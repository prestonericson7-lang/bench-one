/* ===========================================================================================
 *  psram_llm v9 -- Qwen2.5-Coder-3B (3,085,938,688 parameters) on a Teensy 4.1
 *
 *  GENERATED by make_ino.py from psram_worker.ino and psram_llm_board.inc -- edit those, not this.
 *  A .cpp rather than the .ino: the Arduino builder writes a prototype for every function in an .ino,
 *  and for the bus layer's templates it writes non-template ones that are never defined.
 *
 *  BOARD    Teensy 4.1 + ESP-PSRAM64H banks (CS0/CS1 on the pads, Y0-Y7 behind a 74LVC138A) + the
 *           built-in microSD holding qwen3b.gguf (Ollama blob sha256-4a188102..., 1,929,903,072 bytes)
 *  WHAT     the whole model stays on the card (weights, norms and biases every token; the tokenizer's
 *           tables in qwen3b.tok beside it); the PSRAM is the attention cache and nothing else; the
 *           Teensy's own RAM runs the arithmetic, shared/tl_core.c, proven on the PC to
 *           produce model_q.c's logits bit for bit (tests/tl_host.c against tests/tl_ref.c)
 *  BUILD    build.bat (refreshes the shared copies, then arduino-cli). Serial 115200.
 *
 *  Lines 1-94 and 183-661 of psram_worker.ino and its test pattern follow VERBATIM, because a no-op count
 *  is a timing specification for one exact instruction sequence. Qualification then runs again on THIS
 *  binary at every boot rather than trusting numbers measured on another one.
 * ======================================================================================== */
#include <Arduino.h>
#include <SdFat.h>
#include <stdarg.h>
#include "tl_core.h"
#include "tl_plat.h"
#include "gguf.h"
#include "psram_llm.h"

/* HOW MANY INSTANTIATIONS THIS FILE CAN AFFORD, AND WHY THAT IS A TIMING QUESTION.
 *
 * Adding the 0x0B read path cost the two quad banks 21% on a setting that had not changed: at write 8,
 * read 8, burst 64 the same chip went from 9.70 MB/s to 7.71, with a bit-identical partial sum. It was
 * not the wiring, the clock, the burst or the code placement -- both builds put these loops in ITCM and
 * both keep the buffers in DTCM. It was the compiler.
 *
 * The symbol table says it outright. bread<8> is 0x29C bytes in the fast build and 0x244 in the slow
 * one, from identical source. GCC unrolls the payload loop when the translation unit is small enough to
 * justify it and stops when it is not, and the unrolled form is 21% faster. So every template
 * instantiation added anywhere in this file is a change to the timing of every bus loop in it.
 *
 * That is docs/41 again at a larger scale: a no-op count is a timing specification for one exact
 * instruction sequence, and here the compiler rewrote the sequence in response to code that has nothing
 * to do with it. It is also why FASTRUN did not help -- these were already in ITCM, so there was never a
 * fetch penalty to remove.
 *
 * The practical rule: keep the number of instantiations down, and treat adding one as a timing change
 * that requires requalification. The diagnostic tail of 32 to 128 no-ops has done its job -- it proved
 * that slowing down does not rescue a bank that will not read -- and it costs 25 instantiations, so it
 * is gone.
 */

/* BUS-VARIANT: the burst asserts chip select and then waits g_csu no-ops before the first clock
 * edge, which no other sketch in the tree does. The six banks behind the 74LVC138A answer the slow
 * identity probe and return all zeroes to every fast transfer at every timing setting, and the reason
 * is arithmetic: "GPIO9_DR = b" is followed immediately by put_nib, whose first two stores raise the
 * clock about three to seven nanoseconds later. The decoder needs up to six nanoseconds to propagate
 * its enable to the selected output, so the first command bit is clocked into a chip that is not yet
 * selected, every bit after it is shifted, the command is never recognised and the chip never drives
 * SIO1. The two onboard banks have no decoder in the path and pass on the same margin. The delay sits
 * OUTSIDE the nibble loop, so the no-op counts still describe the same instruction sequence they
 * always did -- but the function bodies differ, so it is declared here rather than hidden. */

/* ===========================================================================================
 *  psram_worker -- the Teensy as a math engine, and nothing else.
 *
 *  BOARD    Teensy 4.1, 8x ESP-PSRAM64H = 64 MB. 2 onboard (CS0/CS1), 6 behind a 74LVC138A.
 *  LINK     Serial2 (pins 7/8) at 1 Mbaud to the Luckfox's /dev/ttyS3.
 *
 *  The bus layer below is copied from psram_perfboard unchanged, because a no-op count is a
 *  timing specification for one exact instruction sequence and not for a number. See
 *  .claude/verify-psram-bus.py, which checks that mechanically.
 * ======================================================================================== */

#include <Arduino.h>

#define B_SS0  (1u << 24)
#define B_CLK  (1u << 25)
#define B_DATA (0xFu << 26)
#define DSHIFT 26
#define B_SS1  (1u << 22)
#define PIN_A 2
#define PIN_B 3
#define PIN_C 4
static uint32_t idle;
static inline void bus_out(void) { GPIO9_GDIR |= (B_DATA | B_CLK | B_SS0 | B_SS1); }
static inline void data_in(void) { GPIO9_GDIR &= ~B_DATA; }
template <int S> struct Nop { static inline void go() { __asm__ volatile("nop"); Nop<S - 1>::go(); } };
template <>      struct Nop<0> { static inline void go() { } };
template <int S> static inline void spin(void) { Nop<S>::go(); }

template <int S> static inline void put_nib(uint32_t base, uint8_t nib)
{
    const uint32_t v = base | ((uint32_t)nib << DSHIFT);
    GPIO9_DR = v;
    GPIO9_DR = v | B_CLK;  spin<S>();
    GPIO9_DR = v;          spin<S>();
}

template <int S> static inline uint8_t get_nib(uint32_t base)
{
    GPIO9_DR = base | B_CLK;  spin<S>();
    const uint8_t n = (uint8_t)((GPIO9_PSR >> DSHIFT) & 0xF);
    GPIO9_DR = base;          spin<S>();
    return n;
}

template <int S> static void s_byte(uint32_t base, uint8_t v)
{
    for (int i = 7; i >= 0; i--) {
        const uint32_t d = base | (((v >> i) & 1u) << DSHIFT);
        GPIO9_DR = d;
        GPIO9_DR = d | B_CLK;  spin<S>();
        GPIO9_DR = d;          spin<S>();
    }
}
template <int S> static inline void addr_out(uint32_t b, uint32_t a)
{
    put_nib<S>(b, (a >> 20) & 0xF); put_nib<S>(b, (a >> 16) & 0xF);
    put_nib<S>(b, (a >> 12) & 0xF); put_nib<S>(b, (a >>  8) & 0xF);
    put_nib<S>(b, (a >>  4) & 0xF); put_nib<S>(b, (a      ) & 0xF);
}


#define PIN_DEC  5                      /* decoder enable, active low. GPIO9 bit 8. */
#define B_DEC    (1u << 8)
#define P_SS0    48
#define P_SS1    51
#define P_SCLK   53
#define P_D0     52                     /* SIO0, data IN in single-SPI mode  */
#define P_D1     49                     /* SIO1, data OUT in single-SPI mode */
#define P_D2     50
#define P_D3     54
#define BANKSZ   (8u * 1024u * 1024u)
#define BLK      (8u * 1024u)

enum { SEL_CS0, SEL_CS1, SEL_DEC };

static uint8_t  buf[BLK] __attribute__((aligned(32)));
static uint32_t g_csbit = B_SS0;
static uint32_t g_burst = 32;
static uint8_t  g_wi = 2, g_ri = 4;
static uint8_t  g_kind = 0, g_y = 0;
static uint32_t g_csu = 0;          /* no-ops between chip select falling and the first clock edge */

static inline void cs_setup(void)
{
    for (uint32_t k = 0; k < g_csu; k++) __asm__ volatile("nop");
}

/* THE GAP BETWEEN BURSTS IS WHEN THE CHIP REFRESHES.
 *
 * This is DRAM behind an SPI port and it refreshes only while chip select is HIGH. Between bursts the
 * driver raises chip select and immediately starts the next one, which leaves a gap of a few
 * nanoseconds -- a refresh opportunity far too short for a refresh to finish.
 *
 * Over one burst that does not matter. Over a megabyte it does: at burst 40 the bus holds chip select
 * low for about 90% of a third of a second, and rows that were never refreshed come back wrong. That is
 * what the drifting partial sums were. It is not the per-burst tCEM limit, which is why raising the
 * chip-select budget did not change the error rate, and it is why REMOVING the per-bank resets made
 * things worse rather than better: the reset sequence contains a 2 ms delay with chip select high, and
 * that delay was the only real refresh window in the whole run.
 *
 * So the gap becomes a knob, swept like everything else. It costs a few no-ops per burst against a
 * burst of several hundred clocks, and it buys an answer that does not change between rounds.
 */
static uint32_t g_gap;

static inline void cs_gap(void)
{
    for (uint32_t k = 0; k < g_gap; k++) __asm__ volatile("nop");
}

/* WHERE THE READ IS SAMPLED, AND HOW LONG IT WAITS FIRST.
 *
 * The six external chips take a quad write correctly -- read back over a single-bit path that works,
 * every one of them returns the right bytes with its own tag from four separate addresses -- and then
 * return wrong nibbles to the quad read. The errors are spread evenly over all four data lines, about
 * a quarter of the nibbles each, which is not what a broken wire looks like: one bad line puts all its
 * errors in one bit position. Evenly spread errors across all four lines means the whole nibble is
 * being sampled at the wrong moment.
 *
 * Two things decide that moment. One was the instant within the clock high phase at which GPIO9_PSR is
 * read, and it was swept across seven positions on every bank and changed nothing: the window is wide.
 * That knob has been removed, because the loop implementing it sat inside the nibble loop and added a
 * compare and a branch to every clock phase even at zero -- a different timing specification wearing
 * the same no-op count, which is precisely the fault docs/41 exists to prevent. It showed: the two good
 * banks qualified at read 12 over 32 kB and then returned a different sum on every pass over 1 MB.
 *
 * The other is the number of wait cycles after the read address, and it stays, because it sits outside
 * the payload loop. The sweep settled it at six: the onboard banks are clean at six and totally wrong
 * at four, five, seven, eight and ten, and no other value helps any bank. */
static uint32_t g_dummy = 6;
static uint32_t g_dummy1 = 8;           /* wait cycles for the 0x0B fast read */

/* WHAT THE PAD DOES WHILE IT IS LISTENING.
 *
 * A read turns the four data pads into inputs, and pinMode leaves the bus keeper switched on. A keeper
 * holds whatever the pad last drove -- here, the final nibble of the address -- against anything trying
 * to change it. The two chips soldered to the board overcome it without noticing. Six chips at the far
 * end of ribbon, through 22 ohm resistors, driving into the capacitance of eight chip pins, may not:
 * the keeper is pulling the line back towards the last thing the TEENSY said while the chip is trying
 * to say something else. That would break reads and leave writes untouched, which is exactly the shape
 * of this fault.
 *
 * Hysteresis is the other half. Without it the input threshold sits at one point and a slow, ringing
 * edge crosses it several times; with it the threshold moves away after the first crossing.
 *
 * Neither is assumed to help. Both are switchable and the host sweeps them against a read-back. */
/* THESE WERE WRONG, AND THE CONCLUSION DRAWN FROM THEM WAS WRONG WITH THEM.
 *
 * The pad control fields on this part are, from imxrt.h and not from memory:
 *
 *     SRE   bit 0        slew rate, 1 = fast
 *     DSE   bits 5:3     drive strength
 *     SPEED bits 7:6     pad bandwidth
 *     ODE   bit 11       open drain
 *     PKE   bit 12       keeper or pull enabled
 *     PUE   bit 13       0 = keeper, 1 = pull
 *     PUS   bits 15:14   which pull
 *     HYS   bit 16       Schmitt trigger on the input
 *
 * The earlier values put SPEED at bits 5:4, which overlapped DSE and left the pad bandwidth field at 0 --
 * the SLOWEST setting. So the test that was supposed to ask "does a Schmitt input help" actually asked
 * "does a Schmitt input help if the pad is also crippled", got no for an answer, and that was written
 * down as hysteresis making no difference. It was never tested.
 *
 * It matters here more than anywhere. pinMode(OUTPUT) in the Teensy core writes DSE(7) and nothing else:
 * no hysteresis. So every read this project has ever done sampled the data lines with a plain threshold.
 * A plain threshold is the worst possible input for what these six chips present -- a weak driver at the
 * far end of ribbon, through series resistance, into the capacitance of eight chip pins. A slow edge
 * crosses one threshold several times and reads as several transitions; a Schmitt input moves the
 * threshold away after the first crossing and reads one.
 */
#define PADC_DEFAULT  0x0038u             /* DSE 7, no hysteresis: what pinMode writes today */
#define PADC_HYS      0x10038u            /* the same plus a Schmitt input */
#define PADC_HYSFAST  0x100F9u            /* Schmitt input, fast slew, full pad bandwidth */
#define PADC_HYSPULL  0x1F038u            /* Schmitt input and a 22k pull-up instead of a keeper */

static uint8_t g_padmode;

static void set_pads(uint8_t mode)
{
    g_padmode = mode;
    uint32_t v = PADC_DEFAULT;
    if (mode == 1) v = PADC_HYS;
    else if (mode == 2) v = PADC_HYSFAST;
    else if (mode == 3) v = PADC_HYSPULL;
    IOMUXC_SW_PAD_CTL_PAD_GPIO_EMC_26 = v;   /* pin 52, SIO0 */
    IOMUXC_SW_PAD_CTL_PAD_GPIO_EMC_27 = v;   /* pin 49, SIO1 */
    IOMUXC_SW_PAD_CTL_PAD_GPIO_EMC_28 = v;   /* pin 50, SIO2 */
    IOMUXC_SW_PAD_CTL_PAD_GPIO_EMC_29 = v;   /* pin 54, SIO3 */
    __asm__ volatile("dsb");
}

static inline uint32_t cbase(void)
{
    return (idle | B_SS0 | B_SS1 | B_DEC) & ~g_csbit & ~B_CLK & ~B_DATA;
}

static void select_route(uint8_t kind, uint8_t y)
{
    /* restate the pad configuration every time: anything that has touched a pin as an input leaves it
     * configured differently from what these register writes assume, and GDIR alone does not put that
     * back. Six banks looked dead for an afternoon over exactly this. */
    for (int p = 48; p <= 54; p++) pinMode(p, OUTPUT);
    pinMode(PIN_A, OUTPUT); pinMode(PIN_B, OUTPUT); pinMode(PIN_C, OUTPUT);
    pinMode(PIN_DEC, OUTPUT);

    GPIO9_DR |= (B_SS0 | B_SS1 | B_DEC);
    if (kind == SEL_DEC) {
        digitalWriteFast(PIN_A, (y >> 0) & 1);
        digitalWriteFast(PIN_B, (y >> 1) & 1);
        digitalWriteFast(PIN_C, (y >> 2) & 1);
        g_csbit = B_DEC;
    } else {
        g_csbit = (kind == SEL_CS0) ? B_SS0 : B_SS1;
    }
    g_kind = kind; g_y = y;
    set_pads(g_padmode);                 /* pinMode above rewrites pad control; put it back */
    delayMicroseconds(3);
    idle = (GPIO9_DR | B_SS0 | B_SS1 | B_DEC | (1u << 28) | (1u << 29)) & ~B_CLK;
    bus_out();
}

template <int S> static void bwrite(uint32_t a, const uint8_t *s, uint32_t len)
{
    while (len) {
        const uint32_t n = (len > g_burst) ? g_burst : len;
        bus_out(); const uint32_t b = cbase(); GPIO9_DR = b; cs_setup();
        put_nib<S>(b, 0x3); put_nib<S>(b, 0x8); addr_out<S>(b, a);
        for (uint32_t i = 0; i < n; i++) { put_nib<S>(b, s[i] >> 4); put_nib<S>(b, s[i] & 0xF); }
        GPIO9_DR = idle; cs_gap();
        a += n; s += n; len -= n;
    }
}

template <int S> static void bread(uint32_t a, uint8_t *d, uint32_t len)
{
    while (len) {
        const uint32_t n = (len > g_burst) ? g_burst : len;
        bus_out(); const uint32_t b = cbase(); GPIO9_DR = b; cs_setup();
        put_nib<S>(b, 0xE); put_nib<S>(b, 0xB); addr_out<S>(b, a);
        data_in();
        for (uint32_t k = 0; k < g_dummy; k++)
            { GPIO9_DR = b | B_CLK; spin<S>(); GPIO9_DR = b; spin<S>(); }
        for (uint32_t i = 0; i < n; i++) {
            const uint8_t hi = get_nib<S>(b);
            d[i] = (uint8_t)((hi << 4) | get_nib<S>(b));
        }
        GPIO9_DR = idle; bus_out(); cs_gap();
        a += n; d += n; len -= n;
    }
}

/* THE TABLE NOW STARTS AT ZERO, BECAUSE THE CHIPS STOPPED BEING THE LIMIT.
 *
 * With six chips off the shared bus the two on the Teensy's own pads qualified at 4 no-ops -- the fastest
 * entry there was -- and read 49% faster than they did with eight chips loading the lines. A bank sitting
 * on the fastest entry in the table is a bank whose speed is being set by the table rather than by the
 * hardware, which is the one situation where adding entries is the whole experiment.
 *
 * Zero no-ops leaves a nibble at roughly eleven cycles, about 54 MHz, which is inside the part's 84 MHz
 * rating -- so this asks the chips for nothing they are not specified to do. Correctness is decided the
 * way it always is here, by filling a span and reading it back, and the host requalifies every run, so a
 * setting the chips cannot hold simply does not get chosen.
 *
 * The cost is twenty more template instantiations, and on this target that is a timing change in itself:
 * GCC stops unrolling the payload loop when the translation unit grows, which once cost 21% on a setting
 * that had not moved. So the emitted size of bread<8> is checked against the build these numbers were
 * measured on, and the measurement is what decides whether this stays.
 */

/* The table runs far past anything usable on purpose. 24 no-ops is about 10.7 MHz and is the slowest
 * setting any bank has ever needed; 128 is about 2.3 MHz and exists only to answer one question. The
 * six external banks take a quad write correctly and return wrong nibbles to a quad read, spread over
 * all four data lines, at every setting up to 24. If the far end of that wiring simply cannot be
 * clocked that fast, one of these will come back clean. If none does, clock speed is not the fault and
 * the answer is physical. Either way the sweep decides it rather than an argument. */
/* THE SINGLE-BIT READ, BECAUSE HALF SPEED BEATS NO CAPACITY.
 *
 * Six of the eight chips take a quad write perfectly and return wrong nibbles to a quad read, and
 * nothing in the firmware changes that: not the clock from 10.7 MHz down to 2.3, not the burst from 8
 * bytes to 64, not the wait cycles, not the sample instant, not the bus keeper, the hysteresis or the
 * drive strength. But every one of them answers a SINGLE-bit read correctly, which is the same clock,
 * the same ground, the same supply and the same command phase with one difference: the chip drives one
 * line instead of four.
 *
 * So there is a path to those 48 MB. It is a quarter of the bits per clock, which at the clock a quad
 * read needs is about half the bytes a second -- and half the bytes a second out of 48 MB is worth
 * more than all of the bytes a second out of nothing. Capacity is what this machine is for.
 *
 * The write cannot stay quad. A chip in quad mode does not understand a single-bit command, so the two
 * cannot be mixed on one chip: choosing the single-bit read means the whole bank runs single-bit, and
 * the chip is never given the 0x35 that puts it into quad mode. That was worth finding out the
 * expensive way -- a single-bit read issued to a chip still in quad mode returns garbage from every
 * bank, including the two that are perfect, which looked for a moment like the new path simply did not
 * work. It was the mode, not the path.
 *
 * Writes at one bit a clock cost four times the clocks. That is paid once, when the weights are loaded,
 * and never again during inference. */
template <int S> static void bwrite1(uint32_t a, const uint8_t *src, uint32_t len)
{
    while (len) {
        const uint32_t n = (len > g_burst) ? g_burst : len;
        bus_out();
        const uint32_t b = cbase() | (1u << 28) | (1u << 29);
        GPIO9_DR = b; cs_setup();
        s_byte<S>(b, 0x02);
        s_byte<S>(b, (uint8_t)(a >> 16)); s_byte<S>(b, (uint8_t)(a >> 8)); s_byte<S>(b, (uint8_t)a);
        for (uint32_t i = 0; i < n; i++) s_byte<S>(b, src[i]);
        GPIO9_DR = idle; cs_gap();
        a += n; src += n; len -= n;
    }
}
/* 0x0B RATHER THAN 0x03, BECAUSE 0x03 IS THE SLOW ONE.
 *
 * Five of the seven usable banks read one bit to the clock, and they are the whole critical path: the
 * two quad banks finish a megabyte in 103 ms and the five single-bit ones take 386 ms each. Anything
 * that moves that number moves the machine.
 *
 * Command 0x03 is specified to 33 MHz on this part and has no wait cycles. 0x0B is the same read with
 * wait cycles after the address, and exists precisely so the clock can go faster than 0x03 allows --
 * the wait gives the array time to deliver the first byte instead of requiring a slow clock throughout.
 * It costs eight clocks once per burst and may buy a faster clock on every one of the 128 payload
 * clocks after it.
 *
 * Whether it actually does is a measurement, not an argument: the wait count is swept and so is the
 * clock, and the only thing accepted is a full-span read-back with zero wrong bytes. The quad read
 * already uses a wait count from the same datasheet table and the sweep confirmed its value exactly,
 * which is the reason to trust the table enough to try this at all. */
template <int S> static void bread1f(uint32_t a, uint8_t *d, uint32_t len)
{
    while (len) {
        const uint32_t n = (len > g_burst) ? g_burst : len;
        bus_out();
        const uint32_t b = cbase() | (1u << 28) | (1u << 29);
        GPIO9_DR = b; cs_setup();
        s_byte<S>(b, 0x0B);
        s_byte<S>(b, (uint8_t)(a >> 16)); s_byte<S>(b, (uint8_t)(a >> 8)); s_byte<S>(b, (uint8_t)a);
        GPIO9_GDIR &= ~(1u << 27);
        for (uint32_t k = 0; k < g_dummy1; k++)
            { GPIO9_DR = b | B_CLK; spin<S>(); GPIO9_DR = b; spin<S>(); }
        for (uint32_t i = 0; i < n; i++) {
            uint8_t v = 0;
            for (int k = 0; k < 8; k++) {
                GPIO9_DR = b | B_CLK; spin<S>();
                v = (uint8_t)((v << 1) | ((GPIO9_PSR >> 27) & 1u));
                GPIO9_DR = b;         spin<S>();
            }
            d[i] = v;
        }
        GPIO9_DR = idle; bus_out(); cs_gap();
        a += n; d += n; len -= n;
    }
}

template <int S> static void bread1(uint32_t a, uint8_t *d, uint32_t len)
{
    while (len) {
        const uint32_t n = (len > g_burst) ? g_burst : len;
        bus_out();
        const uint32_t b = cbase() | (1u << 28) | (1u << 29);   /* SIO2/3 idle high in single mode */
        GPIO9_DR = b; cs_setup();
        s_byte<S>(b, 0x03);
        s_byte<S>(b, (uint8_t)(a >> 16)); s_byte<S>(b, (uint8_t)(a >> 8)); s_byte<S>(b, (uint8_t)a);
        GPIO9_GDIR &= ~(1u << 27);
        for (uint32_t i = 0; i < n; i++) {
            uint8_t v = 0;
            for (int k = 0; k < 8; k++) {
                GPIO9_DR = b | B_CLK; spin<S>();
                v = (uint8_t)((v << 1) | ((GPIO9_PSR >> 27) & 1u));
                GPIO9_DR = b;         spin<S>();
            }
            d[i] = v;
        }
        GPIO9_DR = idle; bus_out(); cs_gap();
        a += n; d += n; len -= n;
    }
}

static const int NOPS[] = { 0, 1, 2, 3, 4, 5, 6, 7, 8, 9, 10, 11, 12, 13, 14, 16, 18, 20, 24 };
#define NSET (sizeof(NOPS) / sizeof(NOPS[0]))
static void (*const WF[NSET])(uint32_t, const uint8_t *, uint32_t) = {
    bwrite<0>, bwrite<1>, bwrite<2>, bwrite<3>,
    bwrite<4>, bwrite<5>, bwrite<6>, bwrite<7>, bwrite<8>, bwrite<9>, bwrite<10>,
    bwrite<11>, bwrite<12>, bwrite<13>, bwrite<14>, bwrite<16>, bwrite<18>,
    bwrite<20>, bwrite<24> };
static void (*const RQ[NSET])(uint32_t, uint8_t *, uint32_t) = {
    bread<0>, bread<1>, bread<2>, bread<3>,
    bread<4>, bread<5>, bread<6>, bread<7>, bread<8>, bread<9>, bread<10>,
    bread<11>, bread<12>, bread<13>, bread<14>, bread<16>, bread<18>,
    bread<20>, bread<24> };
static void (*const R1[NSET])(uint32_t, uint8_t *, uint32_t) = {
    bread1<0>, bread1<1>, bread1<2>, bread1<3>,
    bread1<4>, bread1<5>, bread1<6>, bread1<7>, bread1<8>, bread1<9>, bread1<10>,
    bread1<11>, bread1<12>, bread1<13>, bread1<14>, bread1<16>, bread1<18>,
    bread1<20>, bread1<24> };

static void (*const W1[NSET])(uint32_t, const uint8_t *, uint32_t) = {
    bwrite1<0>, bwrite1<1>, bwrite1<2>, bwrite1<3>,
    bwrite1<4>, bwrite1<5>, bwrite1<6>, bwrite1<7>, bwrite1<8>, bwrite1<9>, bwrite1<10>,
    bwrite1<11>, bwrite1<12>, bwrite1<13>, bwrite1<14>, bwrite1<16>, bwrite1<18>,
    bwrite1<20>, bwrite1<24> };

static void (*const RZ[NSET])(uint32_t, uint8_t *, uint32_t) = {
    bread1f<0>, bread1f<1>, bread1f<2>, bread1f<3>,
    bread1f<4>, bread1f<5>, bread1f<6>, bread1f<7>, bread1f<8>, bread1f<9>, bread1f<10>,
    bread1f<11>, bread1f<12>, bread1f<13>, bread1f<14>, bread1f<16>, bread1f<18>,
    bread1f<20>, bread1f<24> };

static uint8_t g_rmode;                 /* 0 quad, 1 single-bit 0x03, 2 single-bit 0x0B */

/* One place decides how a bank is read, so what the sweep timed is what the work runs. */
static inline void do_read(uint32_t a, uint8_t *d, uint32_t len)
{
    if (g_rmode == 2)      RZ[g_ri](a, d, len);
    else if (g_rmode == 1) R1[g_ri](a, d, len);
    else                   RQ[g_ri](a, d, len);
}

static inline void do_write(uint32_t a, const uint8_t *src, uint32_t len)
{
    if (g_rmode) W1[g_wi](a, src, len);      /* both single-bit modes write with 0x02 */
    else         WF[g_wi](a, src, len);
}

static void enter_quad_here(void)
{
    const uint32_t b = cbase();
    const uint32_t b4 = b | (1u << 28) | (1u << 29);
    bus_out();
    GPIO9_DR = b;  cs_setup(); put_nib<10>(b, 0xF); put_nib<10>(b, 0x5); GPIO9_DR = idle;
    delayMicroseconds(5);
    GPIO9_DR = b4; cs_setup(); s_byte<10>(b4, 0x66); GPIO9_DR = idle; delayMicroseconds(5);
    GPIO9_DR = b4; cs_setup(); s_byte<10>(b4, 0x99); GPIO9_DR = idle; delay(2);
    /* 0x35 is what puts the chip into quad mode. In single-bit mode it is simply not sent, and the
     * chip stays where the reset left it: one bit a clock, command 0x02 out and 0x03 back. */
    if (!g_rmode) {
        GPIO9_DR = b4; cs_setup(); s_byte<10>(b4, 0x35); GPIO9_DR = idle;
    }
    delayMicroseconds(50);
}

/* ---------------------------------------------------------------------------------------------
 *  the slow, safe probe -- copied verbatim from psram_perfboard
 *
 *  digitalWriteFast at roughly 250 kHz. A register-level rewrite of this same thing was failing in
 *  every configuration while this one found all eight chips, and a once-per-boot identity read has no
 *  reason to be fast. The chip may still be in quad mode from a previous sketch, so the quad exit and
 *  reset are sent in the mode the chip might actually be in; skipping that makes a working chip look
 *  absent.
 * ------------------------------------------------------------------------------------------ */
static void s_tick(void)
{
    digitalWriteFast(P_SCLK, HIGH); delayMicroseconds(1);
    digitalWriteFast(P_SCLK, LOW);  delayMicroseconds(1);
}

static void s_send(uint8_t v)
{
    pinMode(P_D0, OUTPUT);
    for (int i = 7; i >= 0; i--) { digitalWriteFast(P_D0, (v >> i) & 1); s_tick(); }
}

static uint8_t s_recv(void)
{
    uint8_t v = 0;
    pinMode(P_D1, INPUT);
    for (int i = 0; i < 8; i++) {
        digitalWriteFast(P_SCLK, HIGH);
        v = (uint8_t)((v << 1) | (digitalReadFast(P_D1) ? 1 : 0));
        delayMicroseconds(1);
        digitalWriteFast(P_SCLK, LOW);
        delayMicroseconds(1);
    }
    return v;
}

static void all_high(void)
{
    digitalWriteFast(P_SS0, HIGH);
    digitalWriteFast(P_SS1, HIGH);
    digitalWriteFast(PIN_DEC, HIGH);
}

static uint8_t sel_pin(uint8_t kind)
{
    if (kind == SEL_CS0) return P_SS0;
    if (kind == SEL_CS1) return P_SS1;
    return PIN_DEC;
}

static bool probe_id(uint8_t kind, uint8_t y, uint8_t *id)
{
    const uint8_t cs = sel_pin(kind);

    all_high();
    if (kind == SEL_DEC) {
        digitalWriteFast(PIN_A, (y >> 0) & 1);
        digitalWriteFast(PIN_B, (y >> 1) & 1);
        digitalWriteFast(PIN_C, (y >> 2) & 1);
    }
    delayMicroseconds(5);

    pinMode(P_SCLK, OUTPUT); digitalWriteFast(P_SCLK, LOW);
    pinMode(P_D2, OUTPUT);   digitalWriteFast(P_D2, HIGH);   /* idle high so a quad chip is not */
    pinMode(P_D3, OUTPUT);   digitalWriteFast(P_D3, HIGH);   /* reading them as command bits     */

    /* quad exit, in quad: 0xF5 as two nibbles across all four lines */
    pinMode(P_D0, OUTPUT); pinMode(P_D1, OUTPUT);
    digitalWriteFast(cs, LOW); delayMicroseconds(1);
    for (int k = 0; k < 2; k++) {
        const uint8_t n = (k == 0) ? 0xF : 0x5;
        digitalWriteFast(P_D0, (n >> 0) & 1);
        digitalWriteFast(P_D1, (n >> 1) & 1);
        digitalWriteFast(P_D2, (n >> 2) & 1);
        digitalWriteFast(P_D3, (n >> 3) & 1);
        s_tick();
    }
    digitalWriteFast(cs, HIGH);
    digitalWriteFast(P_D2, HIGH); digitalWriteFast(P_D3, HIGH);
    delayMicroseconds(5);

    /* reset enable, reset */
    digitalWriteFast(cs, LOW); delayMicroseconds(1); s_send(0x66);
    digitalWriteFast(cs, HIGH); delayMicroseconds(5);
    digitalWriteFast(cs, LOW); delayMicroseconds(1); s_send(0x99);
    digitalWriteFast(cs, HIGH); delay(2);

    /* the identity */
    digitalWriteFast(cs, LOW); delayMicroseconds(1);
    s_send(0x9F); s_send(0x00); s_send(0x00); s_send(0x00);
    for (int i = 0; i < 8; i++) id[i] = s_recv();
    digitalWriteFast(cs, HIGH); delayMicroseconds(5);

    all_high();

    /* leave the bus the way the fast path expects to find it */
    for (int q = 48; q <= 54; q++) pinMode(q, OUTPUT);
    bus_out();
    return id[0] == 0x0D && id[1] == 0x5D;
}

static uint8_t g_tag;

static inline uint8_t pat(uint32_t i)
{
    return (uint8_t)(i * 0x9Du + 0x3Bu + (uint32_t)g_tag * 0x51u);
}


/* ===========================================================================================
 *  EVERYTHING BELOW IS NEW IN THIS SKETCH. EVERYTHING ABOVE IS psram_worker's BUS LAYER, VERBATIM.
 * ======================================================================================== */

/* ---------------------------------------------------------------------------------------------
 *  QUALIFICATION -- luckfox/drive.py's procedure, run by the Teensy on itself
 *
 *  Same order and the same numbers: discover by identity, then quad first and the two single-bit reads
 *  after it, each at chip-select setup 0 and then 16. The fastest read that verifies against a slow
 *  write, then the fastest write against that read, a burst computed from the 21 us chip-select budget
 *  in BOTH directions, and a confirmation that reads the same span back four times from one fill,
 *  stepping back until it does. Every bank switch resets the chip, as drive.py does -- the benchmark
 *  found that reset load-bearing (benchmark-must-check-its-answer).
 *
 *  It runs HERE rather than being copied from an old log because a no-op count is a timing
 *  specification for one exact binary, and this is a different binary from the one those logs measured.
 * ------------------------------------------------------------------------------------------ */
#define USABLE            19
#define SAFE_BURST        16
#define WHOLD             15
#define PROBE             32768u
#define SPAN              (1024u * 1024u)
#define CONFIRM_PASSES    4
#define STABLE_PASSES     6
#define WAITS_QUAD        6
#define WAITS_0B          8
#define PAD_MODE          2
#define CS_LOW_BUDGET_US  21.0

/* THE WINDOW, NOT THE EDGE (measure-the-window-not-the-edge, docs/41).
 *
 * The sweep returns the FASTEST setting that verifies, which is the edge of a cliff. The first run of this
 * sketch proved it again: CS0 qualified at write 0 read 13, passed 1 MB four times, six stability passes
 * and the full bank-tagged 8 MB -- and then returned a wrong offset-table word for tokenizer piece 87,272,
 * whose data (small integers, mostly zero bytes) is not the test pattern. So every bank runs this many
 * table steps SLOWER than its edge, in both directions, and is confirmed there. PSRAM carries about 1 MB
 * a token against 1.9 GB off the card, so the speed this costs does not show. */
#define MARGIN            3

/* bank_t lives in psram_llm.h so Arduino's generated prototypes can see it */
static bank_t cand[10];
static bank_t use[10];                    /* the virtual PSRAM, fastest first */
static int    nuse;
static int    cur_bank = -1;

static const char *const MODE_NAME[3] = { "quad", "single 0x03", "single 0x0B" };

static void say(const char *fmt, ...)
{
    char b[240];
    va_list ap;
    va_start(ap, fmt);
    vsnprintf(b, sizeof b, fmt, ap);
    va_end(ap);
    Serial.println(b);
}

/* drive.py's select(): every knob restated, then the bank reset into its mode, then its timing. */
static void apply(const bank_t &b)
{
    g_rmode = b.mode;
    g_dummy = WAITS_QUAD;
    set_pads(PAD_MODE);
    if (b.mode == 2) g_dummy1 = WAITS_0B;
    g_csu = b.su;
    g_gap = 0;
    select_route(b.kind, b.y);
    enter_quad_here();
    set_pads(PAD_MODE);
    g_wi = b.wi; g_ri = b.ri; g_burst = b.nb;
}

static void fill(uint32_t a, uint32_t len)
{
    for (uint32_t off = 0; off < len; off += BLK) {
        const uint32_t n = (len - off > BLK) ? BLK : (len - off);
        for (uint32_t i = 0; i < n; i++) buf[i] = pat(a + off + i);
        do_write(a + off, buf, n);
    }
}

static uint32_t verify(uint32_t a, uint32_t len)
{
    uint32_t bad = 0;
    for (uint32_t off = 0; off < len; off += BLK) {
        const uint32_t n = (len - off > BLK) ? BLK : (len - off);
        do_read(a + off, buf, n);
        for (uint32_t i = 0; i < n; i++) if (buf[i] != pat(a + off + i)) bad++;
    }
    return bad;
}

/* drive.py burst_bound(): two timed bursts give the fixed cost and the per-byte cost. */
static int burst_bound(char dir)
{
    uint32_t c[2];
    const uint32_t len[2] = { 96, 32 };
    for (int k = 0; k < 2; k++) {
        const uint32_t save = g_burst;
        g_burst = len[k];
        if (dir == 'W') for (uint32_t i = 0; i < len[k]; i++) buf[i] = pat(i);
        const uint32_t t0 = ARM_DWT_CYCCNT;
        if (dir == 'W') do_write(0, buf, len[k]); else do_read(0, buf, len[k]);
        c[k] = ARM_DWT_CYCCNT - t0;
        g_burst = save;
    }
    const double per = ((double)c[0] - (double)c[1]) / 64.0;
    const double fix = (double)c[0] - per * 96.0;
    if (per <= 0) return SAFE_BURST;
    int n = (int)((CS_LOW_BUDGET_US * 1e-6 * (double)F_CPU_ACTUAL - fix) / per);
    n = (n / 8) * 8;
    if (n > 96) n = 96;
    if (n < 8) n = 8;
    return n;
}
static int pick_burst(void)
{
    const int r = burst_bound('R'), w = burst_bound('W');
    return r < w ? r : w;
}

/* THE EDGE UNDER THE MODEL'S KIND OF DATA. The edge was found with pat() alone, a linear byte sequence (each
 * byte the last + 0x9D). 2026-09-27: Y1 in 0x03 mode measured its read edge at 11 on the 12:27 boot and at 6 on
 * the 16:28 boot; every other bank's edges repeated exactly. Run at 6 + MARGIN = 9, it passed confirm, stable and
 * the 8 MB proof, then failed the attention cache's writes at the same two addresses on two prompts in a row
 * (17,131,792 read, 17,656,080 write). One lucky 32 KB probe had put it five steps past its real edge. So a
 * setting is clean only when four kinds of data all read back: the linear pattern, mostly-zero bytes (offset
 * tables), mostly-0xFF bytes, and pseudo-random bytes (float cache rows look like this). */
#define PROBE_KINDS 4
static inline uint8_t probe_byte(int kind, uint32_t i)
{
    switch (kind) {
    case 0:  return pat(i);
    case 1:  return (i % 61u) ? 0x00 : (uint8_t)(1u << (i % 8u));
    case 2:  return (i % 67u) ? 0xFF : (uint8_t)~(1u << (i % 8u));
    default: { uint32_t h = (i + 0x9E3779B9u) * 2654435761u; h ^= h >> 15; h *= 0x2C1B3C6Du; h ^= h >> 12;
               return (uint8_t)(h >> 8); }
    }
}
static bool probe_clean(void)
{
    for (int kind = 0; kind < PROBE_KINDS; kind++) {
        for (uint32_t off = 0; off < PROBE; off += BLK) {
            const uint32_t n = (PROBE - off > BLK) ? BLK : (PROBE - off);
            for (uint32_t i = 0; i < n; i++) buf[i] = probe_byte(kind, off + i);
            do_write(off, buf, n);
        }
        for (uint32_t off = 0; off < PROBE; off += BLK) {
            const uint32_t n = (PROBE - off > BLK) ? BLK : (PROBE - off);
            do_read(off, buf, n);
            for (uint32_t i = 0; i < n; i++) if (buf[i] != probe_byte(kind, off + i)) return false;
        }
    }
    return true;
}

static bool sweep(bank_t &b)
{
    b.wi = WHOLD; b.ri = USABLE - 1; b.nb = SAFE_BURST;
    apply(b);
    int ri_ok = -1;
    for (int ri = 0; ri < USABLE; ri++) {
        g_wi = WHOLD; g_ri = (uint8_t)ri; g_burst = SAFE_BURST;
        if (probe_clean()) { ri_ok = ri; break; }
    }
    if (ri_ok < 0) return false;
    int wi_ok = WHOLD;
    for (int wi = 0; wi < USABLE; wi++) {
        g_wi = (uint8_t)wi; g_ri = (uint8_t)ri_ok; g_burst = SAFE_BURST;
        if (probe_clean()) { wi_ok = wi; break; }
    }
    /* the edge, remembered for the log, then MARGIN steps back from it in both directions */
    b.ewi = (uint8_t)wi_ok; b.eri = (uint8_t)ri_ok;
    b.wi = (uint8_t)((wi_ok + MARGIN < USABLE) ? wi_ok + MARGIN : USABLE - 1);
    b.ri = (uint8_t)((ri_ok + MARGIN < USABLE) ? ri_ok + MARGIN : USABLE - 1);
    g_wi = b.wi; g_ri = b.ri; g_burst = SAFE_BURST;
    b.nb = (uint8_t)pick_burst();
    return true;
}

FLASHMEM static bool confirm(bank_t &b)
{
    for (int attempt = 0; attempt < 8; attempt++) {
        apply(b);
        fill(0, SPAN);
        uint32_t bad = 0;
        float rate = 0;
        for (int k = 0; k < CONFIRM_PASSES; k++) {
            const uint32_t t0 = ARM_DWT_CYCCNT;
            bad = verify(0, SPAN);
            const uint32_t cyc = ARM_DWT_CYCCNT - t0;
            if (k == 0 && bad == 0) rate = (float)(SPAN / ((double)cyc / F_CPU_ACTUAL) / 1e6);
            if (bad) break;
        }
        if (!bad) { b.rate = rate; return true; }
        say("        %lu wrong over %u kB at write %d read %d burst %d",
            (unsigned long)bad, SPAN / 1024, NOPS[b.wi], NOPS[b.ri], b.nb);
        if (b.ri + 1 < USABLE) b.ri++;
        else if (b.wi + 1 < USABLE) b.wi++;
        else return false;
        g_wi = b.wi; g_ri = b.ri; g_burst = SAFE_BURST;
        b.nb = (uint8_t)pick_burst();
    }
    return false;
}

FLASHMEM static bool qualify(bank_t &out)
{
    static const uint8_t SETUPS[2] = { 0, 16 };
    bank_t best;
    bool have = false;
    for (uint8_t mode = 0; mode < 3; mode++) {
        bool got = false;
        bank_t b = out;
        for (int s = 0; s < 2 && !got; s++) {
            b = out; b.mode = mode; b.su = SETUPS[s];
            if (!sweep(b)) continue;
            if (confirm(b)) got = true;
        }
        if (got) {
            say("      %-4s %-11s edge write %2d read %2d, running at write %2d read %2d burst %2d setup %2d -> %5.2f MB/s",
                out.name, MODE_NAME[mode], NOPS[b.ewi], NOPS[b.eri], NOPS[b.wi], NOPS[b.ri], b.nb, b.su, b.rate);
            if (!have || b.rate > best.rate) { best = b; have = true; }
            if (mode == 0) break;            /* quad cannot lose to one bit a clock */
        } else {
            say("      %-4s no %s setting survives %u kB", out.name, MODE_NAME[mode], SPAN / 1024);
        }
    }
    if (have) out = best;
    return have;
}

/* drive.py stable(): the same span read back again and again from one fill, every byte compared. */
FLASHMEM static bool stable(const bank_t &b)
{
    apply(b);
    fill(0, SPAN);
    for (int k = 0; k < STABLE_PASSES; k++) {
        const uint32_t bad = verify(0, SPAN);
        if (bad) { say("      %s: %lu wrong on stability pass %d; leaving it out", b.name, (unsigned long)bad, k + 1); return false; }
    }
    return true;
}

FLASHMEM static void psram_bring_up(void)
{
    say("\n  PSRAM discovery: asking all ten selects for an identity");
    static const struct { uint8_t kind, y; const char *name; } ROUTES[10] = {
        { SEL_CS0, 0, "CS0" }, { SEL_CS1, 0, "CS1" },
        { SEL_DEC, 0, "Y0" }, { SEL_DEC, 1, "Y1" }, { SEL_DEC, 2, "Y2" }, { SEL_DEC, 3, "Y3" },
        { SEL_DEC, 4, "Y4" }, { SEL_DEC, 5, "Y5" }, { SEL_DEC, 6, "Y6" }, { SEL_DEC, 7, "Y7" } };
    int ncand = 0;
    for (int r = 0; r < 10; r++) {
        uint8_t id[8] = { 0 };
        const bool ok = probe_id(ROUTES[r].kind, ROUTES[r].y, id);
        say("    %-4s %s  id %02X %02X", ROUTES[r].name, ok ? "PRESENT" : "absent ", id[0], id[1]);
        if (ok) {
            bank_t &b = cand[ncand++];
            memset(&b, 0, sizeof b);
            b.kind = ROUTES[r].kind; b.y = ROUTES[r].y;
            snprintf(b.name, sizeof b.name, "%s", ROUTES[r].name);
        }
    }
    say("  %d chips answered", ncand);

    say("\n  qualifying each: quad first, then single-bit, confirmed over %u kB four times", SPAN / 1024);
    int nq = 0;
    for (int i = 0; i < ncand; i++) {
        g_tag = (uint8_t)(i + 1);
        if (qualify(cand[i]) && stable(cand[i])) cand[nq++] = cand[i];
        else say("      %s: not usable", cand[i].name);
    }

    /* fastest first: the tokenizer sits at the bottom of the address space and is probed hardest */
    for (int i = 0; i < nq; i++)
        for (int j = i + 1; j < nq; j++)
            if (cand[j].rate > cand[i].rate) { bank_t t = cand[i]; cand[i] = cand[j]; cand[j] = t; }

    /* EVERY USABLE BYTE, before the model is allowed near it. All banks are filled first, each with its
     * own tag, and only then read back -- a bank that answers for another (a shared chip select, a
     * decoder line crossed) returns the wrong tag and shows up here, not as a wrong token an hour later. */
    say("\n  proving every byte: fill all %d banks (%d MB) with bank-tagged data, then read all back", nq, nq * 8);
    for (int i = 0; i < nq; i++) {
        apply(cand[i]);
        g_tag = (uint8_t)(0x40 + i);
        const uint32_t t0 = millis();
        fill(0, BANKSZ);
        say("    %-4s filled 8 MB in %.1f s", cand[i].name, (millis() - t0) / 1000.0);
    }
    nuse = 0;
    for (int i = 0; i < nq; i++) {
        apply(cand[i]);
        g_tag = (uint8_t)(0x40 + i);
        const uint32_t t0 = millis();
        const uint32_t bad = verify(0, BANKSZ);
        const float s = (millis() - t0) / 1000.0f;
        say("    %-4s %-11s read back 8 MB in %.1f s (%.2f MB/s): %lu wrong%s", cand[i].name,
            MODE_NAME[cand[i].mode], s, 8.388608f / s, (unsigned long)bad, bad ? "  -> DROPPED" : "");
        if (!bad) use[nuse++] = cand[i];
    }
    cur_bank = -1;
    say("  PSRAM in use: %d banks, %lu bytes", nuse, (unsigned long)nuse * BANKSZ);
}

/* ---------------------------------------------------------------------------------------------
 *  tl_plat.h for this board
 * ------------------------------------------------------------------------------------------ */
static SdFs     sd;
static FsFile   mf;
static uint64_t mf_size;

/* "::stop" is honoured at the next card read, i.e. BETWEEN two complete SdFat reads, never inside one.
 * A Teensy reset does not power-cycle the card: on 2026-09-27 a flash that rebooted the board mid-read left
 * the card answering CMD0 and CMD8 and never finishing ACMD41 (SdFat error 0x17) until power was cut.
 * tools/bench_run.py sends ::stop before it flashes. Any other line arriving during a run is dropped. */
static char     g_pend[64];
static int      g_pn;
static bool     g_abort;
static void poll_stop(void)
{
    while (Serial.available()) {
        const char ch = (char)Serial.read();
        if (ch == '\n' || ch == '\r') {
            g_pend[g_pn] = 0;
            if (!strcmp(g_pend, "::stop")) g_abort = true;
            g_pn = 0;
        } else if (g_pn < (int)sizeof g_pend - 1) {
            g_pend[g_pn++] = ch;
        }
    }
}

/* SEEKS MUST BE CHEAP, AND ON FAT32 THEY ARE NOT BY DEFAULT.
 *
 * SdFat's FatFile::seekSet walks the cluster chain from the file's FIRST cluster for every backward seek.
 * Measured 2026-09-27 12:00 (v5): a random 4 KB read cost 40 ms, and the batched prompt pass -- whose
 * feed-forward alternates 32 gate rows with 32 up rows, a backward seek every block, 12,384 a pass -- read
 * the card at 1.85 MB/s instead of 18.9: 992.9 s of card in a 1144 s pass whose arithmetic was 148 s.
 *
 * contiguousRange() walks the chain once and, when the file is one unbroken run of clusters (the normal
 * case for a file copied onto a fresh card), sets SdFat's contiguous flag: from then on seekSet is
 * firstCluster + n, no walk. If the file is fragmented, four read handles are kept and each read goes to the
 * one already positioned closest below it, so interleaved streams (gate/up) each move forward only. */
#define MF_POOL 4
static bool     mf_contig;
static uint32_t mf_sector0;                  /* the model file's first sector when it is contiguous */
static FsFile   mfp[MF_POOL];
static uint64_t mfp_pos[MF_POOL];
static uint32_t mfp_used[MF_POOL], mfp_tick;

/* THE CARD MUST BE IDLE WHENEVER THE BOARD IS. SdFat on a Teensy 4 in FIFO_SDIO mode leaves every read as an
 * open, paused CMD18 multi-block transfer (SdioTeensy.cpp readSector: "Infinite transfer", m_curState =
 * READ_STATE), closed only by the next non-sequential read or syncDevice() (CMD12). A reboot in that state hung
 * the card twice on 2026-09-27 -- 03:26, and 12:22 after a CLEAN ::stop between two reads -- each time until USB
 * power was cut. So every command the board handles ends with the transfer closed, and so does boot. */
static bool g_sd_up;
static bool fq_open;                         /* ::fifoirq's own CMD18 is open (THE FIFO READ FED BY AN INTERRUPT) */
FLASHMEM __attribute__((noinline)) static void fq_close(void);
static void sd_idle(void) { if (fq_open) fq_close(); if (g_sd_up) sd.card()->syncDevice(); }
/* the card's bus clock as SdFat set it (SdioCard; sd.card() is its base interface) */
static unsigned long sd_khz(void) { return (unsigned long)static_cast<SdioCard *>(sd.card())->kHzSdClk(); }

/* THE DMA PATH'S BURSTS (v8b). v7b measured DMA_SDIO at 7.26 MB/s against FIFO's 18.5 at the same 49.5 MHz
 * clock, flat across read sizes and target memories: a limit inside the controller's DMA, not the card.
 * SdFat's cardInit writes the whole watermark register, SDHC_WML = RDWML(16) | WRWML(16), leaving the read
 * burst length field at 0, and never sets PROT_CTRL's burst-length enables (bits 14:12). ::sdsweep tries
 * read watermark x read burst length x burst enables on DMA reads of the same 2 MB, checks every byte against
 * the FIFO read of it, and keeps the fastest that reads right. cardInit writes the register again on every
 * sd.begin, so the kept setting is reapplied after each (sd_cfg_reapply). */
static uint8_t g_rwml, g_rbrst, g_blen;
static bool    g_sdcfg;                      /* false: SdFat's own settings */
static bool    g_dma;                        /* the card came up in DMA_SDIO (see THE CARD AND THE ARITHMETIC) */
FLASHMEM static void sd_regs(const char *why)
{
    say("    uSDHC %s: WTMK_LVL 0x%08lX PROT_CTRL 0x%08lX MIX_CTRL 0x%08lX SYS_CTRL 0x%08lX VEND_SPEC 0x%08lX VEND_SPEC2 0x%08lX",
        why, (unsigned long)USDHC1_WTMK_LVL, (unsigned long)USDHC1_PROT_CTRL, (unsigned long)USDHC1_MIX_CTRL,
        (unsigned long)USDHC1_SYS_CTRL, (unsigned long)USDHC1_VEND_SPEC, (unsigned long)USDHC1_VEND_SPEC2);
}
static void sd_burst_apply(uint8_t wml, uint8_t brst, uint8_t blen)
{
    USDHC1_WTMK_LVL  = (USDHC1_WTMK_LVL & ~(0xFFu | (0x1Fu << 8))) | wml | ((uint32_t)brst << 8);
    USDHC1_PROT_CTRL = (USDHC1_PROT_CTRL & ~(7u << 12)) | ((uint32_t)blen << 12);
}
/* THE CARD'S CLOCK (v8b). FIFO reads run at 22.9 MB/s, 92.5% of what four data lines carry at 49.5 MHz; the
 * SD spec's next step (UHS-I) needs 1.8 V signalling, which this slot does not have. The uSDHC divides a
 * 198 MHz base (PLL2 PFD0 396 MHz / 2, SdFat's initClock); SdFat picks /4 = 49.5 MHz, the High Speed mode's
 * 50 MHz limit. /3 = 66 MHz and /2 = 99 MHz are beyond that spec. Every data block on the bus carries a CRC16
 * the controller checks, so a bad transfer fails the read instead of passing wrong bytes -- and ::sdclksweep
 * checks every byte anyway, against the same 8 MB read at 49.5 MHz. A divider that reads every byte right
 * twice over is kept (g_sddvs) and reapplied after every sd.begin. */
static uint8_t g_sddvs;                      /* 0: SdFat's own divider */
static unsigned long sd_clk_now(void)
{
    const uint32_t s = USDHC1_SYS_CTRL, fs = (s >> 8) & 0xFF, dvs = (s >> 4) & 0xF;
    return 198000ul / ((fs ? 2u * fs : 1u) * (dvs + 1u));
}
static bool sd_set_dvs(uint8_t dvs)
{
    USDHC1_SYS_CTRL = (USDHC1_SYS_CTRL & ~(0xFu << 4)) | ((uint32_t)dvs << 4);
    const uint32_t t0 = micros();
    while (!(USDHC1_PRES_STATE & (1u << 3)))                 /* SDSTB: the new clock is stable */
        if (micros() - t0 > 10000u) return false;
    return true;
}
static void sd_cfg_reapply(void)
{
    if (g_dma && g_sdcfg) sd_burst_apply(g_rwml, g_rbrst, g_blen);
    if (g_sddvs) sd_set_dvs(g_sddvs);
}

/* THE CARD AND THE ARITHMETIC AT THE SAME TIME (v7).
 *
 * In FIFO_SDIO mode the CPU itself copies every word out of the card controller and spins between sectors
 * (SdioTeensy.cpp readData: waitTimeout, no yield) -- a pass is card time PLUS arithmetic time. In DMA_SDIO mode
 * the controller writes the bytes by itself and SdFat waits in yieldTimeout(), calling yield() until the
 * transfer is done. That wait is where the core's pending rows run: yield() below works ONE row per call by
 * default (::slice 0), so SdFat looks at the transfer again after every row and the card is never left idle
 * behind a slice of arithmetic; ::slice N works rows for N us per call instead, for the A/B. One row is at
 * most a few ms even batched, far inside SdFat's 1 s busy timeout. Rows it does not reach are worked by the
 * core after the read, so the result is the same either way (PC-proven with every interleaving).
 * The core's row buffers are in DTCM, which the controller's DMA reaches and the cache does not cover.
 *
 * Arm the work only around the card read itself: Serial.available() calls yield() whenever nothing has
 * arrived (cores/teensy4/usb_serial.c), so a poll_stop() with the work armed would run rows BEFORE the
 * transfer starts -- no overlap, but counted as hidden. plat_sd_read_overlap polls first, then arms. */
/* g_dma: declared with the SD globals above */
static int  g_overlap = 1;                   /* ::overlap 0|1 */
static int  g_align = 1;                     /* ::align 0|1: whole sectors per pipeline read, DMA only */
static uint32_t g_slice_us;                  /* ::slice N: 0 = one row per yield() */
static int  g_sdpath;                        /* ::sdpath file|adma: 1 = whole-sector pipeline reads by ADMA2 (v9b) */
static void adma_arm(void *buf, uint32_t n);
static void adma_disarm(void);
static int (*volatile g_ywork)(void *);
static void *g_yctx;

void yield(void)                             /* replaces the core's weak yield (it does nothing in this sketch) */
{
    int (*w)(void *) = g_ywork;
    if (!w) return;
    const uint32_t t0 = micros();
    do {
        if (!w(g_yctx)) { g_ywork = 0; return; }
    } while (micros() - t0 < g_slice_us);
}

/* WHICH MODEL: qwen3b.gguf unless model.txt on the card names another file (written by ::model NAME,
 * which then restarts the board). The tokenizer store is the same name with .tok. */
static char g_model_name[48] = "qwen3b.gguf";
static char g_tok_name[48]   = "qwen3b.tok";
FLASHMEM static void model_name_load(void)
{
    FsFile f = sd.open("model.txt", O_RDONLY);
    if (!f) return;
    char b[48];
    const int n = f.read(b, sizeof b - 1);
    f.close();
    if (n <= 0) return;
    b[n] = 0;
    for (int i = 0; b[i]; i++) if (b[i] == '\r' || b[i] == '\n' || b[i] == ' ') { b[i] = 0; break; }
    const size_t L = strlen(b);
    if (L < 6 || L > 40 || strcmp(b + L - 5, ".gguf") || !sd.exists(b)) {
        say("    model.txt names %s: not on the card, opening %s instead", b, g_model_name);
        return;
    }
    strcpy(g_model_name, b);
    strcpy(g_tok_name, b);
    strcpy(g_tok_name + L - 5, ".tok");
    say("    model.txt: %s (tokenizer store %s)", g_model_name, g_tok_name);
}

/* the model file open, and whether its clusters are one run (then every seek is one addition) */
FLASHMEM static bool model_file_open(void)
{
    mf = sd.open(g_model_name, O_RDONLY);
    if (!mf) return false;
    mf_size = mf.fileSize();
    say("    %s: %llu bytes", g_model_name, (unsigned long long)mf_size);
    uint32_t s0 = 0, s1 = 0;
    const uint32_t t0 = millis();
    mf_contig = mf.contiguousRange(&s0, &s1);
    mf_sector0 = s0;
    const uint8_t ft = sd.fatType();
    if (mf_contig) {
        say("    contiguous on the card, sectors %lu..%lu (%s): every seek is one addition (checked in %lu ms)",
            (unsigned long)s0, (unsigned long)s1, ft == FAT_TYPE_EXFAT ? "exFAT" : "FAT32", (unsigned long)(millis() - t0));
    } else {
        for (int i = 0; i < MF_POOL; i++) { mfp[i] = sd.open(g_model_name, O_RDONLY); mfp_pos[i] = 0; mfp_used[i] = 0; }
        say("    FRAGMENTED on the card (%s): backward seeks walk the cluster chain; %d forward-moving read handles instead",
            ft == FAT_TYPE_EXFAT ? "exFAT" : "FAT32", MF_POOL);
    }
    return true;
}

/* THE TOKENIZER'S STORE (tl_plat.h): qwen3b.tok beside the model, created by the core from the model file
 * the first time and reused while it matches. Created as ONE contiguous run (preAllocate), and reopened
 * with contiguousRange(), because the tokenizer reads it at random and a FAT32 seek in a fragmented file
 * walks the cluster chain (40 ms a read, measured 2026-09-27). */
static FsFile tf;
static bool   tf_open;
FLASHMEM int plat_tok_open(uint32_t bytes)
{
    if (tf_open) { tf.close(); tf_open = false; }
    if (!bytes) {
        tf = sd.open(g_tok_name, O_RDWR);
        if (!tf) return -1;
        uint32_t s0 = 0, s1 = 0;
        const bool contig = tf.contiguousRange(&s0, &s1);
        say("    %s: %lu bytes on the card%s", g_tok_name, (unsigned long)tf.fileSize(), contig ? ", contiguous" : ", FRAGMENTED (slow lookups)");
        tf_open = true;
        return 0;
    }
    if (sd.exists(g_tok_name)) sd.remove(g_tok_name);
    tf = sd.open(g_tok_name, O_RDWR | O_CREAT | O_TRUNC);
    if (!tf) return -1;
    if (!tf.preAllocate(bytes)) {
        say("    %s: no contiguous %lu bytes free on the card", g_tok_name, (unsigned long)bytes);
        tf.close(); sd.remove(g_tok_name);
        return -1;
    }
    say("    %s: %lu bytes allocated on the card in one run; writing the tokenizer's tables", g_tok_name, (unsigned long)bytes);
    tf_open = true;
    return 0;
}
int plat_tok_read(uint32_t a, void *dst, uint32_t n)
{
    if (fq_open) fq_close();
    if (!tf_open || !tf.seekSet(a)) return -1;
    return tf.read(dst, n) == (int)n ? 0 : -1;
}
/* exFAT: SdFat's ExFatFile::seekSet refuses a position past the file's valid data length, and the core writes
 * the store's rows from TOK_HDR before its header at 0 -- so on a fresh exFAT card the very first write failed
 * ("tokenizer store write failed at 0", the SanDisk Ultra 64 GB, 2026-10-16). FAT32 allows the seek, which is
 * why the 4 GB FAT32 card never showed it. A gap before the write is filled with zeros first. */
FLASHMEM int plat_tok_write(uint32_t a, const void *src, uint32_t n)
{
    if (fq_open) fq_close();
    if (!tf_open) return -1;
    const uint64_t sz = tf.fileSize();                  /* exFAT: the valid length, the bound seekSet enforces */
    if (a > sz) {
        static const uint8_t z[64] = { 0 };
        if (!tf.seekSet(sz)) return -1;
        for (uint64_t p = sz; p < a; ) {
            const uint32_t k = (a - p) < sizeof z ? (uint32_t)(a - p) : (uint32_t)sizeof z;
            if (tf.write(z, k) != k) return -1;
            p += k;
        }
    }
    if (!tf.seekSet(a)) return -1;
    return tf.write(src, n) == n ? 0 : -1;
}
int plat_tok_flush(void) { if (fq_open) fq_close(); return (tf_open && tf.sync()) ? 0 : -1; }

/* ::sdio fifo|dma -- restart the card in the other mode, for an A/B on one build: close every handle, close
 * the transfer (sd_idle: the card is left idle, never mid-transfer), end, begin in the new mode, reopen. */
FLASHMEM static bool sdio_switch(bool dma)
{
    sd_idle();
    const bool had_tok = tf_open;
    if (tf_open) { tf.close(); tf_open = false; }
    mf.close();
    for (int i = 0; i < MF_POOL; i++) if (mfp[i]) mfp[i].close();
    sd.end();
    g_sd_up = false;
    if (!sd.begin(SdioConfig(dma ? DMA_SDIO : FIFO_SDIO))) {
        say("  SD restart in %s failed: SdFat error 0x%02X data 0x%08lX", dma ? "DMA_SDIO" : "FIFO_SDIO",
            (unsigned)sd.sdErrorCode(), (unsigned long)sd.sdErrorData());
        return false;
    }
    g_sd_up = true;
    g_dma = dma;
    sd_cfg_reapply();
    say("    SD up (%s), clock %lu kHz", dma ? "DMA_SDIO" : "FIFO_SDIO", sd_clk_now());
    if (!model_file_open()) return false;
    return !had_tok || plat_tok_open(0) == 0;
}

static int mf_read_at(uint64_t off, void *dst, uint32_t n, uint32_t need);

/* uSDHC bits, from SdFat's SdioTeensy.h (shared with ::sdfifo below) */
#define FX_BREN    (1u << 11)               /* PRES_STATE: buffer read enable (>= RD_WML words waiting) */
#define FX_RTA     (1u << 9)                /* PRES_STATE: read transfer active */
#define FX_SDOFF   (1u << 7)                /* PRES_STATE: SD clock gated off internally */
#define FX_SABGREQ (1u << 16)               /* PROT_CTRL: stop at block gap request */
#define FX_CREQ    (1u << 17)               /* PROT_CTRL: continue request */
#define FX_TC      (1u << 1)                /* INT_STATUS: transfer complete */
#define FX_BRR     (1u << 5)                /* INT_STATUS / _EN / SIGNAL_EN: buffer read ready */
#define FX_ERR     ((1u << 16) | (1u << 17) | (1u << 18) | (1u << 19) | (1u << 20) | (1u << 21) | (1u << 22) | \
                    (1u << 24) | (1u << 28))   /* CTOE CCE CEBE CIE DTOE DCE DEBE AC12E DMAE (SdFat's ERROR mask) */
/* sd.card() is SdFat's base interface; begun with SdioConfig (always, here) it is SdCardFactory's SdioCard member,
 * whose streaming calls readStart/readStop are not in the base. */
static SdioCard *fx_card(void) { return static_cast<SdioCard *>(sd.card()); }

/* THE FIFO READ FED BY AN INTERRUPT (::fifoirq 0|1, 2026-10-16; on by default once measured). FIFO reads
 * this card at 24 MB/s but SdFat's readData() spins until each block is in, so a FIFO pass is card time PLUS
 * arithmetic. Here the card is fed by the controller's interrupt instead: read watermark 128 words, Buffer
 * Read Ready drains a whole block into the core's buffer, and the stop at the block gap (Transfer Complete)
 * asks for the next -- SdFat's own handshake (SABGREQ / CREQ) moved into the handler -- while the core's
 * pending rows run in plat_sd_read_overlap, whole and uninterrupted, as they do under DMA. One CMD18 stays
 * open, parked at a block gap, across consecutive pipeline reads (the card is never re-addressed, which is
 * what costs ADMA2 274 us a command); any other card access (norms and biases, the tokenizer store, a mode
 * switch, the end of a command) closes it first. The last sector read is kept: the next block usually starts
 * inside it. Same bytes, so the same step lines; a failure closes, restarts the card, turns this off and
 * reads the block through the file layer. */
static int g_fifoirq = 3;                   /* 3, the ring, by default (2026-10-16, SanDisk Ultra: decode 42.7 s against 58.7 for
                                               the interrupt-fed FIFO and 109.6 for ADMA2 per read; 8 of 8 pass sizes exact) */
static void halt(const char *why);
static uint32_t fq_next;                                  /* the card sector the open transfer delivers next */
static uint32_t fq_tail_sec = 0xFFFFFFFFu;                /* the last sector read, kept in fq_tail */
__attribute__((aligned(4))) static uint8_t fq_tail[512];
static volatile uint32_t fqi_done, fqi_err, fqi_parked, fqi_irqs, fqi_wpos;
static uint32_t *fqi_dst, fqi_total, fq_wml0, fq_sten0;
static uint32_t fq_opens;                                 /* transfers opened (each one a card re-address) */
/* The read watermark (::fifoirq N, words: 16, 32, 64 or 128). At 128 the handler drains a block only once all
 * of it is in, and the next block waits behind that 4.7 us drain (::sdfifo 2026-10-16: 27.6 us a block against
 * the polled read's 21.5); below 128 it drains while the block arrives, a WML at a time. */
static uint32_t fq_wml = 128;

FLASHMEM __attribute__((noinline)) static void fq_isr(void)
{
    const uint32_t st = USDHC1_INT_STATUS;
    fqi_irqs++;
    if (st & FX_ERR) { USDHC1_INT_STATUS = st & FX_ERR; fqi_err = st; USDHC1_INT_SIGNAL_EN = 0; return; }
    if (st & FX_BRR) {
        USDHC1_INT_STATUS = FX_BRR;
        const uint32_t w = fq_wml;
        while (USDHC1_PRES_STATE & FX_BREN) {             /* every whole WML waiting, not just the first */
            if (fqi_done >= fqi_total) {                  /* data nobody asked for: the handshake broke */
                for (uint32_t i = 0; i < w; i++) (void)USDHC1_DATA_BUFF_ACC_PORT;
                fqi_err = 0x80000000u;
                break;
            }
            uint32_t *p = fqi_dst + fqi_done * 128u + fqi_wpos;
            for (uint32_t i = 0; i < w; i++) p[i] = USDHC1_DATA_BUFF_ACC_PORT;
            fqi_wpos += w;
            if (fqi_wpos >= 128u) { fqi_wpos = 0; fqi_done++; }
        }
    }
    if (st & FX_TC) {                                     /* parked at the block gap */
        USDHC1_INT_STATUS = FX_TC;
        if (fqi_done < fqi_total) {
            USDHC1_PROT_CTRL &= ~FX_SABGREQ;
            USDHC1_PROT_CTRL |= FX_CREQ;
            USDHC1_PROT_CTRL |= FX_SABGREQ;
        } else fqi_parked = 1;
    }
    asm volatile("dsb");
}

/* ::fifoirq 2 -- the same open transfer, copied by the controller's ADMA2 engine instead of the CPU: Stop At
 * Block Gap set, one interrupt at each block's stop asks for the next, and a new read loads its own descriptor
 * table and continues (NXP's "boot data continuous" pattern, mcux-sdk fsl_usdhc.c). The core's row buffers are
 * DTCM, which the DMA reaches and no cache covers. Measured by ::sdfifo adma before it is trusted. */
__attribute__((aligned(32))) static uint32_t fq_desc[2 * 4];
static bool fq_dma;                                       /* the open transfer is the DMA kind */
FLASHMEM __attribute__((noinline)) static void fqd_isr(void)
{
    const uint32_t st = USDHC1_INT_STATUS;
    fqi_irqs++;
    if (st & FX_ERR) { USDHC1_INT_STATUS = st & FX_ERR; fqi_err = st | 1u; USDHC1_INT_SIGNAL_EN = 0; return; }
    if (st & FX_TC) {
        USDHC1_INT_STATUS = st & ~FX_ERR;                 /* TC, and the DMA / block-gap events with it */
        if (++fqi_done < fqi_total) {
            USDHC1_PROT_CTRL &= ~FX_SABGREQ;
            USDHC1_PROT_CTRL |= FX_CREQ;
            USDHC1_PROT_CTRL |= FX_SABGREQ;
        } else fqi_parked = 1;
    }
    asm volatile("dsb");
}
/* the read's descriptors: up to three of <= 32 KB, NOT marked End, then one block of overflow marked End. An End
 * descriptor ends the data phase itself (::sdfifo adma, 2026-10-16: after the first read's End the controller
 * showed no transfer active and Continue resumed nothing), so the engine must stop at the read's last block gap
 * with the table not finished; the next read then replaces the table address before Continue. */
__attribute__((aligned(4))) static uint8_t fq_ovf[512];
static void fq_desc_build(uint8_t *d, uint32_t n)
{
    int i = 0;
    for (; i < 3 && n; i++) {
        const uint32_t k = n < 32768u ? n : 32768u;
        n -= k;
        fq_desc[2 * i] = (k << 16) | 0x21u;
        fq_desc[2 * i + 1] = (uint32_t)d;
        d += k;
    }
    fq_desc[2 * i] = (512u << 16) | 0x23u;
    fq_desc[2 * i + 1] = (uint32_t)fq_ovf;
}
/* the open CMD18 with ADMA2 armed: block size 512, no block count, no auto CMD12, Stop At Block Gap set */
FLASHMEM __attribute__((noinline)) static bool sd_cmd18_dma(uint32_t sector, const uint32_t *desc)
{
    uint32_t t0 = micros();
    while (!(fx_card()->status() & (1u << 8))) if (micros() - t0 > 100000u) return false;     /* READY_FOR_DATA */
    t0 = micros();
    while (USDHC1_PRES_STATE & 3u) if (micros() - t0 > 100000u) return false;                 /* CIHB, CDIHB */
    USDHC1_INT_STATUS = 0xFFFFFFFFu;
    USDHC1_BLK_ATT = 512u;
    USDHC1_ADMA_SYS_ADDR = (uint32_t)desc;
    USDHC1_PROT_CTRL = (USDHC1_PROT_CTRL & ~(3u << 8)) | (2u << 8) | FX_SABGREQ;
    USDHC1_CMD_ARG = sector;                                                                    /* SDHC/SDXC: sector address */
    USDHC1_MIX_CTRL = (USDHC1_MIX_CTRL & ~0xFFu) | 0x01u /* DMAEN */ | 0x10u /* DTDSEL: read */ | 0x20u /* MSBSEL */;
    USDHC1_CMD_XFR_TYP = (18u << 24) | (1u << 21) /* DPSEL */ | (1u << 20) /* CICEN */ | (1u << 19) /* CCCEN */ | (2u << 16) /* R1 */;
    t0 = micros();
    while (!(USDHC1_INT_STATUS & (1u | FX_ERR))) if (micros() - t0 > 100000u) return false;   /* command complete */
    if (USDHC1_INT_STATUS & FX_ERR) return false;
    USDHC1_INT_STATUS = 1u;
    return true;
}

/* ::fifoirq 3 -- THE CARD STREAMING INTO A RING (2026-10-16; ::sdfifo ring proved the mechanism: 45.2 MB/s, one
 * interrupt a block, every byte right). One open CMD18 copies by ADMA2 into a 16-block DTCM ring whose table is a
 * Tran over the ring and a Link back to it, so the engine never ends and never needs a new table. Stop At Block
 * Gap stays set; each block's stop grants the next only while the ring has room. The card therefore runs ahead
 * of the reads (it prefetches while the core computes); a pipeline read copies its sectors out of the ring in
 * order (1.2 us a block) and works the core's pending rows whenever its next block is not in yet. A read that
 * does not continue the stream restarts it. */
#define RQ_NB 16u
__attribute__((aligned(32))) static uint8_t rq_ring[RQ_NB * 512u];
__attribute__((aligned(32))) static uint32_t rq_desc[4];
static volatile uint32_t rq_prod, rq_cons, rq_parked, rq_stop;   /* rq_stop: grant nothing more, park */
static uint32_t rq_sec0;                                  /* the card sector of stream block 0 */
static bool fq_ring;                                      /* the open transfer is the ring kind */
static int g_rq_rstd = 0;                                 /* ::sdfifo cycle: pass number */
static int g_ring_fault = 0;                              /* ::ringfault N: the Nth ring read from now fails halfway */
FLASHMEM __attribute__((noinline)) static void rq_isr(void)
{
    const uint32_t st = USDHC1_INT_STATUS;
    fqi_irqs++;
    if (st & FX_ERR) { USDHC1_INT_STATUS = st & FX_ERR; fqi_err = st | 1u; USDHC1_INT_SIGNAL_EN = 0; return; }
    if (st & FX_TC) {
        USDHC1_INT_STATUS = st & ~FX_ERR;
        const uint32_t p = ++rq_prod;
        if (!rq_stop && p - rq_cons < RQ_NB) {
            USDHC1_PROT_CTRL &= ~FX_SABGREQ;
            USDHC1_PROT_CTRL |= FX_CREQ;
            USDHC1_PROT_CTRL |= FX_SABGREQ;
        } else rq_parked = 1;
    }
    asm volatile("dsb");
}

/* DS_ADDR, the simple-DMA target, is pointed here while a DMA kind of stream is open or closing: if simple DMA ever
 * moves data, it lands in this canary, which ::sdfifo cycle checks, instead of on a variable or the stack. */
DMAMEM __attribute__((aligned(32))) static uint8_t rq_canary[4096];
/* a DMA kind of stream closed by this board, not by SdFat's readStop: park at a block gap, CMD12 while still in
 * ADMA2, wait for the data lines, reset the data side (buffer and DMA engine; RSTD), clear every transfer bit and
 * status. 2026-10-16: closing through readStop (which clears Stop At Block Gap before its CMD12) and then
 * leaving ADMA2 let the controller move data by simple DMA to DS_ADDR -- card bytes over the stack (11:11,
 * IACCVIOL), then over the variables after the scratch block DS_ADDR was moved to (::sdfifo cycle, 11:34). */
FLASHMEM __attribute__((noinline)) static void rq_close_hw(void)
{
    rq_stop = 1;
    uint32_t t0 = micros();
    while (!rq_parked && (USDHC1_PRES_STATE & (FX_RTA | 4u /* DLA */)) && micros() - t0 < 5000u) {}
    USDHC1_INT_SIGNAL_EN = 0;
    USDHC1_DS_ADDR = (uint32_t)rq_canary;
    t0 = micros();
    while ((USDHC1_PRES_STATE & 1u /* CIHB */) && micros() - t0 < 10000u) {}
    USDHC1_CMD_ARG = 0;
    USDHC1_CMD_XFR_TYP = (12u << 24) | (3u << 22) /* abort */ | (1u << 20) | (1u << 19) | (3u << 16) /* R1b */;
    t0 = micros();
    while (!(USDHC1_INT_STATUS & (1u /* CC */ | FX_ERR)) && micros() - t0 < 10000u) {}
    t0 = micros();
    while ((USDHC1_PRES_STATE & (4u /* DLA */ | 2u /* CDIHB */)) && micros() - t0 < 20000u) {}
    const uint32_t prot = USDHC1_PROT_CTRL & ~((3u << 8) | FX_SABGREQ | FX_CREQ);
    USDHC1_SYS_CTRL |= (1u << 26);                        /* RSTD */
    t0 = micros();
    while ((USDHC1_SYS_CTRL & (1u << 26)) && micros() - t0 < 10000u) {}
    USDHC1_MIX_CTRL &= ~0xFFu;                            /* no DMA, no block count, no direction */
    USDHC1_PROT_CTRL = prot;
    USDHC1_INT_STATUS = 0xFFFFFFFFu;
}

FLASHMEM __attribute__((noinline)) static void fq_close(void)
{
    if (!fq_open) return;
    fq_open = false;
    if (fq_dma || fq_ring) {
        rq_close_hw();
        fq_dma = false; fq_ring = false;
    } else {
        USDHC1_INT_SIGNAL_EN = 0;
        fx_card()->readStop();
    }
    USDHC1_INT_STATUS_EN = fq_sten0;
    USDHC1_WTMK_LVL = fq_wml0;                            /* SdFat's readData() drains 16 words per wait */
}

/* ::fifoirq 3: whole sectors at file offset a into d out of the ring, working `work` while blocks are not in */
FLASHMEM __attribute__((noinline)) static int rq_read(uint64_t a, uint8_t *d, uint32_t len, int (*work)(void *), void *ctx)
{
    uint32_t sec = (uint32_t)(mf_sector0 + a / 512u), nsec = len / 512u;
    if (sec == fq_tail_sec) { memcpy(d, fq_tail, 512); d += 512; sec++; nsec--; }
    if (!nsec) return 0;
    fqi_err = 0;
    if (fq_open && !fq_ring) fq_close();
    /* continue the stream if this read starts at, or a few blocks past, the next sector it will deliver */
    if (!fq_open || sec < rq_sec0 + rq_cons || sec > rq_sec0 + rq_cons + 2u * RQ_NB) {
        fq_close();
        sd.card()->syncDevice();
        fq_wml0 = USDHC1_WTMK_LVL; fq_sten0 = USDHC1_INT_STATUS_EN;
        rq_desc[0] = ((RQ_NB * 512u) << 16) | 0x21u; rq_desc[1] = (uint32_t)rq_ring;   /* Tran over the ring */
        rq_desc[2] = 0x31u;                          rq_desc[3] = (uint32_t)rq_desc;   /* Link back to it */
        rq_prod = 0; rq_cons = 0; rq_parked = 0; rq_stop = 0; rq_sec0 = sec;
        USDHC1_DS_ADDR = (uint32_t)rq_canary;
        USDHC1_INT_STATUS = 0xFFFFFFFFu;                  /* nothing latched from before raises an interrupt */
        USDHC1_INT_STATUS_EN = fq_sten0 | FX_TC;
        attachInterruptVector(IRQ_SDHC1, rq_isr);
        NVIC_SET_PRIORITY(IRQ_SDHC1, 6 * 16);
        NVIC_ENABLE_IRQ(IRQ_SDHC1);
        USDHC1_INT_SIGNAL_EN = FX_TC | FX_ERR;
        fq_open = true; fq_ring = true; fq_opens++;
        if (!sd_cmd18_dma(sec, rq_desc)) fqi_err = 0x20000000u;
    }
    uint32_t t = micros(), last = rq_prod;
    for (uint32_t k = 0; !fqi_err; ) {                  /* blocks before `sec` are skipped, then nsec copied */
        if (rq_prod <= rq_cons) {                        /* the next block is not in yet */
            if (work) { if (!work(ctx)) work = 0; continue; }
            if (rq_prod != last) { last = rq_prod; t = micros(); }
            else if (micros() - t > 200000u) { fqi_err = 0x40000000u; break; }
            continue;
        }
        const uint32_t s = rq_sec0 + rq_cons;
        if (s >= sec) {
            memcpy(d + k * 512u, rq_ring + (rq_cons % RQ_NB) * 512u, 512);
            k++;
            if (g_ring_fault && k == (nsec + 1u) / 2u && --g_ring_fault == 0) {   /* ::ringfault: fail halfway, on purpose */
                fqi_err = 0x10000000u;
                break;
            }
        }
        noInterrupts();
        rq_cons++;
        if (rq_parked) {
            rq_parked = 0;
            USDHC1_PROT_CTRL &= ~FX_SABGREQ; USDHC1_PROT_CTRL |= FX_CREQ; USDHC1_PROT_CTRL |= FX_SABGREQ;
        }
        interrupts();
        if (k == nsec) break;
    }
    if (fqi_err) {
        say("    fifoirq 3: read of %lu sectors at %lu stopped (0x%08lX, PRES_STATE 0x%08lX, ADMA_ERR 0x%08lX); back to the file layer",
            (unsigned long)nsec, (unsigned long)sec, (unsigned long)fqi_err, (unsigned long)USDHC1_PRES_STATE, (unsigned long)USDHC1_ADMA_ERR_STATUS);
        fq_close();
        fq_tail_sec = 0xFFFFFFFFu;
        return -1;
    }
    memcpy(fq_tail, d + (nsec - 1) * 512u, 512);
    fq_tail_sec = sec + nsec - 1;
    return 0;
}

/* whole sectors at file offset a (sector-aligned) into d, working `work` while they come in. 0, or -1: the
 * caller restarts the card and reads through the file layer. */
FLASHMEM __attribute__((noinline)) static int fq_read(uint64_t a, uint8_t *d, uint32_t len, int (*work)(void *), void *ctx)
{
    uint32_t sec = (uint32_t)(mf_sector0 + a / 512u), nsec = len / 512u;
    if (sec == fq_tail_sec) { memcpy(d, fq_tail, 512); d += 512; sec++; nsec--; }
    if (!nsec) return 0;
    fqi_dst = (uint32_t *)d; fqi_total = nsec; fqi_done = 0; fqi_err = 0; fqi_parked = 0; fqi_wpos = 0;
    const bool dma = g_fifoirq == 2;
    if (fq_open && fq_ring) fq_close();
    if (dma) fq_desc_build(d, nsec * 512u);
    if (fq_open && fq_dma != dma) fq_close();
    if (dma && (!fq_open || fq_next != sec)) {
        fq_close();
        sd.card()->syncDevice();
        fq_wml0 = USDHC1_WTMK_LVL; fq_sten0 = USDHC1_INT_STATUS_EN;
        USDHC1_DS_ADDR = (uint32_t)rq_canary;
        USDHC1_INT_STATUS = 0xFFFFFFFFu;
        USDHC1_INT_STATUS_EN = fq_sten0 | FX_TC;
        attachInterruptVector(IRQ_SDHC1, fqd_isr);
        NVIC_SET_PRIORITY(IRQ_SDHC1, 6 * 16);
        NVIC_ENABLE_IRQ(IRQ_SDHC1);
        USDHC1_INT_SIGNAL_EN = FX_TC | FX_ERR;
        fq_open = true; fq_dma = true; fq_opens++;
        if (!sd_cmd18_dma(sec, fq_desc)) fqi_err = 0x20000000u;
    } else if (dma) {                                     /* parked after the previous read: its table, then go on */
        noInterrupts();
        USDHC1_ADMA_SYS_ADDR = (uint32_t)fq_desc;
        USDHC1_PROT_CTRL &= ~FX_SABGREQ;
        USDHC1_PROT_CTRL |= FX_CREQ;
        USDHC1_PROT_CTRL |= FX_SABGREQ;
        interrupts();
    } else if (!fq_open || fq_next != sec) {
        fq_close();
        sd.card()->syncDevice();                          /* SdFat's own open transfer, if any */
        fq_wml0 = USDHC1_WTMK_LVL; fq_sten0 = USDHC1_INT_STATUS_EN;
        USDHC1_WTMK_LVL = (fq_wml0 & ~0xFFu) | fq_wml;
        USDHC1_INT_STATUS_EN = fq_sten0 | FX_BRR | FX_TC;
        USDHC1_INT_STATUS = FX_BRR | FX_TC;
        attachInterruptVector(IRQ_SDHC1, fq_isr);         /* every sd.begin re-attaches SdFat's handler */
        NVIC_SET_PRIORITY(IRQ_SDHC1, 6 * 16);
        NVIC_ENABLE_IRQ(IRQ_SDHC1);
        USDHC1_INT_SIGNAL_EN = FX_BRR | FX_TC | FX_ERR;
        fq_open = true; fq_opens++;
        if (!fx_card()->readStart(sec)) { fqi_err = 0x20000000u; }
    } else {                                              /* parked right after the previous block: go on */
        noInterrupts();
        USDHC1_PROT_CTRL &= ~FX_SABGREQ;
        USDHC1_PROT_CTRL |= FX_CREQ;
        USDHC1_PROT_CTRL |= FX_SABGREQ;
        interrupts();
    }
    fq_next = sec + nsec;
    uint32_t last = 0, t = micros();
    while (!fqi_err && !(fqi_done == nsec && fqi_parked)) {
        if (work && fqi_done < nsec) { if (!work(ctx)) work = 0; continue; }
        if (fqi_done != last) { last = fqi_done; t = micros(); }
        else if (micros() - t > 200000u) { fqi_err = 0x40000000u; break; }
    }
    if (fqi_err) {
        say("    fifoirq: read of %lu sectors at %lu stopped after %lu (0x%08lX, PRES_STATE 0x%08lX); back to the file layer",
            (unsigned long)nsec, (unsigned long)sec, (unsigned long)fqi_done, (unsigned long)fqi_err, (unsigned long)USDHC1_PRES_STATE);
        fq_close();
        fq_tail_sec = 0xFFFFFFFFu;
        return -1;
    }
    memcpy(fq_tail, d + (nsec - 1) * 512u, 512);
    fq_tail_sec = sec + nsec - 1;
    return 0;
}

/* after each pass with ::fifoirq on: transfers opened (card re-addressed) and interrupts taken in it */
FLASHMEM __attribute__((noinline)) static void fq_report(const char *what)
{
    static uint32_t o0, i0;
    if (g_fifoirq) say("CARD %s fifoirq opens=%lu interrupts=%lu", what, (unsigned long)(fq_opens - o0), (unsigned long)(fqi_irqs - i0));
    o0 = fq_opens; i0 = fqi_irqs;
}

/* ::fifoirq: the whole sectors around a pipeline read (the core's room for them, tl_plat.h) by fq_read; false
 * = read it the usual way (not FIFO, not contiguous, past the file, or a failure -- which turns ::fifoirq off) */
FLASHMEM __attribute__((noinline)) static bool fq_try(uint64_t off, void *dst, uint32_t n, int (*work)(void *), void *ctx)
{
    if (!mf_contig) return false;
    const uint32_t pre = (uint32_t)(off & 511u);
    const uint64_t a = off - pre;
    uint8_t *d = (uint8_t *)dst - pre;
    const uint32_t len = (pre + n + 511u) & ~511u;
    if (((uintptr_t)d & 3u) || a + len > ((mf_size + 511u) & ~511ull)) return false;
    if (g_fifoirq == 2 && ((uintptr_t)d < 0x20000000u || (uintptr_t)d + len > 0x20080000u)) return false;  /* DMA: DTCM only */
    if ((g_fifoirq == 3 ? rq_read(a, d, len, work, ctx) : fq_read(a, d, len, work, ctx)) == 0) return true;
    g_fifoirq = 0;
    say("    fifoirq OFF; the card restarted, this block read through the file layer");
    if (!sdio_switch(false)) halt("the card did not restart; power-cycle the Teensy (unplug USB for 2 s)");
    return false;
}

/* A pipeline read (tl_plat.h). In DMA mode with ::align 1 it reads the whole sectors around the block into
 * the room the core leaves for them: one CMD18 for the block. Unaligned, SdFat splits it into a head sector
 * and a tail sector through its cache and a middle by DMA -- two or three card commands, each with the card's
 * own start-up time. FIFO mode keeps one transfer open across reads, so there it reads exactly the block
 * (whole sectors would re-read each boundary sector and restart the transfer). */
int plat_sd_read_overlap(uint64_t off, void *dst, uint32_t n, int (*work)(void *), void *ctx)
{
    poll_stop();                             /* before the work is armed: Serial.available() calls yield() */
    if (g_abort) return -1;
    if (!g_dma && g_fifoirq && fq_try(off, dst, n, work, ctx)) return 0;
    uint64_t a = off;
    uint8_t *d = (uint8_t *)dst;
    uint32_t len = n;
    if (g_dma && g_align) {
        const uint32_t pre = (uint32_t)(off & 511u);
        a -= pre;
        d -= pre;
        len = (pre + n + 511u) & ~511u;
    }
    if (work && g_dma && g_overlap) { g_yctx = ctx; g_ywork = work; }
    /* ::sdpath adma (v9b): whole sectors of the contiguous model file straight through the card object with an
     * ADMA2 descriptor table for this very buffer -- no file layer, no cluster splitting, one CMD18 -- and the
     * core's rows run in SdFat's wait for it, exactly as with simple DMA. The pipeline buffers are DTCM. */
    if (g_sdpath == 1 && g_dma && mf_contig && (a % 512u) == 0 && (len % 512u) == 0 && len <= 8u * 32768u &&
        ((uintptr_t)d % 4u) == 0 && a + len <= ((mf_size + 511u) & ~511ull)) {
        adma_arm(d, len);
        const bool ok = sd.card()->readSectors((uint32_t)(mf_sector0 + a / 512u), d, len / 512u);
        adma_disarm();
        g_ywork = 0;
        if (!ok) { say("    ADMA2 read failed at %llu (+%lu): SdFat error 0x%02X", (unsigned long long)a, (unsigned long)len, (unsigned)sd.sdErrorCode()); return -1; }
        return 0;
    }
    const int r = mf_read_at(a, d, len, (uint32_t)(off - a) + n);   /* the file may end inside the last sector */
    g_ywork = 0;
    return r;
}

int plat_sd_read(uint64_t off, void *dst, uint32_t n)
{
    poll_stop();
    if (g_abort) return -1;
    return mf_read_at(off, dst, n, n);
}

/* n bytes at off into dst; succeeds when at least `need` of them arrived */
/* A card read above SdFat's clock that fails (the controller checks every block's CRC16, so a marginal clock
 * shows up as a failed read, not as wrong bytes) drops the card back to SdFat's 49.5 MHz for good, restarts
 * it, and reads again. */
static int mf_read_once(uint64_t off, void *dst, uint32_t n, uint32_t need);
static int mf_read_at(uint64_t off, void *dst, uint32_t n, uint32_t need)
{
    if (fq_open) fq_close();                 /* the file layer needs the card to itself */
    const int r = mf_read_once(off, dst, n, need);
    if (!r || !g_sddvs) return r;
    say("    card read failed at %lu kHz: back to SdFat's clock, card restarted, read again", sd_clk_now());
    g_sddvs = 0;
    if (!sdio_switch(g_dma)) return -1;
    return mf_read_once(off, dst, n, need);
}
static int mf_read_once(uint64_t off, void *dst, uint32_t n, uint32_t need)
{
    if (mf_contig) {
        if (!mf.seekSet(off)) return -1;
        return (mf.read(dst, n) >= (int)need) ? 0 : -1;
    }
    int h = -1;
    for (int i = 0; i < MF_POOL; i++)                      /* nearest handle at or below off: a forward seek */
        if (mfp[i] && mfp_pos[i] <= off && (h < 0 || mfp_pos[i] > mfp_pos[h])) h = i;
    if (h < 0)                                            /* none below: the least recently used one */
        for (int i = 0; i < MF_POOL; i++)
            if (mfp[i] && (h < 0 || mfp_used[i] < mfp_used[h])) h = i;
    if (h < 0) return -1;
    if (!mfp[h].seekSet(off)) return -1;
    const int got = mfp[h].read(dst, n);
    mfp_pos[h] = off + (uint64_t)(got > 0 ? got : 0);
    mfp_used[h] = ++mfp_tick;
    return got >= (int)need ? 0 : -1;
}

/* An extended ACMD41 wait was tried here on 2026-09-27 and REMOVED: its raw command path read a stale
 * response register (CMD8 'answer' 0x00000120 was an earlier CMD55's R1 status), so its result proved
 * nothing. SdFat's own eight attempts are the evidence: CMD0 and CMD8 answer, ACMD41 never reports ready
 * -- the card is hung, and on a Teensy 4.1 only cutting its power (USB) clears that. */
uint64_t plat_sd_size(void) { return mf_size; }
/* THE CHIPS ARE OFFERED AS THEY ARE (tl_plat.h, v9): nuse independent banks, fastest first, never one flat
 * memory. Selecting a chip is a bus reconfiguration and a chip reset (apply: two 5 us waits, a 2 ms wait and a
 * 50 us wait), so it is counted and timed; the core's per-layer layout exists to make it rare. */
int      plat_ps_banks(void) { return nuse; }
uint32_t plat_ps_bank_bytes(int b) { return (b >= 0 && b < nuse) ? BANKSZ : 0; }
static uint32_t ps_switches;
static uint64_t ps_switch_us;
static inline int ps_bank(int bi)
{
    if (bi < 0 || bi >= nuse) return -1;
    if (bi != cur_bank) {
        const uint32_t t0 = micros();
        apply(use[bi]); cur_bank = bi;
        ps_switch_us += micros() - t0;
        ps_switches++;
    }
    return bi;
}
/* A WRITE CHECKS ITSELF; A READ IS CHECKED BY THE CORE.
 *
 * A write is read back and compared, and re-done until it reads back right. A read is ONE transfer: the core
 * keeps a checksum beside every cache row and re-reads a row that fails it (tl_core.c cache_read), so the
 * double read v5-v8 did here is gone -- half the PSRAM read traffic for the same detection. Every write
 * correction is counted and the first few are logged with their place, so a marginal bank shows up as numbers
 * in the log instead of as a wrong word the model trips over later.
 *
 * What neither can catch is a read that is wrong the SAME way every time; that is what MARGIN is for. */
static uint8_t  vchk[BLK] __attribute__((aligned(32)));
static uint32_t ps_fix_r, ps_fix_w, ps_bad, ps_events;   /* ps_fix_r: the core's row re-reads, added per pass */

static void ps_event(const char *what, int b, uint32_t off, uint32_t n, uint32_t nbytes)
{
    if (ps_events++ < 16)
        say("    PSRAM self-check: %s on bank %d (%s) at %lu (+%lu), %lu byte(s) differed", what, b, use[b].name,
            (unsigned long)off, (unsigned long)n, (unsigned long)nbytes);
}

static int ps_write_chunk(int b, uint32_t off, const uint8_t *s, uint32_t k)   /* k <= BLK */
{
    for (int attempt = 0; attempt < 4; attempt++) {
        do_write(off, s, k);
        do_read(off, vchk, k);
        if (!memcmp(s, vchk, k)) {
            if (attempt) { ps_fix_w++; ps_event("write re-done", b, off, k, (uint32_t)attempt); }
            return 0;
        }
    }
    ps_bad++;
    ps_event("write never read back right", b, off, k, 4);
    return -1;
}

int plat_ps_read(int b, uint32_t off, void *dst, uint32_t n)
{
    if ((uint64_t)off + n > BANKSZ || ps_bank(b) < 0) return -1;
    uint8_t *d = (uint8_t *)dst;
    while (n) {
        const uint32_t k = n < BLK ? n : BLK;
        do_read(off, d, k);
        off += k; d += k; n -= k;
    }
    return 0;
}
int plat_ps_write(int b, uint32_t off, const void *src, uint32_t n)
{
    if ((uint64_t)off + n > BANKSZ || ps_bank(b) < 0) return -1;
    const uint8_t *s = (const uint8_t *)src;
    while (n) {
        const uint32_t k = n < BLK ? n : BLK;
        if (ps_write_chunk(b, off, s, k)) return -1;
        off += k; s += k; n -= k;
    }
    return 0;
}
double plat_now(void)
{
    static uint32_t last;
    static uint64_t hi;
    const uint32_t m = micros();
    if (m < last) hi += 1ull << 32;
    last = m;
    return (double)(hi + m) * 1e-6;
}
void plat_log(const char *fmt, ...)
{
    char b[240];
    va_list ap;
    va_start(ap, fmt);
    vsnprintf(b, sizeof b, fmt, ap);
    va_end(ap);
    Serial.println(b);
}
void plat_emit(const char *s, int n) { Serial.write((const uint8_t *)s, (size_t)n); }

/* ---------------------------------------------------------------------------------------------
 *  the run, and what a host can send (one line each, USB serial)
 *
 *    I              identity: "I bench-one psram_llm v9 ..." -- tools/bench_run.py asks this before flashing
 *    ::gen N        tokens to generate after the prompt, 1..512 (default 16)
 *    ::bench        component benchmarks: the card at three read sizes and at random, the M7 kernels on
 *                   real Q4_K and Q6_K rows held in RAM, raw and self-checked PSRAM on a free bank
 *    ::stats        banks in use, PSRAM self-check counters, temperature
 *    ::hold         nothing -- a host sends it during the boot window so the default prompt does not run
 *    ::prefill 0|1  prompt through tl_prefill (default 1) or one token per pass, for A/B runs on one board
 *    ::multi K      the next K prompt lines (1..8) are answered TOGETHER: every pass over the weights feeds
 *                   all unfinished prompts (tl_multi_pass), ::gen tokens each; "::multi 0" cancels
 *    ::share 0|1    in a ::multi, a prompt that opens with the same tokens as an earlier one (every chat
 *                   prompt's system turn) copies those cache rows instead of computing them (default 1)
 *    ::sdio fifo|dma  restart the card in FIFO_SDIO (v6's way) or DMA_SDIO (the default from v7)
 *    ::overlap 0|1  DMA only: the arithmetic runs while the card reads (default 1)
 *    ::align 0|1    DMA only: a pipeline read takes the whole sectors around its block, one command (default 1)
 *    ::slice N      rows per yield(): 0 = one row (default), N = rows for N us per call
 *    ::sdsweep      the DMA path at every read watermark / burst length / burst enable, each 2 MB checked
 *                   byte for byte against FIFO; keeps the fastest that reads right ("SWEEP ..." lines)
 *    ::sdcfg W B L  DMA read watermark W words, burst B words, burst enables L; "::sdcfg 0" = SdFat's own
 *    ::sdregs       the SD controller's registers
 *    ::sdclksweep   the card clock above SdFat's 49.5 MHz (66, 99), 8 MB checked byte for byte at each;
 *                   keeps the fastest that reads right ("CLKSWEEP ..." lines)
 *    ::sdclk N      card clock = 198 MHz / N (2..16); "::sdclk 0" = SdFat's own
 *    ::admamin N    a pass with N or more positions reads the card by ADMA2 with the arithmetic under the read,
 *                   a smaller one by FIFO (default 7 with ::fifoirq; 3 before 2026-10-16: docs/56); 0 = no switching
 *    ::sdpath file|adma  a pipeline read goes through SdFat's file layer (default) or, in DMA mode, straight to
 *                   the card object as whole sectors with an ADMA2 descriptor table for the core's buffer
 *    ::sdadma       the card by ADMA2 (descriptor DMA) at four read sizes, 2 MB each checked byte for byte
 *                   against FIFO and against SdFat's simple DMA ("ADMA ..." lines)
 *                   (every one of these four gives the same step lines; they move only the time)
 *    ::sdfifo       the FIFO read with arithmetic (a timed spin) between each block's request and its drain,
 *                   with and without Stop At Block Gap; then 48-block bursts with pauses between, reads alone
 *                   timed; 2 MB each checked byte for byte ("FIFOX ..." lines)
 *    ::sdtrace      the cycle counter at each step of the FIFO block handshake, polled and interrupt-fed
 *    ::sdfifo adma|ring|cycle  one open ADMA2 transfer per read; the ring; the ring opened and closed as a pass
 *                   does, checked against the file layer ("FIFOX ...")
 *    ::fifoirq N    how a FIFO-path pipeline read reaches the card: 0 SdFat's file layer; 1 one open transfer fed
 *                   by the card's interrupt (CPU drains the port); 2 the same copied by ADMA2 per read; 3 (default)
 *                   the card streaming by ADMA2 into a ring that prefetches, reads copied out; 16/32/64/128 =
 *                   mode 1 at that read watermark. Same step lines, only the time moves
 *    ::kbench       the batched Q4_K kernel, cycles per weight per vector at 2..8 vectors ("KBENCH ...")
 *    ::ffngroup G   a batched pass computes gate/up G rows at a time (32..256; 32 = the pre-2026-10-16 order)
 *    ::reuse 0|1    a prompt that starts with the tokens the attention cache holds is fed from where it differs
 *                   (default 1; "REUSE m=..."); the answer is the same, the skipped positions print no step lines
 *    ::lookup K [N] after the prompt, each pass also checks up to K tokens guessed from the context (the
 *                   tokens that followed the last 4..N tokens' most recent earlier occurrence, N default 1); 0 = off.
 *                   Same step lines as without; fewer passes when the guesses are right ("LOOKUP ...")
 *    anything else  a prompt. \n \t \\ are unescaped, so code and chat templates fit on one line
 *
 *  Machine-readable lines for tests/psram_llm/suite.py: "step ...", "S<k> step ..." (prompt k of a ::multi),
 *  "STAGES ...", "RUN ...", "BENCH ...".
 * ------------------------------------------------------------------------------------------ */
#define MAX_GEN 512
static int      g_gen = 16;
/* The card test and the benchmarks borrow the core's arena between passes (tl_scratch) rather than keep
 * their own 119 KB of OCRAM, which the batched prompt path needs. */
#define SDBUF_BYTES (64u * 1024u)
static uint8_t  *sdbuf;
static float    *bx;
static int8_t   *bxq;
static uint32_t *bxw;                        /* the activation vector pre-widened (BENCH path widened) */
FLASHMEM static bool scratch_init(void)
{
    uint32_t n = 0;
    uint8_t *s = (uint8_t *)tl_scratch(&n);
    if (n < SDBUF_BYTES + 11008u * 4u + 11008u + 11008u * 2u) return false;
    sdbuf = s;
    bx  = (float *)(s + SDBUF_BYTES);
    bxq = (int8_t *)(s + SDBUF_BYTES + 11008u * 4u);
    bxw = (uint32_t *)(s + SDBUF_BYTES + 11008u * 4u + 11008u);
    return true;
}
static float    bxs[11008 / 32 + 1];
static int32_t  bxsum[11008 / 32 + 1];
static tl_info_t info;
static bool ready;

static void halt(const char *why)
{
    say("\n  HALTED: %s", why);
    ready = false;
}

static void esc(const char *s, int n, char *o, int omax)
{
    int k = 0;
    for (int i = 0; i < n && k < omax - 5; i++) {
        const unsigned char c = (unsigned char)s[i];
        if (c == '"' || c == '\\') { o[k++] = '\\'; o[k++] = (char)c; }
        else if (c >= 0x20 && c < 0x7F) o[k++] = (char)c;
        else k += snprintf(o + k, (size_t)(omax - k), "\\x%02X", c);
    }
    o[k] = 0;
}

static void unescape(char *s)
{
    char *o = s;
    for (char *p = s; *p; p++) {
        if (*p == '\\' && p[1]) {
            p++;
            if (*p == 'n') *o++ = '\n';
            else if (*p == 't') *o++ = '\t';
            else if (*p == '\\') *o++ = '\\';
            else { *o++ = '\\'; *o++ = *p; }
        } else {
            *o++ = *p;
        }
    }
    *o = 0;
}

static bool read_line(char *out, int max, uint32_t wait_ms)
{
    int n = 0;
    const uint32_t t0 = millis();
    while (millis() - t0 < wait_ms) {
        while (Serial.available()) {
            const char ch = (char)Serial.read();
            if (ch == '\n' || ch == '\r') { if (n) { out[n] = 0; return true; } }
            else if (n < max - 1) out[n++] = ch;
        }
        delay(5);
    }
    out[n] = 0;
    return n > 0;
}

static int g_prefill = 1;                 /* ::prefill 0|1 -- the prompt through tl_prefill, or one token at a time */
static int g_lookup = 0;                  /* ::lookup K [N] -- guess up to K tokens a pass from the context (0: off) */
/* WHAT THE ATTENTION CACHE HOLDS (::reuse 0|1, default 1; 2026-10-16). A cache row depends only on the tokens up
 * to its own position (the same fact ::multi's shared openings rest on, proven by verify_pc.py), so when a new
 * prompt starts with the tokens the cache was computed from, those rows are already exactly right: the prompt is
 * fed from the first position that differs. Every chat prompt opens with the same 24-token system turn, and a
 * conversation's next prompt contains the whole conversation so far. g_ctx[0..g_kv_len) are the tokens of the
 * rows known good -- accepted positions only; rows a rejected guess wrote lie beyond it. Anything else that
 * writes the cache (a chip fault's re-layout, ::multi, the benchmarks) forgets it. Also the lookup context. */
static int g_reuse = 1;
static int g_promptlogits = 0;            /* ::promptlogits 1: scores at every prompt position (the full proof); 0: last only */
DMAMEM static int32_t g_ctx[1024 + 512 + 8];
static int g_kv_len;
FLASHMEM static uint32_t stack_unused(void);   /* THE STACK'S HIGH-WATER MARK, below */
static int g_lookup_nmin = 1;             /* ... matching the last 4 down to N tokens (2026-10-16: 4..1, k 3 is best at the
                                             interrupt-fed pass costs, alpha_sim.py) */

/* One position's line, exactly the format tests/tl_host.c and tests/tl_ref.c print, and the text so far. */
/* WHICH WAY THE CARD IS READ IS DECIDED PER PASS (v9c). Measured 2026-09-28 (docs/56): a batched pass of 5
 * positions took 208.6 s by FIFO and 143.0 s by ADMA2 with the arithmetic run under the read; a one-token pass
 * 104.8 s by FIFO and 137.5 s by ADMA2, because 29 s of arithmetic cannot hide 131 s of card. So a pass with
 * g_adma_min or more positions reads the card by ADMA2 with the overlap, a smaller one by FIFO; the switch
 * is a card restart (about 2 s), made only when the answer changes -- once per prompt, a few per group. */
static int g_adma_min = 8;                   /* ::admamin N; 0 = never switch automatically. 3 until 2026-10-16; with the
                                                ring (::fifoirq 3) every pass to 7 positions is cheaper by the ring, 8 by ADMA2 */
static void card_for_slots(int slots)
{
    if (!mf_contig || g_adma_min <= 0) return;
    const bool want = slots >= g_adma_min;
    if (want != g_dma) {
        say("  card: %d position%s in this pass -> %s", slots, slots == 1 ? "" : "s",
            want ? "ADMA2 with the arithmetic under the read" : "FIFO");
        if (!sdio_switch(want)) { halt("the card did not restart; power-cycle the Teensy (unplug USB for 2 s)"); return; }
        say("SDIO %s", want ? "dma" : "fifo");
    }
    if (g_sdpath != (want ? 1 : 0)) { g_sdpath = want ? 1 : 0; say("SDPATH %s", want ? "adma" : "file"); }
    if (want) { g_overlap = 1; g_align = 1; }
}

/* After a chip fault a prompt is re-run from position 0 (run_prompt, run_multi below): the step lines that
 * were already printed come out again prefixed "R ", so the log holds both copies to compare. */
static int g_replay_to, g_run_steps;                 /* one prompt: steps printed before the fault / so far */
static int g_multi_replay[8], g_multi_printed[8];    /* MULTI_MAX prompts: positions printed, per sequence */

FLASHMEM static void emit_step(const char *prompt, int n, int step, int32_t fed, int32_t t1, float l1, int32_t t2, float l2,
                      char *gen, int *gl, int genmax)
{
    static char txt[256], e[1024];
    const int k = tl_decode(t1, txt, (int)sizeof txt - 1);
    esc(txt, k, e, (int)sizeof e);
    char line[1400];
    snprintf(line, sizeof line, "%sstep %d pos %d fed %ld -> top1 %ld %.9g top2 %ld %.9g text \"%s\"",
             step < g_replay_to ? "R " : "", step, step, (long)fed, (long)t1, (double)l1, (long)t2, (double)l2, e);
    if (step + 1 > g_run_steps) g_run_steps = step + 1;
    Serial.println(line);
    if (step >= n - 1 && *gl + k < genmax) { memcpy(gen + *gl, txt, (size_t)k); *gl += k; }
    if (step >= n - 1) {
        Serial.print("  >> ");
        Serial.write((const uint8_t *)prompt, strlen(prompt));
        Serial.write((const uint8_t *)gen, (size_t)*gl);
        Serial.println();
    }
}

FLASHMEM static void pass_lines(const char *what, const tl_stats_t &st, float tc)
{
    static uint32_t sw_prev;
    static uint64_t swus_prev;
    say("    %s: %.1f s: SD %.1f MB in %.1f s (%.2f MB/s), PSRAM %.0f KB read %.1f KB written in %.2f s, compute %.1f s;"
        " PSRAM self-check so far: %lu rows re-read, %lu writes re-done, %lu unresolved; chip selects this pass %lu (%.3f s)", what,
        st.t_total, st.sd_bytes / 1048576.0, st.t_sd, st.sd_bytes / 1048576.0 / (st.t_sd > 0 ? st.t_sd : 1),
        st.ps_read / 1024.0, st.ps_written / 1024.0, st.t_ps, st.t_compute,
        (unsigned long)ps_fix_r, (unsigned long)ps_fix_w, (unsigned long)ps_bad,
        (unsigned long)(ps_switches - sw_prev), (ps_switch_us - swus_prev) / 1e6);
    sw_prev = ps_switches; swus_prev = ps_switch_us;
    say("STAGES %s embed=%.3f qkv=%.2f att=%.3f wo=%.2f ffn=%.2f head=%.2f hidden=%.2f temp_c=%.1f",
        what, st.t_embed, st.t_qkv, st.t_att, st.t_wo, st.t_ffn, st.t_head, st.t_hidden, tc);
    fq_report(what);
}

FLASHMEM static bool run_prompt_once(const char *prompt)
{
    g_abort = false;                      /* a ::stop that arrived while idle is not a stop for this run */
    static int32_t ids[1024];
    const uint32_t sw0 = ps_switches;
    const uint64_t swus0 = ps_switch_us;
    const int n = tl_encode(prompt, ids, 1024);
    if (n <= 0) { say("  prompt did not encode"); say("RUN error=encode"); return true; }
    if (n + g_gen > info.max_seq) { say("  prompt too long for the %d-position cache", info.max_seq); say("RUN error=too_long"); return true; }
    {
        static char ep[4096];
        esc(prompt, (int)strlen(prompt), ep, (int)sizeof ep);
        say("\n  prompt: \"%s\"  (%d tokens, generating %d, prompt %s)", ep, n, g_gen,
            g_prefill ? "batched through tl_prefill" : "one token per pass");
    }
    Serial.print("prompt ids:");
    for (int i = 0; i < n; i++) { Serial.print(' '); Serial.print((long)ids[i]); }
    Serial.println();
    int m0 = 0;                                              /* positions the cache already holds for these tokens */
    if (g_reuse && g_prefill) while (m0 < g_kv_len && m0 < n - 1 && g_ctx[m0] == ids[m0]) m0++;
    if (m0) say("REUSE m=%d (the attention cache already holds positions 0..%d for these same tokens; the prompt is fed from %d)", m0, m0 - 1, m0);
    g_kv_len = m0;                                           /* rows from m0 on are about to be rewritten */

    static char gen[8192];
    int gl = 0, passes = 0, step0 = 0;
    int32_t next = 0;
    double total = 0, t_sd = 0, t_ps = 0, t_cmp = 0, t_hid = 0, t_prompt = 0;
    uint64_t sd_total = 0;
    float tmax = -1000.0f;
    bool ended = false;

    if (g_prefill) {
        static int32_t a1[64], a2[64];
        static float   b1[64], b2[64];
        const int B = tl_batch() < 64 ? tl_batch() : 64;
        for (int p0 = m0; p0 < n; p0 += B) {
            const int k = (n - p0) < B ? (n - p0) : B;
            card_for_slots(k);
            tl_stats_reset();
            /* the output head (a tenth of the weights) only at the prompt's last position unless ::promptlogits 1:
             * no other prompt position's scores are used (tl_set_logits_from; PC-proven, verify_pc.py stage 2d) */
            if (!g_promptlogits) tl_set_logits_from(p0 + k == n ? k - 1 : k);
            const int pf = tl_prefill(ids + p0, k, p0, a1, b1, a2, b2);
            tl_set_logits_from(0);
            if (pf) {
                if (g_abort) { say("  STOPPED in the prompt by ::stop, between two card reads"); say("RUN error=stopped step=%d", p0); g_abort = false; return true; }
                say("  prefill failed at positions %d..%d: %s", p0, p0 + k - 1, tl_last_error());
                if (tl_fault_bank() >= 0) return false;
                say("RUN error=prefill step=%d", p0);
                return true;
            }
            passes++;
            memcpy(g_ctx + p0, ids + p0, (size_t)k * sizeof(int32_t));
            g_kv_len = p0 + k;
            tl_stats_t st;
            tl_stats(&st);
            ps_fix_r += st.ps_rows_reread; ps_bad += st.ps_rows_bad;
            total += st.t_total; t_sd += st.t_sd; t_ps += st.t_ps; t_cmp += st.t_compute; t_hid += st.t_hidden; t_prompt += st.t_total;
            sd_total += st.sd_bytes;
            const float tc = tempmonGetTemp();
            if (tc > tmax) tmax = tc;
            for (int j = 0; j < k; j++)                       /* a position whose scores were not computed prints nothing */
                if (a1[j] >= 0) emit_step(prompt, n, p0 + j, ids[p0 + j], a1[j], b1[j], a2[j], b2[j], gen, &gl, (int)sizeof gen);
            char what[48];
            snprintf(what, sizeof what, "prefill=%d..%d", p0, p0 + k - 1);
            pass_lines(what, st, tc);
            if (p0 + k == n) next = a1[k - 1];
        }
        step0 = n;
        if (next == info.eos) ended = true;
    }
    /* ::lookup K (2026-10-16): speculative decoding from the context. Each pass feeds the pending token plus up to
     * K guesses -- the tokens that followed the most recent earlier occurrence of the last 4 down to N tokens -- and
     * keeps the guesses only as far as the model's own greedy choice agrees, so every step line is the line plain
     * decoding prints (tl_prefill's outputs are tl_forward's; tests/tl_host.c TL_LOOKUP, docs/54). Rows a
     * rejected guess wrote into the cache lie beyond the accepted position: the next pass writes those rows before
     * any position reads them. Simulated on the PC reference (alpha_sim.py, 63 answers) with the board's measured
     * pass costs: 4..2 tokens matched, 6 guesses -> 1.19x at the FIFO/ADMA2 costs; 4..1 and 3 guesses -> 1.31x
     * (24-token answers 1.17x) at ::fifoirq's, where 2..4 positions cost what one does. */
    if (g_lookup > 0 && g_prefill && !ended && step0 < n + g_gen) {
        int32_t *const lctx = g_ctx;                                    /* holds the prompt already (recorded above) */
        DMAMEM static int32_t lo1[64], lo2[64], lfeed[64], ldraft[64];  /* OCRAM: RAM1 is the stack's */
        DMAMEM static float   lf1[64], lf2[64];
        int kmax = g_lookup < tl_batch() - 1 ? g_lookup : tl_batch() - 1;
        if (kmax > 63) kmax = 63;
        int drafted = 0, accepted = 0, lpasses = 0;
        int pos = step0;
        while (!ended && pos < n + g_gen) {
            lctx[pos] = next;
            int lim = n + g_gen - pos - 1;
            if (lim > kmax) lim = kmax;
            int k = 0;
            for (int m = 4; m >= g_lookup_nmin && !k && lim > 0; m--) {   /* the most recent earlier match of the last m */
                if (pos + 1 < m + 1) continue;
                const int32_t *suf = lctx + pos + 1 - m;
                for (int s = pos - m; s >= 0 && !k; s--) {
                    if (memcmp(lctx + s, suf, (size_t)m * sizeof(int32_t))) continue;
                    while (k < lim && s + m + k <= pos) { ldraft[k] = lctx[s + m + k]; k++; }
                }
            }
            lfeed[0] = next;
            for (int i = 0; i < k; i++) lfeed[i + 1] = ldraft[i];
            card_for_slots(k + 1);
            tl_stats_reset();
            /* no guess: the ordinary one-position pass (104.8 s measured; tl_prefill over 1 position took 121.1 s,
             * the batched path's read order -- same outputs either way) */
            if (k ? tl_prefill(lfeed, k + 1, pos, lo1, lf1, lo2, lf2)
                  : tl_forward(lfeed[0], pos, lo1, lf1, lo2, lf2)) {
                if (g_abort) { say("  STOPPED at step %d by ::stop, between two card reads", pos); say("RUN error=stopped step=%d", pos); g_abort = false; return true; }
                say("  lookup pass failed at step %d: %s", pos, tl_last_error());
                if (tl_fault_bank() >= 0) return false;
                say("RUN error=forward step=%d", pos);
                return true;
            }
            passes++; lpasses++; drafted += k;
            tl_stats_t st;
            tl_stats(&st);
            ps_fix_r += st.ps_rows_reread; ps_bad += st.ps_rows_bad;
            total += st.t_total; t_sd += st.t_sd; t_ps += st.t_ps; t_cmp += st.t_compute; t_hid += st.t_hidden;
            sd_total += st.sd_bytes;
            const float tc = tempmonGetTemp();
            if (tc > tmax) tmax = tc;
            emit_step(prompt, n, pos, lfeed[0], lo1[0], lf1[0], lo2[0], lf2[0], gen, &gl, (int)sizeof gen);
            if (lo1[0] == info.eos) ended = true;
            int j = 0;
            while (!ended && j < k && lo1[j] == ldraft[j]) {
                j++;
                emit_step(prompt, n, pos + j, lfeed[j], lo1[j], lf1[j], lo2[j], lf2[j], gen, &gl, (int)sizeof gen);
                if (lo1[j] == info.eos) ended = true;
            }
            accepted += j;
            for (int i = 0; i < j; i++) lctx[pos + 1 + i] = ldraft[i];
            g_kv_len = pos + j + 1;                                     /* rows pos..pos+j hold accepted tokens */
            char what[48];
            snprintf(what, sizeof what, "lookup=%d guessed=%d kept=%d", pos, k, j);
            pass_lines(what, st, tc);
            next = lo1[j];
            pos += j + 1;
        }
        say("LOOKUP k=%d passes=%d drafted=%d accepted=%d", kmax, lpasses, drafted, accepted);
        ended = true;                                                   /* the generation is done */
    }
    if (!ended && step0 < n + g_gen) card_for_slots(1);
    for (int step = step0; !ended && step < n + g_gen; step++) {
        const int32_t fed = step < n ? ids[step] : next;
        int32_t t1, t2;
        float l1, l2;
        tl_stats_reset();
        if (tl_forward(fed, step, &t1, &l1, &t2, &l2)) {
            if (g_abort) {
                say("  STOPPED at step %d by ::stop, between two card reads", step);
                say("RUN error=stopped step=%d", step);
                g_abort = false;
                return true;
            }
            say("  forward failed at step %d: %s", step, tl_last_error());
            if (tl_fault_bank() >= 0) return false;
            say("RUN error=forward step=%d", step);
            return true;
        }
        passes++;
        if (step < (int)(sizeof g_ctx / sizeof g_ctx[0])) { g_ctx[step] = fed; if (g_kv_len == step) g_kv_len = step + 1; }
        tl_stats_t st;
        tl_stats(&st);
        ps_fix_r += st.ps_rows_reread; ps_bad += st.ps_rows_bad;
        total += st.t_total; t_sd += st.t_sd; t_ps += st.t_ps; t_cmp += st.t_compute; t_hid += st.t_hidden;
        if (step < n) t_prompt += st.t_total;
        sd_total += st.sd_bytes;
        const float tc = tempmonGetTemp();
        if (tc > tmax) tmax = tc;
        emit_step(prompt, n, step, fed, t1, l1, t2, l2, gen, &gl, (int)sizeof gen);
        char what[24];
        snprintf(what, sizeof what, "step=%d", step);
        pass_lines(what, st, tc);
        next = t1;
        if (step >= n - 1 && t1 == info.eos) break;
    }
    gen[gl] = 0;
    static char ea[8192 * 2];
    esc(gen, gl, ea, (int)sizeof ea);
    say("\n  ANSWER: \"%s\"", ea);
    say("  %d passes over the weights in %.0f s (prompt %.0f s), %.1f s each; %.2f GB read from the card", passes, total,
        t_prompt, total / (passes ? passes : 1), sd_total / 1073741824.0);
    say("  PSRAM self-check over the whole run: %lu rows re-read, %lu writes re-done, %lu unresolved",
        (unsigned long)ps_fix_r, (unsigned long)ps_fix_w, (unsigned long)ps_bad);
    say("RUN n_prompt=%d n_gen=%d prefill=%d passes=%d total_s=%.1f prompt_s=%.1f per_pass_s=%.2f sd_gb=%.3f sd_mbs=%.2f"
        " sd_s=%.1f compute_s=%.1f hidden_s=%.1f ps_s=%.1f ps_fix_r=%lu ps_fix_w=%lu ps_bad=%lu ps_sw=%lu ps_sw_s=%.2f temp_max_c=%.1f",
        n, g_gen, g_prefill, passes, total, t_prompt, total / (passes ? passes : 1), sd_total / 1073741824.0,
        sd_total / 1048576.0 / (t_sd > 0 ? t_sd : 1), t_sd, t_cmp, t_hid, t_ps,
        (unsigned long)ps_fix_r, (unsigned long)ps_fix_w, (unsigned long)ps_bad,
        (unsigned long)(ps_switches - sw0), (ps_switch_us - swus0) / 1e6, tmax);
    say("STACK never_used %lu bytes (the deepest the stack has gone since boot leaves this much)", (unsigned long)stack_unused());
    say("  DONE. Type another prompt and press Enter.");
    return true;
}

/* A PSRAM chip that fails mid-run: the core retires it and moves its layers to spare slots on the others
 * (tl_bank_fault); the prompt is then re-run from position 0, which recomputes everything exactly. The step
 * lines already printed are printed again with an "R " prefix (suite.py counts only "step" lines; the R
 * lines are there to be compared with them in the log). Once per prompt: a second chip failing ends it. */
static void run_prompt(const char *prompt)
{
    g_replay_to = 0; g_run_steps = 0;
    if (run_prompt_once(prompt)) return;
    g_kv_len = 0;                                            /* the re-layout moves layers: nothing cached is kept */
    const int fb = tl_fault_bank();
    if (fb < 0) { say("RUN error=failed"); return; }
    if (tl_bank_fault(fb)) {
        say("  chip %s (bank %d) failed and cannot be replaced: %s", use[fb].name, fb, tl_last_error());
        say("RUN error=bank_fault bank=%d", fb);
        return;
    }
    say("  chip %s (bank %d) failed: retired; its layers are now on other chips; re-running the prompt from position 0",
        use[fb].name, fb);
    say("FAULT bank=%d chip=%s steps_printed=%d", fb, use[fb].name, g_run_steps);
    g_replay_to = g_run_steps; g_run_steps = 0;
    if (!run_prompt_once(prompt)) { say("  a second chip failed: %s", tl_last_error()); say("RUN error=bank_fault_again"); }
}

/* ::multi -- several prompts, one pass over the weights for all of them. Three quarters of a pass is the card
 * read, which one prompt or eight cost the same; each extra prompt adds only its arithmetic. */
#define MULTI_MAX 8
/* ONE POOL of token ids for a ::multi group (2026-10-16), each prompt's ids (prompt + answer + 1) after the last
 * one's. Was 8 x 1,024 (32 KB of OCRAM); the group can never need more than the cache's rows anyway -- the core
 * refuses a group whose prompts and answers exceed max_seq -- so the pool is TL_MAX_SEQ + one per prompt, 12 KB,
 * and the 20 KB went to the 30B's model table. */
#define MIDS_POOL (3072 + MULTI_MAX)
static int g_multi_want = 0, g_multi_n = 0, g_mids_used = 0;
DMAMEM static int32_t mids[MIDS_POOL];
static tl_seq_t mseq[MULTI_MAX];

static void multi_emit(void *ctx, int s, int pos, int32_t fed, int32_t t1, float l1, int32_t t2, float l2)
{
    (void)ctx;
    static char txt[256], e[1024], line[1400];
    const int k = tl_decode(t1, txt, (int)sizeof txt - 1);
    esc(txt, k, e, (int)sizeof e);
    snprintf(line, sizeof line, "%sS%d step %d pos %d fed %ld -> top1 %ld %.9g top2 %ld %.9g text \"%s\"",
             pos < g_multi_replay[s] ? "R " : "", s, pos, pos, (long)fed, (long)t1, (double)l1, (long)t2, (double)l2, e);
    if (pos + 1 > g_multi_printed[s]) g_multi_printed[s] = pos + 1;
    Serial.println(line);
}

static bool run_multi_once(int ns)
{
    g_abort = false;
    const uint32_t sw0 = ps_switches;
    const uint64_t swus0 = ps_switch_us;
    if (tl_multi_begin(mseq, ns)) {
        say("  multi: %s", tl_last_error());
        if (tl_fault_bank() >= 0) return false;
        say("RUN error=multi");
        return true;
    }
    say("\n  answering %d prompts together, %d tokens each", ns, g_gen);
    int shared = 0;
    for (int i = 0; i < ns; i++)
        if (mseq[i].donor >= 0) {
            say("  S%d copies its first %d positions from S%d (the same opening tokens)", i, mseq[i].share, mseq[i].donor);
            shared += mseq[i].share;
        }
    int passes = 0, fed = 0, r;
    double total = 0, t_sd = 0, t_ps = 0, t_cmp = 0, t_hid = 0;
    uint64_t sd_total = 0;
    float tmax = -1000.0f;
    for (;;) {
        {
            int live = 0;
            for (int i = 0; i < ns; i++) live += !mseq[i].done;
            if (live) card_for_slots(live < tl_batch() ? live : tl_batch());
        }
        tl_stats_reset();
        r = tl_multi_pass(mseq, ns, multi_emit, NULL);
        if (r <= 0) break;
        passes++;
        fed += r;
        tl_stats_t st;
        tl_stats(&st);
        ps_fix_r += st.ps_rows_reread; ps_bad += st.ps_rows_bad;
        total += st.t_total; t_sd += st.t_sd; t_ps += st.t_ps; t_cmp += st.t_compute; t_hid += st.t_hidden;
        sd_total += st.sd_bytes;
        const float tc = tempmonGetTemp();
        if (tc > tmax) tmax = tc;
        char what[40];
        snprintf(what, sizeof what, "multi pass=%d slots=%d", passes, r);
        pass_lines(what, st, tc);
    }
    if (r < 0) {
        if (g_abort) { say("  STOPPED at pass %d by ::stop, between two card reads", passes + 1); say("RUN error=stopped pass=%d", passes + 1); g_abort = false; return true; }
        say("  multi pass %d failed: %s", passes + 1, tl_last_error());
        if (tl_fault_bank() >= 0) return false;
        say("RUN error=multi pass=%d", passes + 1);
        return true;
    }
    int solo = 0;
    DMAMEM static char gen[4096], ea[8192];   /* OCRAM: RAM1 is the stack's */
    for (int i = 0; i < ns; i++) {
        solo += (mseq[i].n_prompt + tl_batch() - 1) / tl_batch() + (mseq[i].fed - mseq[i].n_prompt);
        int gl = 0;
        for (int j = mseq[i].n_prompt; j <= mseq[i].fed; j++)
            gl += tl_decode(mseq[i].ids[j], gen + gl, (int)sizeof gen - gl - 1);
        esc(gen, gl, ea, (int)sizeof ea);
        say("  ANSWER S%d: \"%s\"", i, ea);
    }
    say("  %d prompts, %d passes over the weights for %d positions in %.0f s, %.1f s per pass; one at a time they "
        "would take %d passes", ns, passes, fed, total, total / (passes ? passes : 1), solo);
    say("RUN multi=%d n_gen=%d passes=%d positions=%d shared=%d solo_passes=%d total_s=%.1f per_pass_s=%.2f sd_gb=%.3f"
        " sd_mbs=%.2f sd_s=%.1f compute_s=%.1f hidden_s=%.1f ps_s=%.1f ps_fix_r=%lu ps_fix_w=%lu ps_bad=%lu ps_sw=%lu ps_sw_s=%.2f temp_max_c=%.1f",
        ns, g_gen, passes, fed, shared, solo, total, total / (passes ? passes : 1), sd_total / 1073741824.0,
        sd_total / 1048576.0 / (t_sd > 0 ? t_sd : 1), t_sd, t_cmp, t_hid, t_ps,
        (unsigned long)ps_fix_r, (unsigned long)ps_fix_w, (unsigned long)ps_bad,
        (unsigned long)(ps_switches - sw0), (ps_switch_us - swus0) / 1e6, tmax);
    say("STACK never_used %lu bytes (the deepest the stack has gone since boot leaves this much)", (unsigned long)stack_unused());
    say("  DONE. Type another prompt and press Enter.");
    return true;
}

static void run_multi(void)
{
    g_kv_len = 0;
    tl_set_logits_from(0);                                   /* every sequence's every position is printed */                                            /* the sequences' rows overwrite the single prompt's */
    const int ns = g_multi_n;
    g_multi_n = 0;
    for (int i = 0; i < MULTI_MAX; i++) { g_multi_replay[i] = 0; g_multi_printed[i] = 0; }
    if (run_multi_once(ns)) return;
    const int fb = tl_fault_bank();
    if (fb < 0) { say("RUN error=failed"); return; }
    if (tl_bank_fault(fb)) {
        say("  chip %s (bank %d) failed and cannot be replaced: %s", use[fb].name, fb, tl_last_error());
        say("RUN error=bank_fault bank=%d", fb);
        return;
    }
    say("  chip %s (bank %d) failed: retired; its layers are now on other chips; re-running all %d prompts from position 0",
        use[fb].name, fb, ns);
    say("FAULT bank=%d chip=%s", fb, use[fb].name);
    for (int i = 0; i < ns; i++) { g_multi_replay[i] = g_multi_printed[i]; g_multi_printed[i] = 0; mseq[i].fed = 0; mseq[i].done = 0; }
    if (!run_multi_once(ns)) { say("  a second chip failed: %s", tl_last_error()); say("RUN error=bank_fault_again"); }
}

/* The M7 on real rows already in RAM: what the arithmetic costs once the card is out of the way. */
FLASHMEM static void bench_kernel(const char *label, int layer, int which)
{
    uint64_t off; uint32_t type, rows, cols, rb;
    if (tl_matrix(layer, which, &off, &type, &rows, &cols, &rb)) { say("BENCH kernel %s absent", label); return; }
    uint32_t nr = SDBUF_BYTES / rb;
    if (nr > rows) nr = rows;
    if (!nr || cols > 11008) { say("BENCH kernel %s does not fit", label); return; }
    /* sdbuf is the core's arena, in CACHED OCRAM, and SdFat's DMA does no cache maintenance: clean and drop the
     * lines first, so no stale line is read and no dirty one is written back over the card's bytes. (The
     * partial sectors SdFat copies by CPU end on 32-byte lines here: tensor offsets are 32-aligned.) */
    arm_dcache_flush_delete(sdbuf, nr * rb);
    if (plat_sd_read(off, sdbuf, nr * rb)) { say("BENCH kernel %s read failed", label); return; }
    uint32_t x = 0x2545F491u;
    for (uint32_t i = 0; i < cols; i++) { x = x * 1664525u + 1013904223u; bx[i] = ((int32_t)(x >> 8) - 8388608) / 8388608.0f; }
    gguf_quantize_act(bx, cols, bxq, bxs);
    gguf_act_sums(bxq, cols, bxsum);
    for (int path = 0; path < (type == GGML_Q4_K ? 2 : 1); path++) {
        uint32_t reps = 0;
        volatile float sink = 0;
        const uint32_t t0 = micros();
        do {
            for (uint32_t r = 0; r < nr; r++) {
                const uint8_t *p = sdbuf + (size_t)r * rb;
                sink += (type == GGML_Q4_K && path == 0) ? gguf_dot_q4k_presum(p, bxq, bxs, bxsum, cols)
                                                         : gguf_dot_q(type, p, bxq, bxs, cols);
            }
            reps++;
        } while (micros() - t0 < 1000000u);
        const float s = (micros() - t0) / 1e6f;
        say("BENCH kernel %s type %lu path %s rows %lu cols %lu mb_s %.2f mweights_s %.2f", label, (unsigned long)type,
            (type == GGML_Q4_K && path == 0) ? "presum" : "dot_q", (unsigned long)nr, (unsigned long)cols,
            (double)nr * rb * reps / 1048576.0 / s, (double)nr * cols * reps / 1e6 / s);
    }
    /* The one-token kernels as the core runs them since v9f: the activation vector's lane pairs made once
     * (gguf_widen_act) and loaded, instead of widened per weight word of every row. */
    if (type == GGML_Q4_K || type == GGML_Q6_K) {
        uint32_t *xw = bxw;
        gguf_widen_act(bxq, cols, xw);
        uint32_t reps = 0;
        volatile float sink = 0;
        const uint32_t t0 = micros();
        do {
            for (uint32_t r = 0; r < nr; r++) {
                const uint8_t *p = sdbuf + (size_t)r * rb;
                sink += type == GGML_Q4_K ? gguf_dot_q4k_presum_w(p, bxq, xw, bxs, bxsum, cols)
                                          : gguf_dot_q6k_w(p, bxq, xw, bxs, cols);
            }
            reps++;
        } while (micros() - t0 < 1000000u);
        const float s = (micros() - t0) / 1e6f;
        say("BENCH kernel %s type %lu path widened rows %lu cols %lu mb_s %.2f mweights_s %.2f", label, (unsigned long)type,
            (unsigned long)nr, (unsigned long)cols, (double)nr * rb * reps / 1048576.0 / s, (double)nr * cols * reps / 1e6 / s);
    }
    /* The batched kernel: the same rows against 8 activation vectors in one call (the same vector 8 times --
     * the arithmetic does not depend on the values). Reported per vector, to set against the lines above. */
    if (type == GGML_Q4_K || type == GGML_Q6_K) {
        const int8_t *qp[8];
        const float *sp[8];
        const int32_t *mp[8];
        for (int p = 0; p < 8; p++) { qp[p] = bxq; sp[p] = bxs; mp[p] = bxsum; }
        float o8[8];
        uint32_t reps = 0;
        volatile float sink = 0;
        const uint32_t t0 = micros();
        do {
            for (uint32_t r = 0; r < nr; r++) {
                const uint8_t *p = sdbuf + (size_t)r * rb;
                if (type == GGML_Q4_K) gguf_dot_q4k_presum_n(p, 8, qp, sp, mp, cols, o8);
                else                   gguf_dot_q_n(type, p, 8, qp, sp, cols, o8);
                sink += o8[7];
            }
            reps++;
        } while (micros() - t0 < 1000000u);
        const float s = (micros() - t0) / 1e6f;
        say("BENCH kernel_x8 %s type %lu vectors 8 mweights_s_per_vector %.2f", label, (unsigned long)type,
            8.0 * (double)nr * cols * reps / 1e6 / s);
    }
    /* Where a Q4_K dot's time goes (gguf_dot_q4k_stage): 0 the whole kernel, 1 without the float combination,
     * 2 without the scale unpack as well. Differences between adjacent stages attribute the cost. */
    if (type == GGML_Q4_K)
        for (int stage = 0; stage < 3; stage++) {
            uint32_t reps = 0;
            volatile float sink = 0;
            const uint32_t t0 = micros();
            do {
                for (uint32_t r = 0; r < nr; r++) sink += gguf_dot_q4k_stage(sdbuf + (size_t)r * rb, bxq, bxs, cols, stage);
                reps++;
            } while (micros() - t0 < 1000000u);
            const float s = (micros() - t0) / 1e6f;
            say("BENCH q4k_stage %s stage %d cycles_per_weight %.3f mweights_s %.2f", label, stage,
                (double)F_CPU_ACTUAL * s / ((double)nr * cols * reps), (double)nr * cols * reps / 1e6 / s);
        }
}

/* ::kbench (2026-10-16) -- where the batched Q4_K kernel's cycles go (docs/59 L3), by the M7's cycle counter.
 * ffn_gate of layer 0, 16 rows, in the core's own row buffer (tl_rowbuf: DTCM, uncached -- where a pass works
 * rows) and in the cached OCRAM arena; np = 2, 3, 4, 5, 8 vectors (the same vector repeated: the arithmetic does
 * not depend on the values). The production kernel (gguf_dot_q4k_presum_n) against the pre-widened one
 * (gguf_dot_q4k_presum_nw), whose outputs must carry the same bits on every row. Each figure is the fewest
 * cycles of 5 timed runs over the 16 rows (an interrupt can only add cycles), per weight per vector. */
FLASHMEM static void kbench(void)
{
    uint64_t off; uint32_t type, rows, cols, rb;
    if (tl_matrix(0, 4, &off, &type, &rows, &cols, &rb) || type != GGML_Q4_K) { say("KBENCH ffn_gate_L0 absent or not Q4_K"); return; }
    uint32_t rbytes = 0;
    uint8_t *rbuf = (uint8_t *)tl_rowbuf(&rbytes);
    uint32_t nr = rbytes / rb;
    if (nr > 16) nr = 16;
    if (!nr || cols > 11008 || nr * rb > SDBUF_BYTES) { say("KBENCH rows do not fit"); return; }
    arm_dcache_flush_delete(sdbuf, nr * rb);
    if (plat_sd_read(off, sdbuf, nr * rb)) { say("KBENCH read failed"); return; }
    memcpy(rbuf, sdbuf, nr * rb);
    uint32_t x = 0x2545F491u;
    for (uint32_t i = 0; i < cols; i++) { x = x * 1664525u + 1013904223u; bx[i] = ((int32_t)(x >> 8) - 8388608) / 8388608.0f; }
    gguf_quantize_act(bx, cols, bxq, bxs);
    gguf_act_sums(bxq, cols, bxsum);
    gguf_widen_act(bxq, cols, bxw);
    const int8_t *qp[8]; const uint32_t *wp[8]; const float *sp[8]; const int32_t *mp[8];
    for (int p = 0; p < 8; p++) { qp[p] = bxq; wp[p] = bxw; sp[p] = bxs; mp[p] = bxsum; }
    say("KBENCH begin temp_c %.1f rows %lu cols %lu", tempmonGetTemp(), (unsigned long)nr, (unsigned long)cols);
    static const int NPS[] = { 2, 3, 4, 5, 8 };
    volatile float sink = 0;
    for (unsigned ni = 0; ni < sizeof NPS / sizeof NPS[0]; ni++) {
        const int np = NPS[ni];
        float cpw[2][2];                                    /* [place: 0 rowbuf DTCM, 1 OCRAM][kernel: 0 _n, 1 _nw] */
        for (int place = 0; place < 2; place++)
            for (int kern = 0; kern < 2; kern++) {
                const uint8_t *base = place ? sdbuf : rbuf;
                uint32_t best = 0xFFFFFFFFu;
                for (int rep = 0; rep < 5; rep++) {
                    float o[8];
                    const uint32_t t0 = ARM_DWT_CYCCNT;
                    for (uint32_t r = 0; r < nr; r++) {
                        if (kern) gguf_dot_q4k_presum_nw(base + (size_t)r * rb, np, qp, wp, sp, mp, cols, o);
                        else      gguf_dot_q4k_presum_n(base + (size_t)r * rb, np, qp, sp, mp, cols, o);
                        sink += o[np - 1];
                    }
                    const uint32_t c = ARM_DWT_CYCCNT - t0;
                    if (c < best) best = c;
                }
                cpw[place][kern] = (float)best / ((float)nr * cols * np);
            }
        /* the answer: the pre-widened kernel against the production one, every row, every vector, to the bit */
        int differ = 0;
        for (uint32_t r = 0; r < nr; r++) {
            float a[8], b[8];
            gguf_dot_q4k_presum_n(rbuf + (size_t)r * rb, np, qp, sp, mp, cols, a);
            gguf_dot_q4k_presum_nw(rbuf + (size_t)r * rb, np, qp, wp, sp, mp, cols, b);
            differ += memcmp(a, b, (size_t)np * sizeof(float)) != 0;
        }
        say("KBENCH np %d rowbuf_n %.3f rowbuf_nw %.3f ocram_n %.3f ocram_nw %.3f cycles_per_weight_vector identical %s temp_c %.1f",
            np, cpw[0][0], cpw[0][1], cpw[1][0], cpw[1][1], differ ? "NO" : "yes", tempmonGetTemp());
        /* where the batched kernel's cycles go (2026-10-16): the same kernel without the double combination (stage
         * 1) and also without the scale unpacking (stage 2), rows in the DTCM row buffer; stage 0 must equal _n */
        float cst[3];
        for (int stage = 0; stage < 3; stage++) {
            uint32_t best = 0xFFFFFFFFu;
            for (int rep = 0; rep < 5; rep++) {
                float o[8];
                const uint32_t t0 = ARM_DWT_CYCCNT;
                for (uint32_t r = 0; r < nr; r++) { gguf_dot_q4k_presum_n_stage(rbuf + (size_t)r * rb, np, qp, sp, mp, cols, o, stage); sink += o[np - 1]; }
                const uint32_t c = ARM_DWT_CYCCNT - t0;
                if (c < best) best = c;
            }
            cst[stage] = (float)best / ((float)nr * cols * np);
        }
        int sdiffer = 0;
        for (uint32_t r = 0; r < nr; r++) {
            float a[8], b[8];
            gguf_dot_q4k_presum_n(rbuf + (size_t)r * rb, np, qp, sp, mp, cols, a);
            gguf_dot_q4k_presum_n_stage(rbuf + (size_t)r * rb, np, qp, sp, mp, cols, b, 0);
            sdiffer += memcmp(a, b, (size_t)np * sizeof(float)) != 0;
        }
        say("KBENCH stages np %d full %.3f no_double %.3f no_double_no_scales %.3f cycles_per_weight_vector stage0_identical %s",
            np, cst[0], cst[1], cst[2], sdiffer ? "NO" : "yes");
    }
    say("KBENCH end temp_c %.1f", tempmonGetTemp());
}

/* the card at three read sizes into the cached arena, and at 4 KB into DTCM, in the mode it is in */
/* 2 MB of the model at off in 64 KB reads: MB/s over the reads alone, and FNV-1a 64 of the bytes. The
 * target is the cached arena, so in DMA mode its lines are dropped before each read and after it (aligned
 * 64 KB reads are pure DMA, nothing copied by the CPU): the sum is of what the card delivered. */
FLASHMEM static bool sd_region(uint64_t off, uint64_t *sum, float *mbs)
{
    const uint32_t N = 2u << 20, K = 64u * 1024u;
    uint64_t h = 1469598103934665603ull;
    uint32_t us = 0;
    for (uint32_t got = 0; got < N; got += K, off += K) {
        arm_dcache_flush_delete(sdbuf, K);
        const uint32_t t0 = micros();
        if (mf_read_at(off, sdbuf, K, K)) return false;
        us += micros() - t0;
        if (g_dma) arm_dcache_delete(sdbuf, K);
        for (uint32_t i = 0; i < K; i++) { h ^= sdbuf[i]; h *= 1099511628211ull; }
    }
    *sum = h;
    *mbs = 2.0f * 1.048576f / (us / 1e6f);
    return true;
}

/* ::sdsweep -- see "THE DMA PATH'S BURSTS". FIFO first, for the reference sum; then every DMA setting. A
 * setting whose read fails restarts the card before the next. The fastest setting that read every byte
 * right is kept (g_sdcfg) and the card is left in the mode it was in. */
FLASHMEM static void sd_sweep(void)
{
    say("SWEEP begin temp_c %.1f", tempmonGetTemp());
    const bool was_dma = g_dma;
    uint64_t ref = 0, s = 0;
    float rf = 0, r = 0;
    if (g_dma && !sdio_switch(false)) { say("SWEEP end: FIFO restart failed"); return; }
    if (!sd_region(512ull << 20, &ref, &rf)) { say("SWEEP end: FIFO read failed"); return; }
    say("SWEEP fifo mb_s %.2f sum %08lx%08lx", rf, (unsigned long)(ref >> 32), (unsigned long)ref);
    g_sdcfg = false;
    if (!sdio_switch(true)) { say("SWEEP end: DMA restart failed"); return; }
    sd_regs("DMA as SdFat sets it");
    const uint32_t w0 = USDHC1_WTMK_LVL, p0 = USDHC1_PROT_CTRL;
    bool ok = sd_region(512ull << 20, &s, &r);
    say("SWEEP dma sdfat wml %lu brst %lu blen %lu mb_s %.2f data %s", (unsigned long)(w0 & 0xFF),
        (unsigned long)((w0 >> 8) & 0x1F), (unsigned long)((p0 >> 12) & 7), r, !ok ? "READ-FAILED" : s == ref ? "OK" : "WRONG");
    float best = (ok && s == ref) ? r : 0;
    uint8_t bw = 0, bb = 0, bl = 0;
    static const uint8_t WML[4] = { 16, 32, 64, 128 };
    static const uint8_t BRS[3] = { 4, 8, 16 };
    static const uint8_t BLE[3] = { 1, 3, 7 };
    for (int a = 0; a < 4; a++)
        for (int b = 0; b < 3; b++)
            for (int c = 0; c < 3; c++) {
                if (BRS[b] > WML[a]) continue;
                USDHC1_WTMK_LVL = w0; USDHC1_PROT_CTRL = p0;
                sd_burst_apply(WML[a], BRS[b], BLE[c]);
                ok = sd_region(512ull << 20, &s, &r);
                const bool good = ok && s == ref;
                say("SWEEP dma wml %u brst %u blen %u mb_s %.2f data %s", WML[a], BRS[b], BLE[c], ok ? r : 0.0f,
                    !ok ? "READ-FAILED" : good ? "OK" : "WRONG");
                if (!ok) {
                    say("SWEEP restarting the card after a failed read");
                    if (!sdio_switch(true)) { say("SWEEP end: DMA restart failed"); return; }
                }
                if (good && r > best) { best = r; bw = WML[a]; bb = BRS[b]; bl = BLE[c]; }
            }
    USDHC1_WTMK_LVL = w0; USDHC1_PROT_CTRL = p0;
    if (bw) {
        g_rwml = bw; g_rbrst = bb; g_blen = bl; g_sdcfg = true;
        sd_burst_apply(bw, bb, bl);
        say("SWEEP best wml %u brst %u blen %u mb_s %.2f (kept for DMA)", bw, bb, bl, best);
    } else {
        say("SWEEP best is SdFat's own setting, mb_s %.2f", best);
    }
    if (!was_dma && !sdio_switch(false)) { say("SWEEP end: FIFO restart failed"); return; }
    say("SWEEP end temp_c %.1f", tempmonGetTemp());
}

/* ::sdclksweep -- see "THE CARD'S CLOCK". FIFO, 8 MB in four places at SdFat's 49.5 MHz for the reference
 * sums; then each faster divider reads the same 8 MB twice. The first divider that fails or reads one wrong
 * byte ends the sweep, and the card is restarted at SdFat's clock before anything else. */
/* Which card is in the slot (its CID register): the card, not the bus, sets the pass time -- it sustains
 * 18.5 MB/s where the bus delivers 30.1 (::sdtrace, 2026-10-16) -- so a log should say which card it measured.
 * The serial number is left out: these logs are published. */
FLASHMEM static void card_id_say(void)
{
    cid_t c;
    if (!sd.card()->readCID(&c)) { say("CARD id unreadable"); return; }
    char oid[3] = { c.oid[0], c.oid[1], 0 }, pnm[6] = { c.pnm[0], c.pnm[1], c.pnm[2], c.pnm[3], c.pnm[4], 0 };
    for (int i = 0; i < 5; i++) if (pnm[i] < 32 || pnm[i] > 126) pnm[i] = '?';
    for (int i = 0; i < 2; i++) if (oid[i] < 32 || oid[i] > 126) oid[i] = '?';
    say("CARD id manufacturer 0x%02X oem %s product %s rev %u.%u made %u-%02u sectors %lu", (unsigned)c.mid, oid, pnm,
        (unsigned)c.prv_n, (unsigned)c.prv_m, 2000u + 16u * c.mdt_year_high + c.mdt_year_low, (unsigned)c.mdt_month,
        (unsigned long)sd.card()->sectorCount());
}

FLASHMEM static void sd_clk_sweep(void)
{
    static const uint64_t OFF[4] = { 64ull << 20, 512ull << 20, 1024ull << 20, 1536ull << 20 };
    card_id_say();
    say("CLKSWEEP begin temp_c %.1f", tempmonGetTemp());
    const bool was_dma = g_dma;
    g_sddvs = 0;
    if (!sdio_switch(false)) { say("CLKSWEEP end: FIFO restart failed"); return; }
    uint64_t ref[4];
    float r = 0, sum = 0;
    for (int i = 0; i < 4; i++) {
        if (!sd_region(OFF[i], &ref[i], &r)) { say("CLKSWEEP end: reference read failed"); return; }
        sum += r;
    }
    const uint8_t dvs0 = (uint8_t)((USDHC1_SYS_CTRL >> 4) & 0xF);
    say("CLKSWEEP khz %lu divider %u mb_s %.2f (SdFat's, the reference)", sd_clk_now(), dvs0 + 1u, sum / 4);
    /* kept: the divider with the best MEASURED rate, and only if it beats SdFat's clock by 2% -- a faster clock
     * that the card cannot feed buys nothing (this card: 22.9 MB/s at 49.5 MHz, 24.0 at 66, 23.9 at 99) */
    uint8_t best = 0;
    float best_mbs = sum / 4 * 1.02f;
    for (int dvs = (int)dvs0 - 1; dvs >= 1; dvs--) {
        sd_idle();
        if (!sd_set_dvs((uint8_t)dvs)) { say("CLKSWEEP divider %d: clock did not settle", dvs + 1); break; }
        int wrong = 0, failed = 0, n = 0;
        sum = 0;
        for (int pass = 0; pass < 2 && !failed; pass++)
            for (int i = 0; i < 4 && !failed; i++) {
                uint64_t h;
                if (!sd_region(OFF[i], &h, &r)) { failed = 1; break; }
                wrong += h != ref[i];
                sum += r; n++;
            }
        say("CLKSWEEP khz %lu divider %d mb_s %.2f regions %d wrong %d failed %d", sd_clk_now(), dvs + 1,
            n ? sum / n : 0.0f, n, wrong, failed);
        if (failed || wrong) break;
        if (sum / n > best_mbs) { best = (uint8_t)dvs; best_mbs = sum / n; }
    }
    /* back to SdFat's clock through a full restart (a failed read may have left the card mid-command) */
    if (!sdio_switch(was_dma)) { say("CLKSWEEP end: restart failed"); halt("the card did not restart; power-cycle the Teensy (unplug USB for 2 s)"); return; }
    if (best) {
        g_sddvs = best;
        sd_idle();
        sd_set_dvs(best);
        say("CLKSWEEP best khz %lu divider %u mb_s %.2f (kept)", sd_clk_now(), best + 1u, best_mbs);
    } else {
        say("CLKSWEEP best is SdFat's clock");
    }
    say("CLKSWEEP end temp_c %.1f", tempmonGetTemp());
}

/* THE CARD BY ADMA2 (v9b experiment). SdFat's DMA path uses the uSDHC's simple DMA (PROT_CTRL DMASEL 00) and
 * measured 7.3 MB/s on this card whatever the watermark and burst registers said (::sdsweep), against 22.9
 * by FIFO. NXP's own driver runs the same controller in ADMA2 mode (DMASEL 10): the transfer follows a
 * descriptor table -- {attribute, address} pairs, attribute = length << 16 | Tran (0x21) | End (0x02) --
 * instead of DS_ADDR. ::sdadma arms such a table for SdFat's own readSectors() (its DS_ADDR write is then
 * ignored) and reads 2 MB of the model at four read sizes, each summed and compared with the FIFO read.
 * A fast, right ADMA2 read is what the v7 overlap (arithmetic during the card wait) has been waiting for. */
__attribute__((aligned(32))) static uint32_t adma_desc[2 * 8];   /* up to 8 x 32 KB */
static uint32_t g_adma_chunk = 32768u;       /* bytes per descriptor (<= 65024, a multiple of 512) */
static void adma_arm(void *buf, uint32_t n)
{
    uint8_t *p = (uint8_t *)buf;
    uint32_t i = 0;
    while (n && i < 8) {
        const uint32_t k = n < g_adma_chunk ? n : g_adma_chunk;
        adma_desc[2 * i]     = (k << 16) | 0x21u | (n == k ? 0x02u : 0u);
        adma_desc[2 * i + 1] = (uint32_t)p;
        p += k; n -= k; i++;
    }
    USDHC1_ADMA_SYS_ADDR = (uint32_t)adma_desc;
    USDHC1_PROT_CTRL = (USDHC1_PROT_CTRL & ~(3u << 8)) | (2u << 8);
}
static void adma_disarm(void) { USDHC1_PROT_CTRL &= ~(3u << 8); }

FLASHMEM static bool sd_region_adma(uint64_t off, uint32_t K, uint64_t *sum, float *mbs, uint32_t *errstat)
{
    const uint32_t N = 2u << 20;
    uint64_t h = 1469598103934665603ull;
    uint32_t us = 0, bytes = 0;
    *errstat = 0;
    uint32_t arena = 0;
    tl_scratch(&arena);                                         /* sdbuf is the arena's start; the whole arena is free here */
    if (K > arena || K % 512u || K > 8u * g_adma_chunk) { say("    ADMA2 read size %lu does not fit (arena %lu, 8 descriptors of %lu)", (unsigned long)K, (unsigned long)arena, (unsigned long)g_adma_chunk); return false; }
    for (uint32_t got = 0; got < N; got += K) {
        arm_dcache_flush_delete(sdbuf, K);
        adma_arm(sdbuf, K);
        const uint32_t t0 = micros();
        const bool ok = sd.card()->readSectors((uint32_t)(mf_sector0 + (off + got) / 512u), sdbuf, K / 512u);
        us += micros() - t0;
        *errstat |= USDHC1_ADMA_ERR_STATUS;
        adma_disarm();
        if (!ok) {
            say("    ADMA2 read of %lu bytes failed: SdFat error 0x%02X data 0x%08lX, ADMA_ERR_STATUS 0x%08lX", (unsigned long)K,
                (unsigned)sd.sdErrorCode(), (unsigned long)sd.sdErrorData(), (unsigned long)*errstat);
            return false;
        }
        arm_dcache_delete(sdbuf, K);
        /* the sum covers the 2 MB region exactly, whatever the read size: a size that does not divide it reads a
         * little past the end (the 07:5x sweep summed that too and called 65,024- and 114,688-byte reads WRONG) */
        const uint32_t take = (N - got) < K ? (N - got) : K;
        for (uint32_t i = 0; i < take; i++) { h ^= sdbuf[i]; h *= 1099511628211ull; }
        bytes += K;
    }
    *sum = h;
    *mbs = (float)bytes / 1048576.0f / (us / 1e6f);
    return true;
}

FLASHMEM static void sd_adma_sweep(void)
{
    say("ADMA begin temp_c %.1f", tempmonGetTemp());
    if (!mf_contig) { say("ADMA end: the model file is not contiguous, no sector arithmetic"); return; }
    const bool was_dma = g_dma;
    uint64_t ref = 0, s = 0;
    float r = 0;
    if (g_dma && !sdio_switch(false)) { say("ADMA end: FIFO restart failed"); return; }
    if (!sd_region(512ull << 20, &ref, &r)) { say("ADMA end: FIFO read failed"); return; }
    say("ADMA fifo mb_s %.2f", r);
    if (!sdio_switch(true)) { say("ADMA end: DMA restart failed"); return; }
    if (sd_region(512ull << 20, &s, &r)) say("ADMA sdma read_size 65536 mb_s %.2f data %s", r, s == ref ? "OK" : "WRONG");
    /* read size x descriptor size (the arena, 119 KB, is the buffer: the 04:52 build read 256 KB into it and the
     * board reset itself), then the watermark and burst registers under ADMA2 at 64 KB */
    static const uint32_t SZ[7][2] = { { 4096, 32768 }, { 16384, 32768 }, { 65024, 65024 }, { 65536, 32768 }, { 65536, 16384 },
                                       { 114688, 57344 }, { 114688, 28672 } };
    for (int k = 0; k < 7; k++) {
        uint32_t es = 0;
        g_adma_chunk = SZ[k][1];
        if (!sd_region_adma(512ull << 20, SZ[k][0], &s, &r, &es)) {
            say("ADMA adma2 read_size %lu desc %lu FAILED; restarting the card", (unsigned long)SZ[k][0], (unsigned long)SZ[k][1]);
            if (!sdio_switch(true)) { say("ADMA end: DMA restart failed"); halt("the card did not restart; power-cycle the Teensy (unplug USB for 2 s)"); return; }
            continue;
        }
        say("ADMA adma2 read_size %lu desc %lu mb_s %.2f data %s adma_err 0x%08lX", (unsigned long)SZ[k][0], (unsigned long)SZ[k][1], r,
            s == ref ? "OK" : "WRONG", (unsigned long)es);
    }
    g_adma_chunk = 32768u;
    {
        const uint32_t w0 = USDHC1_WTMK_LVL, p0 = USDHC1_PROT_CTRL;
        static const uint8_t WB[4][3] = { { 128, 16, 7 }, { 64, 16, 7 }, { 16, 16, 7 }, { 128, 8, 0 } };
        for (int k = 0; k < 4; k++) {
            uint32_t es = 0;
            sd_burst_apply(WB[k][0], WB[k][1], WB[k][2]);
            const bool ok = sd_region_adma(512ull << 20, 65536, &s, &r, &es);
            USDHC1_WTMK_LVL = w0; USDHC1_PROT_CTRL = p0;
            if (!ok) { say("ADMA adma2 wml %u brst %u blen %u FAILED", WB[k][0], WB[k][1], WB[k][2]); if (!sdio_switch(true)) { halt("the card did not restart; power-cycle the Teensy (unplug USB for 2 s)"); return; } continue; }
            say("ADMA adma2 read_size 65536 wml %u brst %u blen %u mb_s %.2f data %s", WB[k][0], WB[k][1], WB[k][2], r, s == ref ? "OK" : "WRONG");
        }
    }
    sd_idle();
    if (!was_dma && !sdio_switch(false)) { say("ADMA end: FIFO restart failed"); return; }
    say("ADMA end temp_c %.1f", tempmonGetTemp());
}

/* CAN ARITHMETIC RUN UNDER A FIFO READ? (::sdfifo, 2026-10-16). FIFO reads this card at 24 MB/s against
 * ADMA2's 18.6 MB/s streaming plus 274 us a command, but a FIFO pass cannot hide its arithmetic: SdFat's
 * readData() (SdioTeensy.cpp) asks the card for one block (Continue Request, with Stop At Block Gap set) and
 * then spins in waitTimeout(), which never yields, until the block is in the controller's buffer. The card is
 * idle at every block gap anyway. So: issue the Continue Request, run arithmetic while the block arrives, then
 * drain it -- the same registers in the same order as readData(), with the work in the middle.
 *   gap     SdFat's handshake per block, with `work` microseconds of spinning between the request and the drain
 *   stream  Stop At Block Gap cleared: the infinite CMD18 runs on and the controller must gate the card's
 *           clock when its buffer is full (PRES_STATE SDOFF, counted at the end of each spin)
 * 2 MB of the model per setting, read by sector straight from the card object (the file is contiguous) into
 * the arena 64 KB at a time; each 64 KB is summed outside the timing and the sum must equal the file layer's
 * (sd_region). Every wait has a timeout; a setting that fails is reported and the card restarted. In stream
 * mode the card runs on while a 64 KB piece is summed, so the first block after it drains at once: < 1% of
 * the timing. Bits: FX_* above (from SdFat's SdioTeensy.h). */
static uint32_t fx_sdoff;
static uint64_t fx_wait_cyc;                /* cycles spent waiting for blocks after the work: the card's latency */
FLASHMEM static int fx_block(uint32_t *p32, uint32_t work_cyc, bool gap)
{
    if (gap && !(USDHC1_PRES_STATE & FX_RTA)) {
        USDHC1_PROT_CTRL &= ~FX_SABGREQ;
        noInterrupts();
        USDHC1_PROT_CTRL |= FX_CREQ;
        USDHC1_PROT_CTRL |= FX_SABGREQ;
        interrupts();
    }
    if (work_cyc) {
        const uint32_t c0 = ARM_DWT_CYCCNT;
        while (ARM_DWT_CYCCNT - c0 < work_cyc) {}
        if (USDHC1_PRES_STATE & FX_SDOFF) fx_sdoff++;
    }
    const uint32_t t0 = micros(), w0 = ARM_DWT_CYCCNT;
    for (int iw = 0; iw < 512 / (4 * 16); iw++) {          /* RD_WML is SdFat's 16 words */
        while (!(USDHC1_PRES_STATE & FX_BREN)) if (micros() - t0 > 100000u) return -1;
        for (int i = 0; i < 16; i++) p32[i] = USDHC1_DATA_BUFF_ACC_PORT;
        p32 += 16;
    }
    fx_wait_cyc += ARM_DWT_CYCCNT - w0;
    if (gap) {
        while (!(USDHC1_INT_STATUS & (FX_TC | FX_ERR))) if (micros() - t0 > 100000u) return -2;
        const uint32_t st = USDHC1_INT_STATUS;
        USDHC1_INT_STATUS = st;
        return ((st & FX_TC) && !(st & FX_ERR)) ? 0 : -3;
    }
    const uint32_t st = USDHC1_INT_STATUS;
    if (st & FX_ERR) { USDHC1_INT_STATUS = st; return -3; }
    return 0;
}

/* the interrupt-fed FIFO read (FIFOX irq): state shared with the handler */
static volatile uint32_t fxi_done, fxi_used, fxi_err, fxi_parked, fxi_irqs, fxi_wpos;   /* blocks in; summed */
static uint32_t *fxi_dst, fxi_ring, fxi_total, fxi_wml = 128;
FLASHMEM static void fx_isr(void)
{
    const uint32_t st = USDHC1_INT_STATUS;
    fxi_irqs++;
    if (st & FX_ERR) { USDHC1_INT_STATUS = st & FX_ERR; fxi_err = st; USDHC1_INT_SIGNAL_EN = 0; return; }
    if (st & FX_BRR) {                      /* a watermark of words waits: drain every whole one there is */
        USDHC1_INT_STATUS = FX_BRR;
        while (USDHC1_PRES_STATE & FX_BREN) {
            uint32_t *p = fxi_dst + (fxi_done % fxi_ring) * 128u + fxi_wpos;
            for (uint32_t i = 0; i < fxi_wml; i++) p[i] = USDHC1_DATA_BUFF_ACC_PORT;
            fxi_wpos += fxi_wml;
            if (fxi_wpos >= 128u) { fxi_wpos = 0; fxi_done++; }
        }
    }
    if (st & FX_TC) {                       /* parked at the block gap: the next block, if there is room */
        USDHC1_INT_STATUS = FX_TC;
        if (fxi_done < fxi_total) {
            if (fxi_done - fxi_used < fxi_ring) {
                USDHC1_PROT_CTRL &= ~FX_SABGREQ;
                USDHC1_PROT_CTRL |= FX_CREQ;
                USDHC1_PROT_CTRL |= FX_SABGREQ;
            } else fxi_parked = 1;
        }
    }
    asm volatile("dsb");
}

/* WHERE THE INTERRUPT-FED READ LOSES 6 us A BLOCK (::sdtrace, 2026-10-16). The polled handshake reads a block
 * in 21.5 us; the interrupt-fed one in 27.6 us at every read watermark from 16 to 128 words (2 to 16
 * interrupts a block), so it is neither interrupt latency nor where the drain starts. The cycle counter at
 * each step of the handshake, 64 blocks of the model, for the polled read (SdFat's readData order) and for the
 * interrupt read in three forms: as ::fifoirq does it; the request held until Read Transfer Active has
 * cleared (readData's own test); every status bit cleared at the stop as readData does (it writes back the
 * whole register, not just the bits it waited on). Means over blocks 4..63, microseconds. */
#define TR_N 64
DMAMEM static uint32_t tr_c[TR_N][4];
static volatile uint32_t tr_b, tr_mode;
FLASHMEM __attribute__((noinline)) static void tr_isr(void)
{
    const uint32_t st = USDHC1_INT_STATUS, c = ARM_DWT_CYCCNT;
    if (st & FX_ERR) { USDHC1_INT_STATUS = st & FX_ERR; fxi_err = st; USDHC1_INT_SIGNAL_EN = 0; return; }
    const uint32_t b = tr_b;
    if (st & FX_BRR) {
        USDHC1_INT_STATUS = FX_BRR;
        if (b < TR_N) tr_c[b][0] = c;                     /* the block is in */
        uint32_t *p = (uint32_t *)(sdbuf + (b % TR_N) * 512u);
        for (int i = 0; i < 128; i++) p[i] = USDHC1_DATA_BUFF_ACC_PORT;
        if (b < TR_N) tr_c[b][1] = ARM_DWT_CYCCNT;        /* drained */
    }
    if (st & FX_TC) {
        if (tr_mode == 2) USDHC1_INT_STATUS = st & ~FX_ERR; else USDHC1_INT_STATUS = FX_TC;
        if (b < TR_N) tr_c[b][2] = ARM_DWT_CYCCNT;        /* stopped at the gap */
        tr_b = b + 1;
        if (b + 1 < TR_N) {
            if (tr_mode == 1) { const uint32_t c0 = ARM_DWT_CYCCNT; while ((USDHC1_PRES_STATE & FX_RTA) && ARM_DWT_CYCCNT - c0 < 30000u) {} }
            USDHC1_PROT_CTRL &= ~FX_SABGREQ;
            USDHC1_PROT_CTRL |= FX_CREQ;
            USDHC1_PROT_CTRL |= FX_SABGREQ;
            tr_c[b + 1][3] = ARM_DWT_CYCCNT;              /* the next block asked for */
        }
    }
    asm volatile("dsb");
}

FLASHMEM static void sd_trace(void)
{
    say("TRACE begin temp_c %.1f", tempmonGetTemp());
    if (!mf_contig) { say("TRACE end: the model file is not contiguous"); return; }
    const bool was_dma = g_dma;
    if (g_dma && !sdio_switch(false)) { say("TRACE end: FIFO restart failed"); return; }
    const uint32_t sec0 = (uint32_t)(mf_sector0 + (512ull << 20) / 512u);
    const float us = F_CPU_ACTUAL / 1e6f;
    /* polled: [0] entry, [1] after the request (or entry if none was needed), [2] first words ready, [3] drained;
     * the stop's Transfer Complete is the next block's entry */
    {
        sd_idle();
        int err = 0, no_req = 0;
        if (!fx_card()->readStart(sec0)) err = -10;
        for (int b = 0; b < TR_N && !err; b++) {
            tr_c[b][0] = ARM_DWT_CYCCNT;
            if (!(USDHC1_PRES_STATE & FX_RTA)) {
                USDHC1_PROT_CTRL &= ~FX_SABGREQ;
                noInterrupts(); USDHC1_PROT_CTRL |= FX_CREQ; USDHC1_PROT_CTRL |= FX_SABGREQ; interrupts();
            } else no_req++;
            tr_c[b][1] = ARM_DWT_CYCCNT;
            const uint32_t t0 = micros();
            uint32_t *p = (uint32_t *)(sdbuf + b * 512u);
            for (int iw = 0; iw < 8 && !err; iw++) {
                while (!(USDHC1_PRES_STATE & FX_BREN)) if (micros() - t0 > 100000u) { err = -1; break; }
                if (iw == 0) tr_c[b][2] = ARM_DWT_CYCCNT;
                for (int i = 0; i < 16; i++) p[i] = USDHC1_DATA_BUFF_ACC_PORT;
                p += 16;
            }
            tr_c[b][3] = ARM_DWT_CYCCNT;
            while (!err && !(USDHC1_INT_STATUS & (FX_TC | FX_ERR))) if (micros() - t0 > 100000u) err = -2;
            const uint32_t st = USDHC1_INT_STATUS;
            USDHC1_INT_STATUS = st;
            if (st & FX_ERR) err = -3;
        }
        fx_card()->readStop();
        double a = 0, r = 0, d = 0, g = 0, t = 0;
        for (int b = 4; b < TR_N - 1; b++) {
            a += tr_c[b][1] - tr_c[b][0]; r += tr_c[b][2] - tr_c[b][1]; d += tr_c[b][3] - tr_c[b][2];
            g += tr_c[b + 1][0] - tr_c[b][3]; t += tr_c[b + 1][0] - tr_c[b][0];
        }
        const double n = TR_N - 5;
        say("TRACE polled request %.2f request_to_first_words %.2f first_to_drained %.2f drained_to_stop %.2f block %.2f us; no request needed %d of %d; err %d",
            a / n / us, r / n / us, d / n / us, g / n / us, t / n / us, no_req, TR_N, err);
        if (!sdio_switch(false)) { halt("the card did not restart; power-cycle the Teensy (unplug USB for 2 s)"); return; }
    }
    /* interrupt: [3] request (from the previous stop), [0] block in (Buffer Read Ready, watermark 128), [1] drained,
     * [2] stopped at the gap */
    static const char *const NM[3] = { "as_fifoirq", "request_after_rta", "clear_all_status" };
    for (int mode = 0; mode < 3; mode++) {
        sd_idle();
        int err = 0;
        tr_b = 0; tr_mode = (uint32_t)mode; fxi_err = 0;
        const uint32_t wml0 = USDHC1_WTMK_LVL, sten0 = USDHC1_INT_STATUS_EN;
        USDHC1_WTMK_LVL = (wml0 & ~0xFFu) | 128u;
        USDHC1_INT_STATUS_EN = sten0 | FX_BRR | FX_TC;
        USDHC1_INT_STATUS = 0xFFFFFFFFu;
        attachInterruptVector(IRQ_SDHC1, tr_isr);
        NVIC_SET_PRIORITY(IRQ_SDHC1, 6 * 16);
        NVIC_ENABLE_IRQ(IRQ_SDHC1);
        USDHC1_INT_SIGNAL_EN = FX_BRR | FX_TC | FX_ERR;
        tr_c[0][3] = ARM_DWT_CYCCNT;
        if (!fx_card()->readStart(sec0)) err = -10;
        const uint32_t t0 = micros();
        while (!err && tr_b < TR_N) { if (fxi_err) err = -3; else if (micros() - t0 > 200000u) err = -1; }
        USDHC1_INT_SIGNAL_EN = 0;
        USDHC1_INT_STATUS_EN = sten0;
        USDHC1_WTMK_LVL = wml0;
        fx_card()->readStop();
        double r = 0, d = 0, g = 0, q = 0, t = 0;
        for (int b = 4; b < TR_N - 1; b++) {
            r += tr_c[b][0] - tr_c[b][3]; d += tr_c[b][1] - tr_c[b][0]; g += tr_c[b][2] - tr_c[b][1];
            q += tr_c[b + 1][3] - tr_c[b][2]; t += tr_c[b + 1][3] - tr_c[b][3];
        }
        const double n = TR_N - 5;
        say("TRACE irq %s request_to_block_in %.2f block_in_to_drained %.2f drained_to_stop %.2f stop_to_request %.2f block %.2f us; err %d",
            NM[mode], r / n / us, d / n / us, g / n / us, q / n / us, t / n / us, err);
        if (!sdio_switch(false)) { halt("the card did not restart; power-cycle the Teensy (unplug USB for 2 s)"); return; }
    }
    if (was_dma && !sdio_switch(true)) { say("TRACE end: DMA restart failed"); return; }
    say("TRACE end temp_c %.1f", tempmonGetTemp());
}

/* ONE OPEN ADMA2 TRANSFER (::sdfifo adma, 2026-10-16, on the SanDisk Ultra). With a card that keeps up with the
 * bus, both read paths have a cost the old card hid: the interrupt-fed FIFO read spends 4.3 us of CPU a block
 * draining the port (a one-token pass 58.7 s), and ADMA2 pays the card's ~0.75 ms command latency on every
 * 24 KB read (109.6 s). NXP's own driver (mcux-sdk fsl_usdhc.c, "boot data continuous") continues a DMA
 * transfer from a block gap by loading a new descriptor table and setting Continue Request, with no new
 * command. So: one open CMD18 (no block count, no auto CMD12) with ADMA2 armed and Stop At Block Gap set;
 * an interrupt at each block's stop asks for the next (the DMA engine does the copying), and at the end of a
 * 24 KB read loads the next read's table and continues. Two 24 KB halves of the arena, the main loop summing
 * one (and spinning `work`) while the other fills, as the core's pipeline does; every byte against the file
 * layer's read of the same 2 MB. */
__attribute__((aligned(32))) static uint32_t fa_desc[2][4];
static volatile uint32_t fa_sys[4];                 /* ADMA_SYS_ADDR at the first read ends: where the engine was parked */
static volatile uint32_t fa_blk, fa_chunk, fa_err, fa_parked, fa_irqs, fa_released;
static uint32_t fa_bpc, fa_nchunks;
FLASHMEM __attribute__((noinline)) static void fa_isr(void)
{
    const uint32_t st = USDHC1_INT_STATUS;
    fa_irqs++;
    if (st & FX_ERR) { USDHC1_INT_STATUS = st & FX_ERR; fa_err = st | 1u; USDHC1_INT_SIGNAL_EN = 0; return; }
    if (st & FX_TC) {
        USDHC1_INT_STATUS = st & ~FX_ERR;                  /* TC, and the DMA / block-gap events with it */
        const uint32_t b = ++fa_blk;
        bool go = false;
        if (b % fa_bpc) go = true;                         /* inside a read: the next block */
        else {
            const uint32_t c = ++fa_chunk;                 /* a read is complete */
            if (c <= 4u) fa_sys[c - 1u] = USDHC1_ADMA_SYS_ADDR;
            if (c < fa_nchunks) {
                if (c - fa_released < 2u) { USDHC1_ADMA_SYS_ADDR = (uint32_t)fa_desc[c & 1u]; go = true; }
                else fa_parked = 1;
            }
        }
        if (go) {
            USDHC1_PROT_CTRL &= ~FX_SABGREQ;
            USDHC1_PROT_CTRL |= FX_CREQ;
            USDHC1_PROT_CTRL |= FX_SABGREQ;
        }
    }
    asm volatile("dsb");
}
/* the open CMD18 with ADMA2 armed (sd_cmd18_dma, shared with ::fifoirq 2) */
FLASHMEM static bool fa_start(uint32_t sector) { return sd_cmd18_dma(sector, fa_desc[0]); }

FLASHMEM static void sd_adma_open(void)
{
    say("FIFOX adma_open begin temp_c %.1f", tempmonGetTemp());
    if (!mf_contig) { say("FIFOX end: the model file is not contiguous"); return; }
    const bool was_dma = g_dma;
    if (g_dma && !sdio_switch(false)) { say("FIFOX end: FIFO restart failed"); return; }
    const uint64_t OFF = 512ull << 20;
    uint64_t ref = 0;
    float rf = 0;
    if (!sd_region(OFF, &ref, &rf)) { say("FIFOX end: reference read failed"); return; }
    const uint32_t K = 24u * 1024u, N = 2u << 20;
    uint8_t *half[2] = { sdbuf, sdbuf + K };
    uint8_t *ovf = sdbuf + 2 * K;                               /* one block of overflow, ending each table */
    for (int h = 0; h < 2; h++) {
        fa_desc[h][0] = (K << 16) | 0x21u; fa_desc[h][1] = (uint32_t)half[h];         /* Tran, Valid: not End */
        fa_desc[h][2] = (512u << 16) | 0x23u; fa_desc[h][3] = (uint32_t)ovf;          /* Tran, End, Valid */
    }
    arm_dcache_flush(fa_desc, sizeof fa_desc);
    static const uint16_t WORKC[4] = { 0, 100, 200, 300 };      /* us of extra arithmetic per 24 KB read (one token: ~365) */
    const uint32_t cyc_us = F_CPU_ACTUAL / 1000000u;
    for (int w = 0; w < 4; w++) {
        sd_idle();
        memset(ovf, 0xA5, 512);
        arm_dcache_flush_delete(sdbuf, 2 * K + 512);
        fa_bpc = K / 512u; fa_nchunks = N / K; fa_blk = 0; fa_chunk = 0; fa_err = 0; fa_parked = 0; fa_irqs = 0; fa_released = 0;
        uint64_t h = 1469598103934665603ull;
        int err = 0;
        const uint32_t sten0 = USDHC1_INT_STATUS_EN;
        USDHC1_INT_STATUS_EN = sten0 | FX_TC;
        attachInterruptVector(IRQ_SDHC1, fa_isr);
        NVIC_SET_PRIORITY(IRQ_SDHC1, 6 * 16);
        NVIC_ENABLE_IRQ(IRQ_SDHC1);
        USDHC1_INT_SIGNAL_EN = FX_TC | FX_ERR;
        const uint32_t t0 = micros();
        if (!fa_start((uint32_t)(mf_sector0 + OFF / 512u))) err = -10;
        for (uint32_t c = 0; !err && c < fa_nchunks; c++) {
            const uint32_t tw = micros();
            while (fa_chunk <= c) {
                if (fa_err) { err = -3; break; }
                if (micros() - tw > 200000u) { err = -1; break; }
            }
            if (err) break;
            uint8_t *bp = half[c & 1u];
            arm_dcache_delete(bp, K);                                   /* what the DMA wrote, not stale lines */
            for (uint32_t i = 0; i < K; i++) { h ^= bp[i]; h *= 1099511628211ull; }
            if (WORKC[w]) { const uint32_t s0 = ARM_DWT_CYCCNT; while (ARM_DWT_CYCCNT - s0 < WORKC[w] * cyc_us) {} }
            noInterrupts();
            fa_released = c + 1u;
            if (fa_parked && fa_chunk < fa_nchunks) {
                fa_parked = 0;
                USDHC1_ADMA_SYS_ADDR = (uint32_t)fa_desc[fa_chunk & 1u];
                USDHC1_PROT_CTRL &= ~FX_SABGREQ; USDHC1_PROT_CTRL |= FX_CREQ; USDHC1_PROT_CTRL |= FX_SABGREQ;
            }
            interrupts();
        }
        const uint32_t us = micros() - t0;
        USDHC1_INT_SIGNAL_EN = 0;
        USDHC1_INT_STATUS_EN = sten0;
        const uint32_t adma_es = USDHC1_ADMA_ERR_STATUS;
        const bool stopped = fx_card()->readStop();
        USDHC1_PROT_CTRL &= ~(3u << 8);
        arm_dcache_delete(ovf, 512);
        int ovf_touched = 0;
        for (int i = 0; i < 512; i++) if (ovf[i] != 0xA5) { ovf_touched = 1; break; }
        say("FIFOX adma_open work_per_24k_us %u mb_s %.2f us_per_block %.2f interrupts %lu blocks %lu data %s%s adma_err 0x%08lX overflow %s parked_at %08lX %08lX (tables %08lX %08lX) temp_c %.1f",
            WORKC[w], err ? 0.0f : 2.0f * 1.048576f / (us / 1e6f), err ? 0.0f : us / 4096.0f, (unsigned long)fa_irqs,
            (unsigned long)fa_blk, err ? "FAILED" : h == ref ? "OK" : "WRONG", stopped ? "" : " (stop failed)", (unsigned long)adma_es,
            ovf_touched ? "WRITTEN" : "untouched", (unsigned long)fa_sys[0], (unsigned long)fa_sys[1],
            (unsigned long)(uint32_t)fa_desc[0], (unsigned long)(uint32_t)fa_desc[1], tempmonGetTemp());
        if (err) say("FIFOX   error %d at block %lu chunk %lu, INT_STATUS 0x%08lX PRES_STATE 0x%08lX fa_err 0x%08lX", err,
                     (unsigned long)fa_blk, (unsigned long)fa_chunk, (unsigned long)USDHC1_INT_STATUS, (unsigned long)USDHC1_PRES_STATE, (unsigned long)fa_err);
        if (!sdio_switch(false)) { say("FIFOX end: restart failed"); halt("the card did not restart; power-cycle the Teensy (unplug USB for 2 s)"); return; }
    }
    if (was_dma && !sdio_switch(true)) { say("FIFOX end: DMA restart failed"); return; }
    say("FIFOX adma_open end temp_c %.1f", tempmonGetTemp());
}

/* THE CARD STREAMING INTO A RING (::sdfifo ring, 2026-10-16). ::sdfifo adma showed the ADMA2 engine pauses and
 * continues at every block gap mid-descriptor (48 blocks, 48 interrupts, right), but fetches its next
 * descriptor the moment the current one ends -- a table rewritten at the read's last block gap is ignored
 * (it parked on the overflow descriptor, 0x200166CC) -- and an End descriptor ends the data phase. So the
 * engine is never given a new table: one Tran over a ring and a Link back to it, forever. Stop At Block Gap
 * stays set; at each block's stop the interrupt grants the next block only while the ring has room (flow
 * control), and the reader copies blocks out in order. The card streams ahead into the ring while the CPU
 * does other work; nothing the CPU does copies from the controller's port. */
__attribute__((aligned(32))) static uint32_t rg_desc[4];
static volatile uint32_t rg_prod, rg_cons, rg_err, rg_parked, rg_irqs;
static uint32_t rg_nb;                                   /* blocks in the ring */
FLASHMEM __attribute__((noinline)) static void rg_isr(void)
{
    const uint32_t st = USDHC1_INT_STATUS;
    rg_irqs++;
    if (st & FX_ERR) { USDHC1_INT_STATUS = st & FX_ERR; rg_err = st | 1u; USDHC1_INT_SIGNAL_EN = 0; return; }
    if (st & FX_TC) {
        USDHC1_INT_STATUS = st & ~FX_ERR;
        const uint32_t p = ++rg_prod;
        if (p - rg_cons < rg_nb) {
            USDHC1_PROT_CTRL &= ~FX_SABGREQ;
            USDHC1_PROT_CTRL |= FX_CREQ;
            USDHC1_PROT_CTRL |= FX_SABGREQ;
        } else rg_parked = 1;
    }
    asm volatile("dsb");
}

FLASHMEM static void sd_adma_ring(void)
{
    say("FIFOX ring begin temp_c %.1f", tempmonGetTemp());
    if (!mf_contig) { say("FIFOX end: the model file is not contiguous"); return; }
    const bool was_dma = g_dma;
    if (g_dma && !sdio_switch(false)) { say("FIFOX end: FIFO restart failed"); return; }
    const uint64_t OFF = 512ull << 20;
    uint64_t ref = 0;
    float rf = 0;
    if (!sd_region(OFF, &ref, &rf)) { say("FIFOX end: reference read failed"); return; }
    /* where the ring is: the arena (OCRAM, cached; the control that worked), the production ring (DTCM), and a
     * half-size OCRAM ring -- ::fifoirq 3 failed on its first read with the ring in DTCM (DMA + CRC error) */
    static const uint16_t RINGS[3] = { 16, RQ_NB, 8 };
    static const char *const WHERE[3] = { "ocram", "dtcm", "ocram" };
    static const uint8_t WORKB[2] = { 0, 8 };                 /* us of arithmetic per block (one token: 7.6) */
    const uint32_t cyc_us = F_CPU_ACTUAL / 1000000u, NB = (2u << 20) / 512u;
    for (int r = 0; r < 3; r++)
    for (int w = 0; w < 2; w++) {
        sd_idle();
        rg_nb = RINGS[r];
        uint8_t *ring = r == 1 ? rq_ring : sdbuf;
        rg_desc[0] = ((rg_nb * 512u) << 16) | 0x21u; rg_desc[1] = (uint32_t)ring;   /* Tran over the ring */
        rg_desc[2] = 0x31u;                          rg_desc[3] = (uint32_t)rg_desc; /* Link back to it */
        arm_dcache_flush_delete(ring, rg_nb * 512u);
        rg_prod = 0; rg_cons = 0; rg_err = 0; rg_parked = 0; rg_irqs = 0;
        uint64_t h = 1469598103934665603ull;
        int err = 0;
        const uint32_t sten0 = USDHC1_INT_STATUS_EN;
        USDHC1_INT_STATUS_EN = sten0 | FX_TC;
        attachInterruptVector(IRQ_SDHC1, rg_isr);
        NVIC_SET_PRIORITY(IRQ_SDHC1, 6 * 16);
        NVIC_ENABLE_IRQ(IRQ_SDHC1);
        USDHC1_INT_SIGNAL_EN = FX_TC | FX_ERR;
        uint32_t cpy = 0;
        const uint32_t t0 = micros();
        if (!sd_cmd18_dma((uint32_t)(mf_sector0 + OFF / 512u), rg_desc)) err = -10;
        static uint8_t blk[512] __attribute__((aligned(32)));
        for (uint32_t b = 0; !err && b < NB; b++) {
            const uint32_t tw = micros();
            while (rg_prod <= b) {
                if (rg_err) { err = -3; break; }
                if (micros() - tw > 200000u) { err = -1; break; }
            }
            if (err) break;
            uint8_t *bp = ring + (b % rg_nb) * 512u;
            const uint32_t c0 = ARM_DWT_CYCCNT;
            arm_dcache_delete(bp, 512);                         /* what the DMA wrote, not stale lines */
            memcpy(blk, bp, 512);                               /* the copy out to the reader's buffer */
            cpy += ARM_DWT_CYCCNT - c0;
            noInterrupts();
            rg_cons = b + 1u;
            if (rg_parked && rg_prod < NB) {
                rg_parked = 0;
                USDHC1_PROT_CTRL &= ~FX_SABGREQ; USDHC1_PROT_CTRL |= FX_CREQ; USDHC1_PROT_CTRL |= FX_SABGREQ;
            }
            interrupts();
            for (uint32_t i = 0; i < 512u; i++) { h ^= blk[i]; h *= 1099511628211ull; }
            if (WORKB[w]) { const uint32_t s0 = ARM_DWT_CYCCNT; while (ARM_DWT_CYCCNT - s0 < WORKB[w] * cyc_us) {} }
        }
        const uint32_t us = micros() - t0;
        USDHC1_INT_SIGNAL_EN = 0;
        USDHC1_INT_STATUS_EN = sten0;
        const uint32_t adma_es = USDHC1_ADMA_ERR_STATUS;
        const bool stopped = fx_card()->readStop();
        USDHC1_PROT_CTRL &= ~(3u << 8);
        say("FIFOX ring %s blocks %lu work_us_per_block %u mb_s %.2f us_per_block %.2f copy_us_per_block %.2f interrupts %lu data %s%s adma_err 0x%08lX temp_c %.1f",
            WHERE[r], (unsigned long)rg_nb, WORKB[w], err ? 0.0f : 2.0f * 1.048576f / (us / 1e6f), err ? 0.0f : us / 4096.0f,
            err ? 0.0f : (float)((double)cpy / cyc_us / 4096.0), (unsigned long)rg_irqs, err ? "FAILED" : h == ref ? "OK" : "WRONG",
            stopped ? "" : " (stop failed)", (unsigned long)adma_es, tempmonGetTemp());
        if (err) say("FIFOX   error %d at block %lu, produced %lu, INT_STATUS 0x%08lX PRES_STATE 0x%08lX ADMA_SYS_ADDR 0x%08lX rg_err 0x%08lX", err,
                     (unsigned long)rg_cons, (unsigned long)rg_prod, (unsigned long)USDHC1_INT_STATUS, (unsigned long)USDHC1_PRES_STATE,
                     (unsigned long)USDHC1_ADMA_SYS_ADDR, (unsigned long)rg_err);
        if (!sdio_switch(false)) { say("FIFOX end: restart failed"); halt("the card did not restart; power-cycle the Teensy (unplug USB for 2 s)"); return; }
    }
    if (was_dma && !sdio_switch(true)) { say("FIFOX end: DMA restart failed"); return; }
    say("FIFOX ring end temp_c %.1f", tempmonGetTemp());
}

/* ::sdfifo cycle -- the ring the way a pass uses it (2026-10-16: ::fifoirq 3 failed in a real pass, the same ring
 * passed ::sdfifo ring). A pass opens the stream, reads a run of sequential blocks, closes it for a norm or bias
 * read through the file layer, and reopens it somewhere else -- with no controller restart between, unlike the
 * ring test. The production functions themselves (rq_read, fq_close), 24 runs of 8 sequential 24 KB reads with a
 * file-layer read between runs; every read's sum against the file layer's read of the same bytes; with and
 * without a data-line reset after each close. */
FLASHMEM static void sd_ring_cycle(void)
{
    say("FIFOX cycle begin temp_c %.1f", tempmonGetTemp());
    if (!mf_contig) { say("FIFOX end: the model file is not contiguous"); return; }
    const bool was_dma = g_dma;
    const int was_mode = g_fifoirq;
    if (g_dma && !sdio_switch(false)) { say("FIFOX end: FIFO restart failed"); return; }
    const uint32_t RUNS = 24, PER = 8, K = 24u * 1024u;
    static uint64_t refsum[24 * 8];
    uint32_t rb = 0;
    uint8_t *buf = (uint8_t *)tl_rowbuf(&rb);
    auto offs = [&](uint32_t run, uint32_t j) -> uint64_t { return (64ull << 20) + (uint64_t)run * (61ull << 20) + (uint64_t)j * K; };
    for (uint32_t r = 0; r < RUNS; r++)                     /* the reference: the file layer, FIFO */
        for (uint32_t j = 0; j < PER; j++) {
            if (mf_read_at(offs(r, j), sdbuf, K, K)) { say("FIFOX end: reference read failed"); return; }
            uint64_t h = 1469598103934665603ull;
            for (uint32_t i = 0; i < K; i++) { h ^= sdbuf[i]; h *= 1099511628211ull; }
            refsum[r * PER + j] = h;
        }
    for (int v = 0; v < 2; v++) {
        g_rq_rstd = v;
        g_fifoirq = 3;
        sd_idle();
        memset(rq_canary, 0x5A, sizeof rq_canary);
        arm_dcache_flush_delete(rq_canary, sizeof rq_canary);
        int bad = 0, failed = 0;
        const uint32_t o0 = fq_opens, t0 = micros();
        for (uint32_t r = 0; r < RUNS && !failed; r++) {
            for (uint32_t j = 0; j < PER; j++) {
                if (rq_read(offs(r, j), buf, K, NULL, NULL)) { failed = 1; say("FIFOX   cycle: run %lu read %lu failed", (unsigned long)r, (unsigned long)j); break; }
                uint64_t h = 1469598103934665603ull;
                for (uint32_t i = 0; i < K; i++) { h ^= buf[i]; h *= 1099511628211ull; }
                if (h != refsum[r * PER + j]) bad++;
            }
            uint8_t nb[512];                                 /* the norm/bias read: the file layer closes the stream */
            if (mf_read_at(offs(r, 0) + 7ull * K + 4096u, nb, sizeof nb, sizeof nb)) { failed = 1; say("FIFOX   cycle: file read after run %lu failed", (unsigned long)r); }
        }
        fq_close();
        arm_dcache_delete(rq_canary, sizeof rq_canary);
        int canary = 0;
        for (uint32_t i = 0; i < sizeof rq_canary; i++) if (rq_canary[i] != 0x5A) canary++;
        say("FIFOX cycle pass %d runs %lu reads %lu wrong %d failed %d opens %lu ms %lu canary_bytes_changed %d temp_c %.1f", v, (unsigned long)RUNS,
            (unsigned long)(RUNS * PER), bad, failed, (unsigned long)(fq_opens - o0), (unsigned long)((micros() - t0) / 1000u), canary, tempmonGetTemp());
        if (!sdio_switch(false)) { say("FIFOX end: restart failed"); halt("the card did not restart; power-cycle the Teensy (unplug USB for 2 s)"); return; }
    }
    g_rq_rstd = 0;
    g_fifoirq = was_mode;
    if (was_dma && !sdio_switch(true)) { say("FIFOX end: DMA restart failed"); return; }
    say("FIFOX cycle end temp_c %.1f", tempmonGetTemp());
}

FLASHMEM static void sd_fifo_sweep(bool irq_only)
{
    say("FIFOX begin temp_c %.1f", tempmonGetTemp());
    if (!mf_contig) { say("FIFOX end: the model file is not contiguous, no sector arithmetic"); return; }
    const bool was_dma = g_dma;
    if (g_dma && !sdio_switch(false)) { say("FIFOX end: FIFO restart failed"); return; }
    const uint64_t OFF = 512ull << 20;
    uint64_t ref = 0;
    float rf = 0;
    if (!sd_region(OFF, &ref, &rf)) { say("FIFOX end: reference read failed"); return; }
    say("FIFOX file mb_s %.2f (SdFat's file layer, the reference)", rf);
    static const uint16_t WORK[10] = { 0, 5, 10, 15, 20, 25, 30, 40, 60, 0 };
    const uint32_t cyc_us = F_CPU_ACTUAL / 1000000u;
    for (int mode = 0; mode < 2 && !irq_only; mode++) {
        const bool gap = mode == 0;
        for (int w = 0; w < 10; w++) {
            sd_idle();
            const uint32_t K = 64u * 1024u, N = 2u << 20;
            uint64_t h = 1469598103934665603ull;
            uint32_t us = 0;
            int err = 0;
            fx_sdoff = 0; fx_wait_cyc = 0;
            if (!fx_card()->readStart((uint32_t)(mf_sector0 + OFF / 512u))) err = -10;
            if (!err && !gap) {                       /* readStart set Stop At Block Gap: clear it, continue */
                USDHC1_PROT_CTRL &= ~FX_SABGREQ;
                USDHC1_PROT_CTRL |= FX_CREQ;
            }
            for (uint32_t got = 0; !err && got < N; got += K) {
                const uint32_t t0 = micros();
                for (uint32_t b = 0; b < K / 512u && !err; b++)
                    err = fx_block((uint32_t *)(sdbuf + b * 512u), WORK[w] * cyc_us, gap);
                us += micros() - t0;
                if (!err) for (uint32_t i = 0; i < K; i++) { h ^= sdbuf[i]; h *= 1099511628211ull; }
            }
            const bool stopped = fx_card()->readStop();
            const float mbs = us ? 2.0f * 1.048576f / (us / 1e6f) : 0.0f;
            say("FIFOX %s work_us %u mb_s %.2f us_per_block %.2f wait_us_per_block %.2f sdoff %lu data %s%s temp_c %.1f",
                gap ? "gap" : "stream", WORK[w], err ? 0.0f : mbs, err ? 0.0f : us / 4096.0f,
                err ? 0.0f : (float)((double)fx_wait_cyc / cyc_us / 4096.0), (unsigned long)fx_sdoff,
                err ? "FAILED" : h == ref ? "OK" : "WRONG", stopped ? "" : " (stop failed)", tempmonGetTemp());
            if (err) say("FIFOX   error %d, PRES_STATE 0x%08lX INT_STATUS 0x%08lX; restarting the card", err,
                         (unsigned long)USDHC1_PRES_STATE, (unsigned long)USDHC1_INT_STATUS);
            /* a full restart after every setting: no state carried from one to the next */
            if (!sdio_switch(false)) { say("FIFOX end: restart failed"); halt("the card did not restart; power-cycle the Teensy (unplug USB for 2 s)"); return; }
        }
    }
    /* burst: a FIFO pass's own pattern -- 48 blocks (one 24 KB row block) back to back, then a pause while that
     * block's rows are worked -- with only the reads timed. A 2-position pass read its 1834.8 MB in 67.5 s and a
     * one-position pass in 76.1 s (2026-10-16): the longer pause per block went with the faster reads. If the
     * card reads ahead while parked at a block gap, read time per burst falls as the pause grows. */
    static const uint16_t PAUSE[8] = { 0, 100, 200, 400, 600, 1000, 2000, 0 };
    for (int w = 0; w < 8 && !irq_only; w++) {
        sd_idle();
        const uint32_t K = 64u * 1024u, N = 2u << 20;
        uint64_t h = 1469598103934665603ull;
        uint32_t cyc = 0;
        int err = 0;
        fx_wait_cyc = 0;
        if (!fx_card()->readStart((uint32_t)(mf_sector0 + OFF / 512u))) err = -10;
        uint32_t blk = 0;
        for (uint32_t got = 0; !err && got < N; got += K) {
            for (uint32_t b = 0; b < K / 512u && !err; b++, blk++) {
                const uint32_t c0 = ARM_DWT_CYCCNT;
                err = fx_block((uint32_t *)(sdbuf + b * 512u), 0, true);
                cyc += ARM_DWT_CYCCNT - c0;
                if (blk % 48u == 47u && PAUSE[w]) {
                    const uint32_t p0 = ARM_DWT_CYCCNT;
                    while (ARM_DWT_CYCCNT - p0 < PAUSE[w] * cyc_us) {}
                }
            }
            if (!err) for (uint32_t i = 0; i < K; i++) { h ^= sdbuf[i]; h *= 1099511628211ull; }
        }
        const bool stopped = fx_card()->readStop();
        const float rus = (float)cyc / cyc_us;
        say("FIFOX burst48 pause_us %u read_mb_s %.2f read_us_per_block %.2f data %s%s temp_c %.1f", PAUSE[w],
            err ? 0.0f : 2.0f * 1.048576f / (rus / 1e6f), err ? 0.0f : rus / 4096.0f,
            err ? "FAILED" : h == ref ? "OK" : "WRONG", stopped ? "" : " (stop failed)", tempmonGetTemp());
        if (err) say("FIFOX   error %d, PRES_STATE 0x%08lX INT_STATUS 0x%08lX; restarting the card", err,
                     (unsigned long)USDHC1_PRES_STATE, (unsigned long)USDHC1_INT_STATUS);
        if (!sdio_switch(false)) { say("FIFOX end: restart failed"); halt("the card did not restart; power-cycle the Teensy (unplug USB for 2 s)"); return; }
    }
    /* irq: the card fed by an interrupt while the CPU works -- the design that would need no change to the core.
     * Read watermark = 128 words (a whole block): Buffer Read Ready fires when a block is in; the handler drains
     * it into a 64 KB ring; the stop at the block gap then fires Transfer Complete and the handler asks for the
     * next block (SdFat's own handshake, moved into the interrupt). Meanwhile the main loop sums each block from
     * the ring and spins `work` us after it -- whole rows of arithmetic, uninterrupted. When the ring is full the
     * handler leaves the card parked and the main loop asks once it has room. Timed: the whole 2 MB.
     * The read watermark 128 / 64 / 32 / 16 words: at 128 a block is drained only once all of it is in (and the
     * next waits behind the drain); lower, the handler drains while the block arrives. */
    static const uint8_t WMLS[4] = { 128, 64, 32, 16 };
    static const uint8_t IWORK[6] = { 0, 10, 15, 20, 25, 30 };
    for (int m = 0; m < 4; m++)
    for (int iw = 0; iw < 6; iw++) {
        const uint32_t wk = IWORK[iw];
        sd_idle();
        const uint32_t N = 2u << 20, NB = N / 512u, RING = 128u;
        uint64_t h = 1469598103934665603ull;
        int err = 0;
        fxi_dst = (uint32_t *)sdbuf; fxi_ring = RING; fxi_total = NB; fxi_done = 0; fxi_used = 0; fxi_err = 0;
        fxi_parked = 0; fxi_irqs = 0; fxi_wpos = 0; fxi_wml = WMLS[m];
        const uint32_t wml0 = USDHC1_WTMK_LVL, sten0 = USDHC1_INT_STATUS_EN;
        USDHC1_WTMK_LVL = (wml0 & ~0xFFu) | WMLS[m];
        USDHC1_INT_STATUS_EN = sten0 | FX_BRR | FX_TC;
        USDHC1_INT_STATUS = 0xFFFFFFFFu;
        attachInterruptVector(IRQ_SDHC1, fx_isr);
        NVIC_SET_PRIORITY(IRQ_SDHC1, 6 * 16);
        NVIC_ENABLE_IRQ(IRQ_SDHC1);
        USDHC1_INT_SIGNAL_EN = FX_BRR | FX_TC | FX_ERR;
        const uint32_t t0 = micros();
        if (!fx_card()->readStart((uint32_t)(mf_sector0 + OFF / 512u))) err = -10;
        for (uint32_t j = 0; !err && j < NB; j++) {
            const uint32_t tw = micros();
            while (fxi_done <= j) {                                  /* the block is not in yet */
                if (fxi_err) { err = -3; break; }
                if (micros() - tw > 100000u) { err = -1; break; }
            }
            if (err) break;
            const uint8_t *bp = sdbuf + (j % RING) * 512u;
            for (uint32_t i = 0; i < 512u; i++) { h ^= bp[i]; h *= 1099511628211ull; }
            if (wk) { const uint32_t c0 = ARM_DWT_CYCCNT; while (ARM_DWT_CYCCNT - c0 < wk * cyc_us) {} }
            noInterrupts();
            fxi_used = j + 1;                                        /* block j's slot is free again */
            const bool resume = fxi_parked && fxi_done < fxi_total;
            if (resume) { fxi_parked = 0; USDHC1_PROT_CTRL &= ~FX_SABGREQ; USDHC1_PROT_CTRL |= FX_CREQ; USDHC1_PROT_CTRL |= FX_SABGREQ; }
            interrupts();
        }
        const uint32_t us = micros() - t0;
        USDHC1_INT_SIGNAL_EN = 0;
        USDHC1_INT_STATUS_EN = sten0;
        USDHC1_WTMK_LVL = wml0;
        const bool stopped = fx_card()->readStop();
        say("FIFOX irq wml %u work_us %lu mb_s %.2f us_per_block %.2f interrupts %lu data %s%s temp_c %.1f", WMLS[m], (unsigned long)wk,
            err ? 0.0f : 2.0f * 1.048576f / (us / 1e6f), err ? 0.0f : us / 4096.0f, (unsigned long)fxi_irqs,
            err ? "FAILED" : h == ref ? "OK" : "WRONG", stopped ? "" : " (stop failed)", tempmonGetTemp());
        if (err) say("FIFOX   error %d, blocks in %lu, PRES_STATE 0x%08lX INT_STATUS 0x%08lX; restarting the card", err,
                     (unsigned long)fxi_done, (unsigned long)USDHC1_PRES_STATE, (unsigned long)USDHC1_INT_STATUS);
        /* the restart (sd.begin) re-attaches SdFat's own handler and status mask */
        if (!sdio_switch(false)) { say("FIFOX end: restart failed"); halt("the card did not restart; power-cycle the Teensy (unplug USB for 2 s)"); return; }
    }
    float r2 = 0;
    uint64_t s2 = 0;
    const bool ok2 = sd_region(OFF, &s2, &r2);
    say("FIFOX file again mb_s %.2f data %s", ok2 ? r2 : 0.0f, !ok2 ? "FAILED" : s2 == ref ? "OK" : "WRONG");
    if (was_dma && !sdio_switch(true)) { say("FIFOX end: DMA restart failed"); return; }
    say("FIFOX end temp_c %.1f", tempmonGetTemp());
}

FLASHMEM static void card_bench(void)
{
    static const uint32_t SZ[3] = { 4096, 16384, 65536 };
    for (int k = 0; k < 3; k++) {
        const uint32_t N = 16u << 20;
        uint64_t off = 512ull << 20;
        bool ok = true;
        const uint32_t t0 = micros();
        for (uint32_t got = 0; got < N; got += SZ[k], off += SZ[k])
            if (plat_sd_read(off, sdbuf, SZ[k])) { ok = false; break; }
        const float s = (micros() - t0) / 1e6f;
        say("BENCH sd_seq read_size %lu mb_s %.2f sdio %s%s", (unsigned long)SZ[k], 16.0 * 1.048576 / s,
            g_dma ? "dma" : "fifo", ok ? "" : " FAILED");
    }
    {   /* The same reads into DTCM (uncached, where the model's pipeline buffers are) instead of the cached
         * OCRAM arena above. v7's first boot: DMA_SDIO gave 7.26 MB/s into OCRAM at 4, 16 and 64 KB alike. */
        uint8_t dt[4096] __attribute__((aligned(32)));      /* on the stack: DTCM too, and no RAM1 kept for it */
        const uint32_t N = 16u << 20;
        uint64_t off = 512ull << 20;
        bool ok = true;
        const uint32_t t0 = micros();
        for (uint32_t got = 0; got < N; got += sizeof dt, off += sizeof dt)
            if (plat_sd_read(off, dt, sizeof dt)) { ok = false; break; }
        const float s = (micros() - t0) / 1e6f;
        say("BENCH sd_seq_dtcm read_size %lu mb_s %.2f sdio %s clock_khz %lu%s", (unsigned long)sizeof dt,
            16.0 * 1.048576 / s, g_dma ? "dma" : "fifo", sd_clk_now(), ok ? "" : " FAILED");
    }
}

FLASHMEM static void bench(void)
{
    say("BENCH begin temp_c %.1f", tempmonGetTemp());
    /* both card modes on the same boot, then back to the one it was in (every command leaves the card idle) */
    const bool was = g_dma;
    card_bench();
    if (sdio_switch(!was)) card_bench();
    else say("BENCH sdio switch to %s failed", was ? "fifo" : "dma");
    if (!sdio_switch(was)) { halt("the card did not restart; power-cycle the Teensy (unplug USB for 2 s)"); return; }
    {
        uint32_t x = 12345u;
        int fails = 0;
        const uint32_t blocks = (uint32_t)(mf_size / 4096u) - 1u;
        const uint32_t t0 = micros();
        for (int i = 0; i < 256; i++) {
            x = x * 1664525u + 1013904223u;
            if (plat_sd_read((uint64_t)(x % blocks) * 4096u, sdbuf, 4096)) fails++;
        }
        const float s = (micros() - t0) / 1e6f;
        say("BENCH sd_random read_size 4096 count 256 ms_each %.3f mb_s %.2f fails %d", s * 1000.0f / 256.0f,
            256.0 * 4096.0 / 1048576.0 / s, fails);
    }
    bench_kernel("ffn_gate_L0", 0, 4);
    bench_kernel("ffn_down_L0", 0, 6);
    bench_kernel("attn_v_L0", 0, 2);
    bench_kernel("token_embd", 0, 7);
    /* PSRAM: a bank holding no layer if there is one (a spare), else layer 0's bank -- between prompts the
     * cache is rewritten by the next prompt anyway. One megabyte: raw, then through the platform (a verified
     * write, a single read), then the cache the way attention uses it (tl_cache_bench, layer 0). */
    {
        int bi = -1;
        for (int b = 0; b < nuse && bi < 0; b++) {
            bool held = false;
            for (int l = 0; l < info.n_layer && !held; l++) held = tl_layer_bank(l) == b;
            if (!held) bi = b;
        }
        if (bi < 0) bi = tl_layer_bank(0);
        const uint32_t N = 1u << 20;
        ps_bank(bi);
        g_tag = 0x77;
        uint32_t t0 = micros();
        fill(0, N);
        const float sw = (micros() - t0) / 1e6f;
        t0 = micros();
        const uint32_t bad = verify(0, N);
        const float sr = (micros() - t0) / 1e6f;
        say("BENCH psram_raw bank %s mode %s write_mb_s %.2f read_mb_s %.2f wrong %lu", use[bi].name,
            MODE_NAME[use[bi].mode], 1.048576 / sw, 1.048576 / sr, (unsigned long)bad);
        for (uint32_t i = 0; i < BLK; i++) buf[i] = pat(i);
        t0 = micros();
        int ew = 0;
        for (uint32_t o = 0; o < N; o += BLK) ew |= plat_ps_write(bi, o, buf, BLK);
        const float cw = (micros() - t0) / 1e6f;
        t0 = micros();
        int er = 0;
        for (uint32_t o = 0; o < N; o += BLK) er |= plat_ps_read(bi, o, sdbuf, BLK);
        const float cr = (micros() - t0) / 1e6f;
        say("BENCH psram_plat bank %s verified_write_mb_s %.2f read_mb_s %.2f errors %d", use[bi].name,
            1.048576 / cw, 1.048576 / cr, ew | er);
        double tw = 0, tr = 0;
        uint32_t rr = 0;
        const int np = info.max_seq < 1024 ? info.max_seq : 1024;
        const uint32_t sw0 = ps_switches;
        if (tl_cache_bench(np, &tw, &tr, &rr))
            say("BENCH cache_layer failed: %s", tl_last_error());
        else
            say("BENCH cache_layer bank %s positions %d write_s %.3f read_s %.3f ms_per_position_read %.3f rows_reread %lu bank_switches %lu",
                use[tl_layer_bank(0)].name, np, tw, tr, tr * 1000.0 / np, (unsigned long)rr, (unsigned long)(ps_switches - sw0));
    }
    say("BENCH end temp_c %.1f", tempmonGetTemp());
}

FLASHMEM static void stats(void)
{
    for (int i = 0; i < nuse; i++)
        say("STATS bank %d %s %s write %d read %d burst %d rate_mb_s %.2f", i, use[i].name, MODE_NAME[use[i].mode],
            NOPS[use[i].wi], NOPS[use[i].ri], use[i].nb, use[i].rate);
    say("STATS stack_never_used %lu", (unsigned long)stack_unused());
    say("STATS ps_fix_r %lu ps_fix_w %lu ps_bad %lu temp_c %.1f gen %d max_seq %d uptime_s %lu",
        (unsigned long)ps_fix_r, (unsigned long)ps_fix_w, (unsigned long)ps_bad, tempmonGetTemp(), g_gen,
        info.max_seq, (unsigned long)(millis() / 1000));
}

static void dispatch_one(char *line);
static void dispatch(char *line) { dispatch_one(line); sd_idle(); }   /* every command ends with the card idle */
FLASHMEM static void dispatch_one(char *line)
{
    /* a command that may write the attention cache (benchmarks, PSRAM tests, anything not known harmless) makes the
     * board forget what it holds: reuse only ever skips rows it is sure of */
    if (line[0] == ':' && line[1] == ':') {
        static const char *const SAFE[] = { "::gen", "::lookup", "::reuse", "::stats", "::hold", "::fifoirq", "::admamin", "::promptlogits", "::ringfault",
                                            "::ffngroup", "::prefill", "::stop", "::share", "::multi", "::sdio", "::sdclk" };
        bool safe = false;
        for (unsigned i = 0; i < sizeof SAFE / sizeof SAFE[0] && !safe; i++) safe = !strncmp(line, SAFE[i], strlen(SAFE[i]));
        if (!safe) g_kv_len = 0;
    }
    if (!strcmp(line, "I") || !strcmp(line, "i")) {
        say("I bench-one psram_llm v9 banks %d ps_bytes %lu max_seq %d gen %d sdio %s overlap %d align %d slice %lu clk %lu model %s batch %d experts %d/%d", nuse,
            (unsigned long)nuse * BANKSZ, info.max_seq, g_gen, g_dma ? "dma" : "fifo", g_overlap, g_align, (unsigned long)g_slice_us,
            sd_clk_now(), g_model_name, info.batch, info.n_used, info.n_expert);
        return;
    }
    if (!strncmp(line, "::model", 7)) {                      /* ::model NAME.gguf: record it, restart, open it */
        const char *a = line + 7;
        while (*a == ' ') a++;
        if (!*a) { say("MODEL %s (tokenizer store %s)", g_model_name, g_tok_name); return; }
        const size_t L = strlen(a);
        if (L < 6 || L > 40 || strcmp(a + L - 5, ".gguf") || !sd.exists(a)) { say("MODEL %s: not a .gguf on the card", a); return; }
        FsFile f = sd.open("model.txt", O_RDWR | O_CREAT | O_TRUNC);
        if (!f) { say("MODEL: cannot write model.txt"); return; }
        f.write(a, L); f.write("\n", 1); f.close();
        say("MODEL %s saved to model.txt; restarting the board to open it (about a minute)", a);
        sd_idle();                                          /* the card is idle: a restart here cannot hang it */
        Serial.flush();
        delay(300);
        SCB_AIRCR = 0x05FA0004;                              /* Teensy 4 system reset */
        for (;;) {}
    }
    if (!strncmp(line, "::gen", 5)) {
        int v = atoi(line + 5);
        if (v < 1) v = 1;
        if (v > MAX_GEN) v = MAX_GEN;
        g_gen = v;
        say("GEN %d", g_gen);
        return;
    }
    if (!strcmp(line, "::bench")) { bench(); return; }
    if (!strcmp(line, "::kbench")) { kbench(); return; }
    if (!strncmp(line, "::lookup", 8)) {                     /* ::lookup K: speculative decoding from the context */
        char *e = 0;
        int v = (int)strtol(line + 8, &e, 10);
        if (v < 0) v = 0;
        if (v > tl_batch() - 1) v = tl_batch() - 1;
        const int nm = (e && *e) ? atoi(e) : 0;
        if (nm >= 1 && nm <= 4) g_lookup_nmin = nm;
        g_lookup = v;
        say("LOOKUP %d match 4..%d%s", v, g_lookup_nmin, v ? "" : " (off: one token a pass)");
        return;
    }
    if (!strncmp(line, "::promptlogits", 14)) {              /* ::promptlogits 0|1: the head at every prompt position */
        g_promptlogits = atoi(line + 14) ? 1 : 0;
        say("PROMPTLOGITS %d", g_promptlogits);
        return;
    }
    if (!strncmp(line, "::ringfault", 11)) {                 /* ::ringfault N: test the ring's failure path */
        g_ring_fault = atoi(line + 11);
        say("RINGFAULT %d (that ring read fails halfway; the pass must go on through the file layer, exact)", g_ring_fault);
        return;
    }
    if (!strncmp(line, "::reuse", 7)) {                      /* ::reuse 0|1: feed a prompt from where the cache differs */
        g_reuse = atoi(line + 7) ? 1 : 0;
        if (!g_reuse) g_kv_len = 0;
        say("REUSE %d (the cache holds %d positions)", g_reuse, g_kv_len);
        return;
    }
    if (!strncmp(line, "::fifoirq", 9)) {                    /* ::fifoirq 0|1: FIFO passes fed by the interrupt */
        const int v = atoi(line + 9);                        /* 0 off; 1 on (watermark kept); 16/32/64/128 on at that watermark */
        fq_close();
        if (v == 16 || v == 32 || v == 64 || v == 128) fq_wml = (uint32_t)v;
        g_fifoirq = (v == 2 || v == 3) ? v : v ? 1 : 0;      /* 2: copied by ADMA2 into the reads; 3: ADMA2 into a ring */
        say("FIFOIRQ %d wml %lu%s", g_fifoirq, (unsigned long)fq_wml, g_fifoirq == 3 ? " (the card streaming by ADMA2 into a ring, arithmetic under it)" :
            g_fifoirq == 2 ? " (one open transfer, copied by ADMA2, arithmetic under it)" :
            g_fifoirq ? " (FIFO pipeline reads fed by the card's interrupt, arithmetic under them)" : "");
        return;
    }
    if (!strncmp(line, "::ffngroup", 10)) {                  /* ::ffngroup N: batched gate/up rows per group (32 = the old order) */
        const int v = atoi(line + 10);
        const int was = tl_set_ffn_group(v ? v : 0);
        if (was < 0) say("FFNGROUP %d refused: 32..256, a multiple of 32", v);
        else say("FFNGROUP %d (was %d)", v ? v : was, was);
        return;
    }
    if (!strcmp(line, "::stats")) { stats(); return; }
    if (!strcmp(line, "::hold"))  { say("HOLD waiting for prompts"); return; }
    if (!strncmp(line, "::prefill", 9)) { g_prefill = atoi(line + 9) ? 1 : 0; say("PREFILL %d", g_prefill); return; }
    if (!strcmp(line, "::stop"))  { g_abort = false; say("STOPPED (was idle)"); return; }
    if (!strncmp(line, "::sdio", 6)) {
        const bool dma = strstr(line + 6, "dma") != NULL;
        if (sdio_switch(dma)) say("SDIO %s", dma ? "dma" : "fifo");
        else { say("SDIO failed"); halt("the card did not restart; power-cycle the Teensy (unplug USB for 2 s)"); }
        return;
    }
    if (!strncmp(line, "::overlap", 9)) { g_overlap = atoi(line + 9) ? 1 : 0; say("OVERLAP %d (card %s)", g_overlap, g_dma ? "DMA_SDIO" : "FIFO_SDIO: no overlap possible"); return; }
    if (!strncmp(line, "::align", 7)) { g_align = atoi(line + 7) ? 1 : 0; say("ALIGN %d (card %s)", g_align, g_dma ? "DMA_SDIO" : "FIFO_SDIO: reads stay exact"); return; }
    if (!strcmp(line, "::sdsweep")) { sd_sweep(); return; }
    if (!strcmp(line, "::sdclksweep")) { sd_clk_sweep(); return; }
    if (!strcmp(line, "::sdadma")) { sd_adma_sweep(); return; }
    if (!strcmp(line, "::sdfifo")) { sd_fifo_sweep(false); return; }
    if (!strcmp(line, "::sdfifo irq")) { sd_fifo_sweep(true); return; }
    if (!strcmp(line, "::sdfifo adma")) { sd_adma_open(); return; }
    if (!strcmp(line, "::sdfifo ring")) { sd_adma_ring(); return; }
    if (!strcmp(line, "::sdfifo cycle")) { sd_ring_cycle(); return; }
    if (!strcmp(line, "::sdtrace")) { sd_trace(); return; }
    if (!strncmp(line, "::admamin", 9)) {                    /* ::admamin N: passes with >= N positions go by ADMA2; 0 = never */
        long v = strtol(line + 9, NULL, 10);
        if (v < 0) v = 0;
        if (v > 8) v = 8;
        g_adma_min = (int)v;
        say("ADMAMIN %d%s", g_adma_min, g_adma_min ? "" : " (the card path is only what ::sdio/::sdpath set)");
        return;
    }
    if (!strncmp(line, "::sdpath", 8)) {                     /* ::sdpath file|adma: how a pipeline read reaches the card */
        g_sdpath = strstr(line + 8, "adma") ? 1 : 0;
        say("SDPATH %s%s", g_sdpath ? "adma" : "file", g_sdpath && !g_dma ? " (takes effect in DMA mode: ::sdio dma)" : "");
        return;
    }
    if (!strncmp(line, "::sdclk", 7)) {                      /* ::sdclk N: divide 198 MHz by N (2..16); 0 = SdFat's */
        const unsigned long d = strtoul(line + 7, NULL, 10);
        if (d >= 2 && d <= 16) { g_sddvs = (uint8_t)(d - 1); sd_idle(); sd_set_dvs(g_sddvs); }
        else { g_sddvs = 0; if (!sdio_switch(g_dma)) { say("SDCLK failed"); halt("the card did not restart; power-cycle the Teensy (unplug USB for 2 s)"); return; } }
        say("SDCLK khz %lu divider %lu", sd_clk_now(), ((USDHC1_SYS_CTRL >> 4) & 0xF) + 1ul);
        return;
    }
    if (!strcmp(line, "::sdregs"))  { sd_regs(g_dma ? "DMA" : "FIFO"); say("SDREGS cfg %d wml %u brst %u blen %u", g_sdcfg, g_rwml, g_rbrst, g_blen); return; }
    if (!strncmp(line, "::sdcfg", 7)) {
        char *e1, *e2, *e3;                       /* strtoul, not sscanf: scanf costs RAM1 28 KB of tables */
        const unsigned long w = strtoul(line + 7, &e1, 10), b = strtoul(e1, &e2, 10), l = strtoul(e2, &e3, 10);
        const int n = (e1 != line + 7) + (e2 != e1) + (e3 != e2);
        if (n == 3 && w >= 1 && w <= 128 && b >= 1 && b <= 31 && b <= w && l <= 7) {
            g_rwml = (uint8_t)w; g_rbrst = (uint8_t)b; g_blen = (uint8_t)l; g_sdcfg = true;
            sd_cfg_reapply();
        } else {
            g_sdcfg = false;                          /* SdFat's own: restart the card so cardInit sets them */
            if (!sdio_switch(g_dma)) { say("SDCFG failed"); halt("the card did not restart; power-cycle the Teensy (unplug USB for 2 s)"); return; }
        }
        say("SDCFG %s wml %u brst %u blen %u", g_sdcfg ? "set" : "sdfat", g_rwml, g_rbrst, g_blen);
        return;
    }
    if (!strncmp(line, "::slice", 7)) {
        long v = atol(line + 7);
        if (v < 0) v = 0;
        if (v > 100000) v = 100000;
        g_slice_us = (uint32_t)v;
        say("SLICE %lu us of rows per yield%s", (unsigned long)g_slice_us, g_slice_us ? "" : " (0: one row per yield)");
        return;
    }
    if (!strncmp(line, "::share", 7)) { const int on = atoi(line + 7) ? 1 : 0; tl_multi_share(on); say("SHARE %d", on); return; }
    if (!strncmp(line, "::multi", 7)) {
        int v = atoi(line + 7);
        if (v < 0) v = 0;
        if (v > MULTI_MAX) v = MULTI_MAX;
        g_multi_want = v;
        g_multi_n = 0;
        g_mids_used = 0;
        say("MULTI %d", v);
        return;
    }
    unescape(line);
    if (g_multi_want > 0) {                   /* one of the prompts of a ::multi: encode it and wait for the rest */
        tl_seq_t *q = &mseq[g_multi_n];
        int32_t *ids = mids + g_mids_used;
        const int room = MIDS_POOL - g_mids_used - g_gen - 1;
        const int n = room > 0 ? tl_encode(line, ids, room) : -1;
        if (n <= 0) { say("  multi prompt %d did not fit; ::multi cancelled", g_multi_n); say("RUN error=encode"); g_multi_want = 0; g_multi_n = 0; return; }
        q->ids = ids; q->n_prompt = n; q->n_gen = g_gen;
        g_mids_used += n + g_gen + 1;
        DMAMEM static char ep[4096];
        esc(line, (int)strlen(line), ep, (int)sizeof ep);
        say("  multi prompt %d: \"%s\"  (%d tokens)", g_multi_n, ep, n);
        Serial.printf("S%d prompt ids:", g_multi_n);
        for (int i = 0; i < n; i++) { Serial.print(' '); Serial.print((long)ids[i]); }
        Serial.println();
        g_multi_n++;
        if (--g_multi_want == 0) run_multi();
        return;
    }
    run_prompt(line);
}

/* THE STACK'S HIGH-WATER MARK (2026-10-16). The ring (8 KB of DTCM) took the stack from 34 KB to 21 KB; whether
 * that is enough is measured, not assumed: at boot the unused stack is painted, and after every run the words
 * the stack never reached are counted (the core's MPU guard -- 32 bytes at _ebss -- traps an overflow outright). */
extern unsigned long _ebss;
#define STACK_PAINT 0xA5A5A5A5u
static uint32_t *stack_floor(void) { return (uint32_t *)(((((uint32_t)&_ebss) + 31u) & ~31u) + 32u); }
FLASHMEM static void stack_paint(void)
{
    uint32_t sp;
    __asm__ volatile("mov %0, sp" : "=r"(sp));
    for (uint32_t *p = stack_floor(); p < (uint32_t *)(sp - 1024u); p++) *p = STACK_PAINT;
}
FLASHMEM static uint32_t stack_unused(void)
{
    const uint32_t *p = stack_floor();
    uint32_t n = 0;
    while (p[n] == STACK_PAINT) n++;
    return n * 4u;
}

FLASHMEM void setup()
{
    /* from psram_worker setup(), verbatim: FlexSPI off and its pads handed to GPIO9 */
    FLEXSPI2_MCR0 |= FLEXSPI_MCR0_MDIS;
    IOMUXC_SW_MUX_CTL_PAD_GPIO_EMC_22 = 5; IOMUXC_SW_MUX_CTL_PAD_GPIO_EMC_24 = 5;
    IOMUXC_SW_MUX_CTL_PAD_GPIO_EMC_25 = 5; IOMUXC_SW_MUX_CTL_PAD_GPIO_EMC_26 = 5;
    IOMUXC_SW_MUX_CTL_PAD_GPIO_EMC_27 = 5; IOMUXC_SW_MUX_CTL_PAD_GPIO_EMC_28 = 5;
    IOMUXC_SW_MUX_CTL_PAD_GPIO_EMC_29 = 5;
    __asm__ volatile("dsb");

    pinMode(PIN_A, OUTPUT); pinMode(PIN_B, OUTPUT); pinMode(PIN_C, OUTPUT);
    pinMode(PIN_DEC, OUTPUT); digitalWriteFast(PIN_DEC, HIGH);
    for (int p = 48; p <= 54; p++) pinMode(p, OUTPUT);
    GPIO9_DR |= (B_SS0 | B_SS1 | B_DEC);
    bus_out();
    ARM_DEMCR |= ARM_DEMCR_TRCENA;
    ARM_DWT_CTRL |= ARM_DWT_CTRL_CYCCNTENA;

    stack_paint();
    Serial.begin(115200);
    const uint32_t w0 = millis();
    while (!Serial && millis() - w0 < 5000) delay(10);
    delay(200);
    say("\n========================================================================");
    say("  psram_llm v9 -- a 3B-parameter language model on a Teensy 4.1");
    say("  the model: all of it on the microSD, streamed every token");
    say("  PSRAM:     the attention cache -- the model's working memory, nothing of the model");
    say("  cpu %lu MHz, %.1f C", (unsigned long)(F_CPU_ACTUAL / 1000000), tempmonGetTemp());
    say("========================================================================");
    /* a fault on the previous run: the Teensy core keeps its report in RAM across the reset (not a power cut) */
    if (CrashReport) { say("CRASH report from the previous run follows"); Serial.print(CrashReport); say("CRASH report end"); }

    if (!scratch_init()) { halt("the core arena is smaller than the card test needs"); return; }
    psram_bring_up();
    if (nuse < 2) { halt("fewer than two PSRAM banks passed; building the tokenizer's card file needs 8.3 MB of scratch"); return; }

    say("\n  SD card");
    /* RETRIED, AND EVERY FAILURE NAMED. The 2026-09-27 03:26 boot halted here after a flash that rebooted the
     * Teensy while the previous firmware was mid-way through reading the card -- a Teensy reset does not
     * power-cycle the card. SD spec: CMD0 resets a card from any state but "inactive", so a retry should
     * recover it; SdFat's error code says which step of CMD0 / CMD8 / ACMD41 / CMD2... failed if not. */
    bool sd_ok = false;
    for (int a = 1; a <= 8 && !sd_ok; a++) {
        const bool fifo = (a % 2) == 0;          /* DMA_SDIO first: it lets reads overlap the arithmetic */
        if (sd.begin(SdioConfig(fifo ? FIFO_SDIO : DMA_SDIO))) {
            say("    SD up on attempt %d (%s), clock %lu kHz", a, fifo ? "FIFO_SDIO" : "DMA_SDIO", sd_khz());
            g_sd_up = true;
            g_dma = !fifo;
            sd_regs("at boot");
            sd_ok = true;
        } else {
            say("    SD begin attempt %d (%s) failed: SdFat error 0x%02X data 0x%08lX", a, fifo ? "FIFO_SDIO" : "DMA_SDIO",
                (unsigned)sd.sdErrorCode(), (unsigned long)sd.sdErrorData());
            delay(250u * (uint32_t)a);
        }
    }
    if (!sd_ok) { halt("the SD card would not initialise; power-cycle the Teensy (unplug USB for 2 s)"); return; }
    model_name_load();                            /* model.txt, if ::model chose another file */
    if (!model_file_open()) {
        static char hm[80];
        snprintf(hm, sizeof hm, "%s not found on the card", g_model_name);
        halt(hm); return;
    }
    sd_clk_sweep();                               /* the fastest card clock this card reads right at, checked */
    {
        const uint32_t N = 32u * 1024u * 1024u;
        const uint32_t t0 = micros();
        uint32_t got = 0;
        bool ok = true;
        for (uint64_t off = 64ull << 20; got < N; off += SDBUF_BYTES, got += SDBUF_BYTES)
            if (plat_sd_read(off, sdbuf, SDBUF_BYTES)) { ok = false; break; }
        const float s = (micros() - t0) / 1e6f;
        if (!ok) { halt("SD read failed during the rate test"); return; }
        say("    sequential read: 32 MB in %.2f s = %.2f MB/s", s, 32.0f * 1.048576f / s);
    }

    say("\n  opening the model: all of it stays on the card; the PSRAM gets the attention cache and nothing else");
    char err[200];
    const uint32_t t0 = millis();
    const int opened = tl_open(&info, err, sizeof err);
    say("    %.1f s; PSRAM self-check: %lu reads corrected, %lu writes re-done, %lu unresolved",
        (millis() - t0) / 1000.0, (unsigned long)ps_fix_r, (unsigned long)ps_fix_w, (unsigned long)ps_bad);
    if (opened) { halt(err); return; }
    say("    %d layers, dim %d, hidden %d, %d heads (%d kv), head_dim %d, vocabulary %d, %lu merges",
        info.n_layer, info.dim, info.hidden, info.n_heads, info.n_kv, info.head_dim, info.vocab,
        (unsigned long)info.n_merges);
    say("    %.0f parameters in the file", info.params);
    if (info.n_expert)
        say("    mixture of experts: %d a layer, %d picked per token, each %d wide -- only those come off the card;"
            " a pass feeds up to %d positions", info.n_expert, info.n_used, info.eff, info.batch);
    say("    read from the card per token: %llu bytes", (unsigned long long)info.sd_bytes_per_token);
    say("    the model stays on the card: weights, norms and biases read from %s every pass; the tokenizer's"
        " tables in %s (%lu bytes, %s)", g_model_name, g_tok_name, (unsigned long)info.tok_store_bytes,
        info.tok_built ? "built from the model just now" : "checked against the model and reused");
    say("    PSRAM: %d chips, the attention cache on %d of them, one layer per region (%lu bytes), %d positions;"
        " %d layer slots, %d spare (%s) -- nothing of the model", info.banks, info.banks_used,
        (unsigned long)info.layer_bytes, info.max_seq, info.layer_slots, info.spare_slots,
        info.one_bank_spare ? "any one chip can fail" : "not a whole chip's worth");
    {
        char lb[200];
        int k = 0;
        for (int l = 0; l < info.n_layer && k < (int)sizeof lb - 8; l++)
            k += snprintf(lb + k, sizeof lb - (size_t)k, "%s%s", l ? " " : "", use[tl_layer_bank(l)].name);
        say("    layer -> chip: %s", lb);
    }
    ready = true;

    sd_idle();                                /* the rate test and tl_open left a transfer open */
    static char line[2048];
    say("\n  READY. Type a prompt and press Enter within 30 s, or the default runs");
    if (read_line(line, sizeof line, 30000)) dispatch(line);
    else { snprintf(line, sizeof line, "The capital of France is"); run_prompt(line); sd_idle(); }
}

void loop()
{
    if (!ready) { delay(1000); return; }
    static char line[2048];
    if (read_line(line, sizeof line, 1000)) dispatch(line);
}
